AUTOSAR XML (schema 00048)
package /MICROSARFBL/Dcm_ib_bswmd/BswModuleDescriptions
  bsw module description Dcm
    bsw internal behavior DcmBehavior

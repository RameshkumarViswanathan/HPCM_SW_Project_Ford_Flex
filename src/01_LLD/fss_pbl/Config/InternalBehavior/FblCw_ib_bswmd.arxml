AUTOSAR XML (schema 00048)
package /MICROSARFBL
  bsw implementation Dcm_Impl: programming-language=C, sw-version=8.03.00, used-code-generator=DaVinci Configurator, vendor-id=30, ar-release-version=4.00.03

AUTOSAR XML (schema 00048)
package /ActiveEcuC
  module config CryIf: implementation-config-variant=VARIANT-PRE-COMPILE, module-description=CryIf_Impl
    3 x CryIfKey:
      CryIfKey_Fbl_Aes128: CryIfKeyId=1, CryIfKeyRef=CryptoKey_Fbl_Aes128
      CryIfKey_Fbl_Signature_Rsa2048: CryIfKeyId=2, CryIfKeyRef=CryptoKey_Fbl_Signature_Rsa2048
      CryIfKey_Fbl_Signature_Rsa3072: CryIfKeyId=3, CryIfKeyRef=CryptoKey_Fbl_Signature_Rsa3072
    CryIfChannel_CryptoCv_Fbl_Aes (CryIfChannel): CryIfChannelId=1, CryIfDriverObjectRef=Crypto_30_LibCv_Aes
    CryIfChannel_CryptoCv_Fbl_Signature (CryIfChannel): CryIfChannelId=0, CryIfDriverObjectRef=Crypto_30_LibCv
    CryIfCryptoModule: CryIfSupportsKeyElementCopyPartial=true, CryIfCancelJobApiUsesJobType=false, CryIfCryptoModuleRef=Crypto
    CryIfKey_CryptoKey (CryIfKey): CryIfKeyId=0, CryIfKeyRef=CryptoKey_Dummy_Hash
    CryIfGeneral:
      CryIfVersionInfoApi = false
      CryIfDevErrorDetect = true
      CryIfMaxNumberOfKeyElements = 10
      CryIfMaxSizeOfKeyElement = 32
      CryIfRedirection = false
      CryIfSafeBswChecks = false

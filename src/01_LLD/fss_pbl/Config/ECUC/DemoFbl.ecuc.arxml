AUTOSAR XML (schema 00048)
package /ActiveEcuC
  ecuc value collection ActiveEcuC
    ecuc-values:
      CanIf
      vSet
      Can
      CanTp
      Det
      MemMap
      Os
      vLinkGen
      FblBm
      FblHal
      Fbl
      FblBmHdr
      Csm
      vSecPrim
      Crypto
      CryIf
      vBaseEnv
      Fls
      McalLib
      vBRS
      ResourceM
      Dem
      Smh
      Irq
      Xcp
      CanTrcv
      Dio
      Dcm
      EcuM
      EcuC
      PduR
      Port
      Fee
      NvM
      WrapNv
      Mcu
      Spi
      vMemAccM
      vMem
      vOtaM

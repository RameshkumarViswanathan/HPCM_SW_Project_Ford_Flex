AUTOSAR XML (schema 00048)
package /ActiveEcuC
  module config CanTp: implementation-config-variant=VARIANT-PRE-COMPILE, module-description=CanTp_Impl
    CanTpGeneral:
      CanTpVersionInfoApi = false
      CanTpSupportExtendedAddressing = false
      CanTpSupportMixed11Addressing = false
      CanTpSupportStandardAddressing = true
      CanTpChangeParameterApi = true
      CanTpDevErrorDetect = true
      CanTpPaddingByte = 204
      CanTpReadParameterApi = true
      CanTpPaddingActive = false
      CanTpHavePaddingByte = false
      CanTpNumRxChannels = 0
      CanTpNumTxChannels = 0
      CanTpEnableSplitMainFunction = false
      CanTpSupportMixed29Addressing = true
      CanTpSupportNormalFixedAddressing = true
      CanTpSupportCustomAddressing = false
      CanTpOnlyNotifyInformedAppl = true
      CanTpRc = false
      CanTpTc = false
      CanTpSafeBswChecks = false
      CanTpEnableSynchronousTransmit = true
      CanTpUseOnlyFirstFc = true
      CanTpFlexibleDataRateSupport = true
      CanTpSupportLongFirstFrames = true
      CanTpDynamicChannelAssignment = false
    CanTpConfig: CanTpMainFunctionPeriod=0.005
      4 x CanTpChannel, all with CanTpChannelMode=CANTP_MODE_FULL_DUPLEX:
        TPCH_1059bc7c
          CanTpTxNSdu_0468c0cb (CanTpTxNSdu):
            CanTpTxAddressingFormat = CANTP_STANDARD
            CanTpTxDl = 8
            CanTpTxTaType = CANTP_PHYSICAL
            CanTpNas = 0.1
            CanTpNcs = 0.2
            CanTpTc = false
            CanTpTxNSduId = 0
            CanTpTxPaddingActivation = CANTP_OFF
            CanTpNbs = 0.5
            CanTpTxNSduRef = Demo_0_CAN_FD_Response_oDemoFBL_Vector_SLP3_20_50875972_Tx
            CanTpTxNPdu_fd979da3 (CanTpTxNPdu): CanTpTxNPduConfirmationPduId=0, CanTpTxNPduRef=Demo_0_CAN_FD_Response_Tp_oDemoFBL_Vector_SLP3_20_ee1db9f7_Tx
            CanTpRxFcNPdu_fd979da3 (CanTpRxFcNPdu): CanTpRxFcNPduId=0, CanTpRxFcNPduRef=Demo_0_CAN_FD_Request_Tp_oDemoFBL_Vector_SLP3_20_f2ebe614_Rx
          CanTpRxNSdu_0468c0cb (CanTpRxNSdu):
            CanTpRxAddressingFormat = CANTP_STANDARD
            CanTpRxDl = 8
            CanTpRxTaType = CANTP_PHYSICAL
            CanTpNbr = 0.1
            CanTpRxNSduId = 1
            CanTpRxPaddingActivation = CANTP_OFF
            CanTpBs = 0
            CanTpNar = 0.1
            CanTpNcr = 0.5
            CanTpRxWftMax = 15
            CanTpSTmin = 0
            CanTpRxNSduRef = Demo_0_CAN_FD_Request_oDemoFBL_Vector_SLP3_20_dc7615a6_Rx
            CanTpTxFcNPdu_df6d4951 (CanTpTxFcNPdu): CanTpTxFcNPduConfirmationPduId=0, CanTpTxFcNPduRef=Demo_0_CAN_FD_Response_Tp_oDemoFBL_Vector_SLP3_20_ee1db9f7_Tx
            CanTpRxNPdu_df6d4951 (CanTpRxNPdu): CanTpRxNPduId=0, CanTpRxNPduRef=Demo_0_CAN_FD_Request_Tp_oDemoFBL_Vector_SLP3_20_f2ebe614_Rx
        TPCH_35dcba18
          CanTpRxNSdu_08631fbd (CanTpRxNSdu):
            CanTpRxAddressingFormat = CANTP_STANDARD
            CanTpRxDl = 8
            CanTpRxTaType = CANTP_FUNCTIONAL
            CanTpNbr = 0.1
            CanTpRxNSduId = 0
            CanTpRxPaddingActivation = CANTP_OFF
            CanTpRxNSduRef = Functional_CAN_FD_oDemoFBL_Vector_SLP3_20_7403a32a_Rx
            CanTpRxNPdu_3cfeb570 (CanTpRxNPdu): CanTpRxNPduId=2, CanTpRxNPduRef=Functional_CAN_FD_Tp_oDemoFBL_Vector_SLP3_20_883488d5_Rx
        TPCH_b6ddd85e
          CanTpRxNSdu_259788c6 (CanTpRxNSdu):
            CanTpRxAddressingFormat = CANTP_STANDARD
            CanTpRxDl = 8
            CanTpRxTaType = CANTP_PHYSICAL
            CanTpNbr = 0.1
            CanTpRxNSduId = 3
            CanTpRxPaddingActivation = CANTP_OFF
            CanTpBs = 0
            CanTpNar = 0.1
            CanTpNcr = 0.5
            CanTpRxWftMax = 15
            CanTpSTmin = 0
            CanTpRxNSduRef = Demo_1_CAN_Request_oDemoFBL_Vector_SLP3_ALPINE_RIGHT_35492789_Rx
            CanTpRxNPdu_258635e4 (CanTpRxNPdu): CanTpRxNPduId=1, CanTpRxNPduRef=Demo_1_CAN_Request_Tp_oDemoFBL_Vector_SLP3_ALPINE_RIGHT_8bdd5adc_Rx
            CanTpTxFcNPdu_258635e4 (CanTpTxFcNPdu): CanTpTxFcNPduConfirmationPduId=1, CanTpTxFcNPduRef=Demo_1_CAN_Response_Tp_oDemoFBL_Vector_SLP3_ALPINE_RIGHT_54cb25de_Tx
          CanTpTxNSdu_259788c6 (CanTpTxNSdu):
            CanTpTxAddressingFormat = CANTP_STANDARD
            CanTpTxDl = 8
            CanTpTxTaType = CANTP_PHYSICAL
            CanTpNas = 0.1
            CanTpNcs = 0.2
            CanTpTc = false
            CanTpTxNSduId = 1
            CanTpTxPaddingActivation = CANTP_OFF
            CanTpNbs = 0.5
            CanTpTxNSduRef = Demo_1_CAN_Response_oDemoFBL_Vector_SLP3_ALPINE_RIGHT_dc6539a8_Tx
            CanTpTxNPdu_077ce116 (CanTpTxNPdu): CanTpTxNPduConfirmationPduId=1, CanTpTxNPduRef=Demo_1_CAN_Response_Tp_oDemoFBL_Vector_SLP3_ALPINE_RIGHT_54cb25de_Tx
            CanTpRxFcNPdu_077ce116 (CanTpRxFcNPdu): CanTpRxFcNPduId=1, CanTpRxFcNPduRef=Demo_1_CAN_Request_Tp_oDemoFBL_Vector_SLP3_ALPINE_RIGHT_8bdd5adc_Rx
        TPCH_3728257e
          CanTpRxNSdu_e9d018a5 (CanTpRxNSdu):
            CanTpRxAddressingFormat = CANTP_STANDARD
            CanTpRxDl = 8
            CanTpRxTaType = CANTP_FUNCTIONAL
            CanTpNbr = 0.1
            CanTpRxNSduId = 2
            CanTpRxPaddingActivation = CANTP_OFF
            CanTpRxNSduRef = Functional_CAN_oDemoFBL_Vector_SLP3_ALPINE_RIGHT_65e7e1e5_Rx
            CanTpRxNPdu_f5eb978f (CanTpRxNPdu): CanTpRxNPduId=3, CanTpRxNPduRef=Functional_CAN_Tp_oDemoFBL_Vector_SLP3_ALPINE_RIGHT_66de96ef_Rx

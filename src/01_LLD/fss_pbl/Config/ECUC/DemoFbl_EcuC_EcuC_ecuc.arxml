AUTOSAR XML (schema 00048)
package /ActiveEcuC
  module config EcuC: implementation-config-variant=VARIANT-PRE-COMPILE, module-description=EcuC_Impl
    EcucPduCollection: PduIdTypeEnum=UINT8, PduLengthTypeEnum=UINT16
      24 x Pdu, all with J1939Requestable=false:
        Demo_0_XCP_CAN_Response_oDemoFBL_Vector_SLP3_3d0163c6_Tx: DynamicLength=false, PduLength=8, SysTPduToFrameMappingRef=Demo_0_XCP_CAN_Response
        Functional_CAN_FD_oDemoFBL_Vector_SLP3_20_7403a32a_Rx: DynamicLength=true, PduLength=7
        Demo_0_CAN_FD_Request_Tp_oDemoFBL_Vector_SLP3_20_f2ebe614_Rx: DynamicLength=false, PduLength=8, SysTPduToFrameMappingRef=Demo_0_CAN_FD_Request_Tp
        Functional_CAN_FD_oDemoFBL_Vector_SLP3_20_57859879_Rx: DynamicLength=true, PduLength=7
        Demo_0_XCP_CAN_Request_oDemoFBL_Vector_SLP3_64ae11cc_Rx: DynamicLength=false, PduLength=8, SysTPduToFrameMappingRef=Demo_0_XCP_CAN_Request
        Demo_0_XCP_CAN_Response_oDemoFBL_Vector_SLP3_26e8a530_Tx: DynamicLength=false, PduLength=8
        Demo_0_CAN_FD_Request_oDemoFBL_Vector_SLP3_20_dc7615a6_Rx: DynamicLength=true, PduLength=8
        Demo_0_CAN_FD_Response_oDemoFBL_Vector_SLP3_20_50875972_Tx: DynamicLength=true, PduLength=8
        Demo_0_CAN_FD_Response_Tp_oDemoFBL_Vector_SLP3_20_ee1db9f7_Tx: DynamicLength=false, PduLength=8, SysTPduToFrameMappingRef=Demo_0_CAN_FD_Response_Tp
        Functional_CAN_FD_Tp_oDemoFBL_Vector_SLP3_20_883488d5_Rx: DynamicLength=false, PduLength=8, SysTPduToFrameMappingRef=Functional_CAN_FD_Tp
        Demo_0_CAN_FD_Request_oDemoFBL_Vector_SLP3_20_797faa4e_Rx: DynamicLength=true, PduLength=8
        Demo_0_XCP_CAN_Request_oDemoFBL_Vector_SLP3_2e49a7b8_Rx: DynamicLength=false, PduLength=8
        Demo_0_CAN_FD_Response_oDemoFBL_Vector_SLP3_20_fac2fc54_Tx: DynamicLength=true, PduLength=8
        Functional_CAN_oDemoFBL_Vector_SLP3_ALPINE_RIGHT_13a7a6c8_Rx: DynamicLength=true, PduLength=7
        Demo_1_CAN_Response_Tp_oDemoFBL_Vector_SLP3_ALPINE_RIGHT_54cb25de_Tx: DynamicLength=false, PduLength=8, SysTPduToFrameMappingRef=Demo_1_CAN_Response_Tp
        Demo_1_CAN_Request_oDemoFBL_Vector_SLP3_ALPINE_RIGHT_f486132d_Rx: DynamicLength=true, PduLength=8
        Functional_CAN_Tp_oDemoFBL_Vector_SLP3_ALPINE_RIGHT_66de96ef_Rx: DynamicLength=false, PduLength=8, SysTPduToFrameMappingRef=Functional_CAN_Tp
        Demo_1_CAN_Response_oDemoFBL_Vector_SLP3_ALPINE_RIGHT_dc6539a8_Tx: DynamicLength=true, PduLength=8
        Demo_1_CAN_Request_oDemoFBL_Vector_SLP3_ALPINE_RIGHT_35492789_Rx: DynamicLength=true, PduLength=8
        Demo_1_CAN_Response_oDemoFBL_Vector_SLP3_ALPINE_RIGHT_93bb36bb_Tx: DynamicLength=true, PduLength=8
        Demo_1_CAN_Request_Tp_oDemoFBL_Vector_SLP3_ALPINE_RIGHT_8bdd5adc_Rx: DynamicLength=false, PduLength=8, SysTPduToFrameMappingRef=Demo_1_CAN_Request_Tp
        Functional_CAN_oDemoFBL_Vector_SLP3_ALPINE_RIGHT_65e7e1e5_Rx: DynamicLength=true, PduLength=7
        XCP_ALPINE_RIGHT_Rx: PduLength=8
        XCP_ALPINE_RIGHT_Tx: PduLength=8
    EcucGeneral:
      CPUType = CPU32Bit
      SizeOfInt = Size32Bit
      ByteOrder = LITTLE_ENDIAN
      BitOrder = LSB_to_MSB
      AtomicBitAccessInBitfield = false
      AtomicVariableAccess = Atomic32BitAccess
      SizeOfEnum = Size32Bit
      SizeOfROMPointer = Size32Bit
      SizeOfRAMPointer = Size32Bit
      BitFieldDataType = INT
      StructAlignment = Auto
      ArrayAlignment = Align8Bit
      StructInArrayAlignment = Auto
      DummyFunction = false
      EcuCSafeBswChecks = false
      DummyStatement = true
      DummyStatementKind = None
      ConditionalGenerating = true
      EcucBswImplementationCodeType = EcuCSourceCode
      EcuCUseStdReturnTypeForRte = false
      PostbuildLoadable: AlignmentFillPattern=255, PBROMStartAddress=0, PBRAMStartAddress=0, PBROMEndAddress=0, PBRAMEndAddress=0
      BswInitialization
        39 x InitFunction:
          Can_InitMemory: Header=Can.h, InitPhase=INIT_MEMORY, ModuleRef=Can  # /ActiveEcuC/Can PLAIN_TEXT InitMemory function description of Can in UnfilteredViewInInvariantProject (UnfilteredInvariantProjectModelView) .
          Can_Init: Header=Can.h, InitPhase=INIT_TWO_DRV, ConfigType=Can_ConfigType, ConfigPtrName=Can_Config_Ptr, ConfigPtrClass=CAN_INIT_DATA, ModuleRef=Can  # /ActiveEcuC/Can PLAIN_TEXT Init function description of Can in UnfilteredViewInInvariantProject (UnfilteredInvariantProjectModelView) .
          CanIf_Init: Header=CanIf.h, InitPhase=INIT_TWO_IF, ConfigType=CanIf_ConfigType, ConfigPtrName=CanIf_Config_Ptr, ConfigPtrClass=CANIF_INIT_DATA, ModuleRef=CanIf  # /ActiveEcuC/CanIf PLAIN_TEXT Init function description of CanIf in UnfilteredViewInInvariantProject (UnfilteredInvariantProjectModelView) .
          CanIf_InitMemory: Header=CanIf.h, InitPhase=INIT_MEMORY, ModuleRef=CanIf  # /ActiveEcuC/CanIf PLAIN_TEXT InitMemory function description of CanIf in UnfilteredViewInInvariantProject (UnfilteredInvariantProjectModelView) .
          CanTp_Init: Header=CanTp.h, InitPhase=INIT_TWO_TP, ConfigType=CanTp_ConfigType, ConfigPtrName=CanTp_Config_Ptr, ConfigPtrClass=CANTP_INIT_DATA, ModuleRef=CanTp  # /ActiveEcuC/CanTp PLAIN_TEXT Init function description of CanTp in UnfilteredViewInInvariantProject (UnfilteredInvariantProjectModelView) .
          CanTp_InitMemory: Header=CanTp.h, InitPhase=INIT_MEMORY, ModuleRef=CanTp  # /ActiveEcuC/CanTp PLAIN_TEXT InitMemory function description of CanTp in UnfilteredViewInInvariantProject (UnfilteredInvariantProjectModelView) .
          FblCw_InitMemory: Header=fbl_inc.h, InitPhase=INIT_MEMORY, ModuleRef=Dcm  # /ActiveEcuC/Dcm PLAIN_TEXT InitMemory function description of FblCw in UnfilteredViewInInvariantProject (UnfilteredInvariantProjectModelView) .
          FblCw_Init: Header=fbl_inc.h, InitPhase=INIT_THREE, ConfigType=FblCw_ConfigType, ConfigPtrName=FblCw_Config_Ptr, ConfigPtrClass=FBLCW_INIT_DATA, ModuleRef=Dcm  # /ActiveEcuC/Dcm PLAIN_TEXT Init function description of FblCw in UnfilteredViewInInvariantProject (UnfilteredInvariantProjectModelView) .
          Det_Init: Header=Det.h, InitPhase=INIT_ZERO, ConfigType=Det_ConfigType, ConfigPtrName=Det_Config_Ptr, ConfigPtrClass=DET_INIT_DATA, ModuleRef=Det  # /ActiveEcuC/Det PLAIN_TEXT Init function description of Det in UnfilteredViewInInvariantProject (UnfilteredInvariantProjectModelView) .
          Det_InitMemory: Header=Det.h, InitPhase=INIT_MEMORY, ModuleRef=Det  # /ActiveEcuC/Det PLAIN_TEXT InitMemory function description of Det in UnfilteredViewInInvariantProject (UnfilteredInvariantProjectModelView) .
          PduR_Init: Header=PduR.h, InitPhase=INIT_TWO_COM, ConfigType=PduR_PBConfigType, ConfigPtrName=PduR_Config_Ptr, ConfigPtrClass=PDUR_INIT_DATA, ModuleRef=PduR  # /ActiveEcuC/PduR PLAIN_TEXT Init function description of PduR in UnfilteredViewInInvariantProject (UnfilteredInvariantProjectModelView) .
          PduR_InitMemory: Header=PduR.h, InitPhase=INIT_MEMORY, ModuleRef=PduR  # /ActiveEcuC/PduR PLAIN_TEXT InitMemory function description of PduR in UnfilteredViewInInvariantProject (UnfilteredInvariantProjectModelView) .
          PduR_PreInit: Header=PduR.h, InitPhase=INIT_ONE, ConfigType=PduR_PBConfigType, ConfigPtrName=PduR_Config_Ptr, ConfigPtrClass=PDUR_INIT_DATA, ModuleRef=PduR  # /ActiveEcuC/PduR PLAIN_TEXT PreInit function description of PduR in UnfilteredViewInInvariantProject (UnfilteredInvariantProjectModelView) .
          Brs_Init: Header=, InitPhase=NO_INIT, ModuleRef=vBRS  # /ActiveEcuC/vBRS PLAIN_TEXT Automatically generated by EcuCBswInitFctConfigurationService.
          vBaseEnv_Init: Header=, InitPhase=NO_INIT, ModuleRef=vBaseEnv  # /ActiveEcuC/vBaseEnv PLAIN_TEXT Created vBaseEnv_Init by Extended Init XML Service
          Xcp_Init: Header=Xcp.h, InitPhase=INIT_TWO_TP, ModuleRef=Xcp  # /ActiveEcuC/Xcp PLAIN_TEXT Module Initialization function of module Xcp.
          Xcp_InitMemory: Header=Xcp.h, InitPhase=INIT_MEMORY, ModuleRef=Xcp  # /ActiveEcuC/Xcp PLAIN_TEXT Memory Initialization function of module Xcp.
          vLinkGen_Init: Header=vLinkGen_Lcfg.h, InitPhase=NO_INIT, ModuleRef=vLinkGen  # /ActiveEcuC/vLinkGen PLAIN_TEXT Dummy initialization of the vLinkGen
          CryIf_Init: Header=CryIf.h, InitPhase=INIT_TWO_IF, ModuleRef=CryIf  # /ActiveEcuC/CryIf PLAIN_TEXT Initializes the Crypto Interface
          CryIf_InitMemory: Header=CryIf.h, InitPhase=INIT_MEMORY, ModuleRef=CryIf  # /ActiveEcuC/CryIf PLAIN_TEXT Initializes variables of the Crypto Interface
          Crypto_30_LibCv_Init: Header=Crypto_30_LibCv.h, InitPhase=INIT_TWO_DRV, ModuleRef=Crypto  # /ActiveEcuC/Crypto PLAIN_TEXT Initializes the Crypto Driver
          Crypto_30_LibCv_InitMemory: Header=Crypto_30_LibCv.h, InitPhase=INIT_MEMORY, ModuleRef=Crypto  # /ActiveEcuC/Crypto PLAIN_TEXT Initializes variables of the Crypto Driver
          Csm_Init: Header=Csm.h, InitPhase=INIT_TWO_SYS, ModuleRef=Csm  # /ActiveEcuC/Csm PLAIN_TEXT Initializes the Crypto Service Manager
          Csm_InitMemory: Header=Csm.h, InitPhase=INIT_MEMORY, ModuleRef=Csm  # /ActiveEcuC/Csm PLAIN_TEXT Initializes variables of the Crypto Service Manager
          Dio_Init: Header=Dio.h, InitPhase=NO_INIT, ModuleRef=Dio  # /Dio/Dio PLAIN_TEXT Created Dio_Init by Extended Init XML Service
          McalLib_Init: Header=McalLib.h, InitPhase=NO_INIT, ModuleRef=McalLib  # /ActiveEcuC/McalLib PLAIN_TEXT Created McalLib_Init by Extended Init XML Service
          Port_Init: Header=Port.h, InitPhase=INIT_ONE_EARLY, ConfigType=Port_ConfigType, ConfigPtrName=&Port_Config, ConfigPtrClass=AUTOMATIC, ModuleRef=Port  # /Port/Port PLAIN_TEXT Created Port_Init by Extended Init XML Service
          Fee_Init: Header=Fee.h, InitPhase=INIT_ONE_LATE, ConfigType=Fee_ConfigType, ConfigPtrName=&Fee_Config, ConfigPtrClass=AUTOMATIC, ModuleRef=Fee  # /ActiveEcuC/Fee PLAIN_TEXT Created Fee_Init by Extended Init XML Service
          Fls_17_Dmu_Init: Header=Fls_17_Dmu.h, InitPhase=INIT_ONE, ConfigType=Fls_17_Dmu_ConfigType, ConfigPtrName=&Fls_17_Dmu_Config, ConfigPtrClass=AUTOMATIC, ModuleRef=Fls  # /ActiveEcuC/Fls PLAIN_TEXT Created Fls_17_Dmu_Init by Extended Init XML Service
          Mcu_Init: Header=Mcu.h, InitPhase=INIT_ONE_EARLY, ConfigType=Mcu_ConfigType, ConfigPtrName=&Mcu_Config, ConfigPtrClass=AUTOMATIC, AdditionalInitCode=Mcu_InitClock(0);while (MCU_PLL_LOCKED != Mcu_GetPllStatus());Mcu_DistributePllClock();, ModuleRef=Mcu  # /Mcu/Mcu PLAIN_TEXT Created Mcu_Init by Extended Init XML Service
          Irq_Init: Header=Irq.h, InitPhase=NO_INIT, ModuleRef=Irq  # /ActiveEcuC/Irq PLAIN_TEXT Created Irq_Init by Extended Init XML Service
          CanTrcv_30_Tja1043_Init: Header=CanTrcv_30_Tja1043.h, InitPhase=INIT_TWO_TRCV, ConfigType=CanTrcv_30_Tja1043_ConfigType, ConfigPtrName=CanTrcv_30_Tja1043_Config_Ptr, ConfigPtrClass=CANTRCV_30_TJA1043_INIT_DATA, ModuleRef=CanTrcv  # /ActiveEcuC/CanTrcv PLAIN_TEXT Init function description of CanTrcv_30_Tja1043 in UnfilteredViewInInvariantProject (UnfilteredInvariantProjectModelView) .
          CanTrcv_30_Tja1043_InitMemory: Header=CanTrcv_30_Tja1043.h, InitPhase=INIT_MEMORY, ModuleRef=CanTrcv  # /ActiveEcuC/CanTrcv PLAIN_TEXT InitMemory function description of CanTrcv_30_Tja1043 in UnfilteredViewInInvariantProject (UnfilteredInvariantProjectModelView) .
          WrapNv_Init: Header=WrapNv.h, InitPhase=INIT_TWO_SYS, ModuleRef=WrapNv  # /ActiveEcuC/WrapNv PLAIN_TEXT WrapNv_Init function description
          vMemAccM_InitMemory: Header=vMemAccM.h, InitPhase=INIT_MEMORY, ModuleRef=vMemAccM  # /ActiveEcuC/vMemAccM PLAIN_TEXT Initializes all *_INIT_* section variables within the vMemAccM.
          vMemAccM_Init: Header=vMemAccM.h, InitPhase=INIT_TWO_DRV, ModuleRef=vMemAccM  # /ActiveEcuC/vMemAccM PLAIN_TEXT Initializes the vMemAccM.
          CanXcp_InitMemory: Header=CanXcp.h, InitPhase=INIT_MEMORY, ModuleRef=Xcp  # /ActiveEcuC/Xcp PLAIN_TEXT Memory Initialization function of module CanXcp.
          CanXcp_Init: Header=CanXcp.h, InitPhase=INIT_TWO_TP, ConfigType=CanXcp_ConfigType, ConfigPtrName=NULL_PTR, ConfigPtrClass=CANXCP_CONST, ModuleRef=Xcp  # /ActiveEcuC/Xcp PLAIN_TEXT Module Initialization function of module CanXcp.
          Spi_Init: Header=Spi.h, InitPhase=INIT_ONE, ConfigType=Spi_ConfigType, ConfigPtrName=&Spi_Config, ConfigPtrClass=AUTOMATIC, ModuleRef=Spi  # /Spi/Spi PLAIN_TEXT Created Spi_Init by Extended Init XML Service

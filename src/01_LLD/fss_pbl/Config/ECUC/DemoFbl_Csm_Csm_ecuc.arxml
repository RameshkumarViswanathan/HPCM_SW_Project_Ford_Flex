AUTOSAR XML (schema 00048)
package /ActiveEcuC
  module config Csm: implementation-config-variant=VARIANT-PRE-COMPILE, module-description=Csm_Impl
    CsmGeneral:
      CsmCustomIncludeFiles = Crypto_30_LibCv_Custom.h
      CsmVersionInfoApi = false
      CsmUseDeprecated = false
      CsmAsymPrivateKeyMaxLength = 32
      CsmAsymPublicKeyMaxLength = 1024
      CsmDevErrorDetect = true
      CsmMainFunctionPeriod = 0.01
      CsmSymKeyMaxLength = 16
      CsmCallbackStartNotification = false
      CsmCancelationDuringProcessing = false
      CsmSafeBswChecks = false
      CsmJobTypeLayout:
        CsmJobTypeLayoutVarMembers = true
        CsmJobTypeLayoutRedirectionInfoRef = false
        CsmJobTypeLayoutAsr430Compatibility = true
        CsmJobTypeLayoutInput64 = false
        CsmJobTypeLayoutOutput64Ptr = false
    CsmJobs
      6 x CsmJob, all with CsmJobPriority=0, CsmProcessingMode=CRYPTO_PROCESSING_SYNC, CsmJobInterfaceUsePort=CRYPTO_USE_FNC, CsmJobUsePort=false:
        CsmJob_DecryptionAes128NoneCbc: CsmJobId=0, CsmJobKeyRef=CsmKey_Fbl_Aes128, CsmJobPrimitiveRef=Csm/CsmPrimitives_Dec_Aes128NoneCbc, CsmJobQueueRef=CsmQueue_Aes
        CsmJob_SigAsymVer_RsaPssSha256: CsmJobId=2, CsmJobKeyRef=CsmKey_Fbl_Signature_Rsa2048, CsmJobPrimitiveRef=Csm/CsmPrimitives_SigAsymVer_RsaPssSha256, CsmJobQueueRef=CsmQueue_Standard
        CsmJob_SigAsymVer_RsaV15Sha256: CsmJobId=3, CsmJobKeyRef=CsmKey_Fbl_Signature_Rsa2048, CsmJobPrimitiveRef=Csm/CsmPrimitives_SigAsymVer_RsaV15Sha256, CsmJobQueueRef=CsmQueue_Standard
        CsmJob_EncryptionAes128NoneCbc: CsmJobId=1, CsmJobKeyRef=CsmKey_Fbl_Aes128, CsmJobPrimitiveRef=Csm/CsmPrimitives_Enc_Aes128NoneCbc, CsmJobQueueRef=CsmQueue_Aes
        CsmJob_Sha1: CsmJobId=4, CsmJobKeyRef=CsmKey_CryptoKey, CsmJobQueueRef=CsmQueue_Standard, CsmJobPrimitiveRef=Csm/CsmPrimitives_Sha1
        CsmJob_EncryptionRsaSha256Oaep: CsmJobId=5, CsmJobPrimitiveRef=Csm/CsmPrimitives_Enc_RsaSha256Oaep, CsmJobKeyRef=CsmKey_Fbl_Signature_Rsa2048, CsmJobQueueRef=CsmQueue_Standard
    CsmKeys
      4 x CsmKey, all with CsmKeyUsePort=false:
        CsmKey_Fbl_Aes128: CsmKeyId=1, CsmKeyRef=CryIfKey_Fbl_Aes128
        CsmKey_Fbl_Signature_Rsa2048: CsmKeyId=2, CsmKeyRef=CryIfKey_Fbl_Signature_Rsa2048
        CsmKey_Fbl_Signature_Rsa3072: CsmKeyId=3, CsmKeyRef=CryIfKey_Fbl_Signature_Rsa3072
        CsmKey_CryptoKey: CsmKeyId=0, CsmKeyRef=CryIfKey_CryptoKey
    CsmQueues
      CsmQueue_Standard (CsmQueue): CsmQueueSize=1, CsmTriggerAsynchJobsInCallback=false, CsmJobSharing=true, CsmChannelRef=CryIfChannel_CryptoCv_Fbl_Signature
      CsmQueue_Aes (CsmQueue): CsmQueueSize=1, CsmTriggerAsynchJobsInCallback=false, CsmJobSharing=true, CsmChannelRef=CryIfChannel_CryptoCv_Fbl_Aes
    6 x CsmPrimitives:
      CsmPrimitives_Dec_Aes128NoneCbc
        CsmDecrypt
          CsmPrimitives_Dec_Aes128NoneCbc (CsmDecryptConfig):
            CsmDecryptAlgorithmMode = CRYPTO_ALGOMODE_CBC
            CsmDecryptAlgorithmSecondaryFamily = CRYPTO_ALGOFAM_CUSTOM
            CsmDecryptAlgorithmSecondaryFamilyCustom = CRYPTO_ALGOFAM_CUSTOM_PADDING_PKCS7
            CsmDecryptProcessing = CSM_SYNCHRONOUS
            CsmDecryptAlgorithmFamily = CRYPTO_ALGOFAM_AES
            CsmDecryptAlgorithmFamiliy = CRYPTO_ALGOFAM_AES
            CsmDecryptAlgorithmKeyLength = 16
      CsmPrimitives_SigAsymVer_RsaPssSha256
        CsmSignatureVerify
          CsmPrimitives_SigAsymVer_RsaPssSha256 (CsmSignatureVerifyConfig):
            CsmSignatureVerifyAlgorithmFamily = CRYPTO_ALGOFAM_RSA
            CsmSignatureVerifyAlgorithmMode = CRYPTO_ALGOMODE_RSASSA_PSS
            CsmSignatureVerifyAlgorithmSecondaryFamily = CRYPTO_ALGOFAM_SHA2_256
            CsmSignatureVerifyKeyLength = 32
            CsmSignatureVerifyProcessing = CSM_SYNCHRONOUS
            CsmSignatureVerifyCompareLength = 32
            CsmSignatureVerifyAlgorithmFamiliy = CRYPTO_ALGOFAM_RSA
      CsmPrimitives_SigAsymVer_RsaV15Sha256
        CsmSignatureVerify
          CsmPrimitives_SigAsymVer_RsaV15Sha256 (CsmSignatureVerifyConfig):
            CsmSignatureVerifyAlgorithmFamily = CRYPTO_ALGOFAM_RSA
            CsmSignatureVerifyAlgorithmFamiliy = CRYPTO_ALGOFAM_RSA
            CsmSignatureVerifyAlgorithmMode = CRYPTO_ALGOMODE_RSASSA_PKCS1_v1_5
            CsmSignatureVerifyAlgorithmSecondaryFamily = CRYPTO_ALGOFAM_SHA2_256
            CsmSignatureVerifyKeyLength = 32
            CsmSignatureVerifyProcessing = CSM_SYNCHRONOUS
            CsmSignatureVerifyCompareLength = 32
      CsmPrimitives_Enc_Aes128NoneCbc
        CsmEncrypt
          CsmPrimitives_Enc_Aes128NoneCbc (CsmEncryptConfig):
            CsmEncryptAlgorithmMode = CRYPTO_ALGOMODE_CBC
            CsmEncryptAlgorithmSecondaryFamily = CRYPTO_ALGOFAM_CUSTOM
            CsmEncryptAlgorithmSecondaryFamilyCustom = CRYPTO_ALGOFAM_CUSTOM_PADDING_PKCS7
            CsmEncryptProcessing = CSM_SYNCHRONOUS
            CsmEncryptAlgorithmFamily = CRYPTO_ALGOFAM_AES
            CsmEncryptAlgorithmFamiliy = CRYPTO_ALGOFAM_AES
            CsmEncryptAlgorithmKeyLength = 16
      CsmPrimitives_Sha1
        CsmPrimitives_Sha1 (CsmHash)
          CsmPrimitives_Sha1 (CsmHashConfig):
            CsmHashAlgorithmFamiliy = CRYPTO_ALGOFAM_SHA1
            CsmHashAlgorithmFamily = CRYPTO_ALGOFAM_SHA1
            CsmHashProcessing = CSM_SYNCHRONOUS
            CsmHashResultLength = 1
            CsmHashAlgorithmMode = CRYPTO_ALGOMODE_NOT_SET
            CsmHashAlgorithmSecondaryFamily = CRYPTO_ALGOFAM_NOT_SET
      CsmPrimitives_Enc_RsaSha256Oaep
        CsmEncrypt
          CsmPrimitives_Enc_RsaSha256Oaep (CsmEncryptConfig):
            CsmEncryptAlgorithmMode = CRYPTO_ALGOMODE_RSAES_OAEP
            CsmEncryptAlgorithmSecondaryFamily = CRYPTO_ALGOFAM_SHA2_256
            CsmEncryptProcessing = CSM_SYNCHRONOUS
            CsmEncryptAlgorithmFamily = CRYPTO_ALGOFAM_RSA
            CsmEncryptAlgorithmFamiliy = CRYPTO_ALGOFAM_RSA
            CsmEncryptAlgorithmKeyLength = 16

AUTOSAR XML (schema 00048)
package /ActiveEcuC
  module config Fbl: implementation-config-variant=VARIANT-LINK-TIME, module-description=Fbl_Impl
    FblFlashBlockTable
      32 x FblFlashBlock, all with FblFbMemoryDeviceRef=Flash:
        FblFlashBlock_0: FblFbStartAddress=2147876864, FblFbEndAddress=2148270079, FblFbDescription=PF0 PS0: 384KB Block0 (Bootloader), FblFbLogicalBlockRef=FblLogicalBlock_FBL
        FblFlashBlock_1: FblFbStartAddress=2148270080, FblFbEndAddress=2148401151, FblFbDescription=PF0 PS0: 128KB Block1 (Application), FblFbLogicalBlockRef=FblLogicalBlock_ASW
        FblFlashBlock_3: FblFbStartAddress=2148532224, FblFbEndAddress=2148663295, FblFbDescription=PF0 PS2: 128KB Block3 (Application), FblFbLogicalBlockRef=FblLogicalBlock_ASW
        FblFlashBlock_5: FblFbStartAddress=2148794368, FblFbEndAddress=2148925439, FblFbDescription=PF0 PS4: 128KB Block5 (Application), FblFbLogicalBlockRef=FblLogicalBlock_ASW
        FblFlashBlock_7: FblFbStartAddress=2149056512, FblFbEndAddress=2149187583, FblFbDescription=PF0 PS6: 128KB Block7 (Application), FblFbLogicalBlockRef=FblLogicalBlock_ASW
        FblFlashBlock_9: FblFbStartAddress=2149318656, FblFbEndAddress=2149449727, FblFbDescription=PF0 PS8: 128KB Block9 (Application), FblFbLogicalBlockRef=FblLogicalBlock_ASW
        FblFlashBlock_11: FblFbStartAddress=2149580800, FblFbEndAddress=2149711871, FblFbDescription=PF0 PS10: 128KB Block11 (Application), FblFbLogicalBlockRef=FblLogicalBlock_ASW
        FblFlashBlock_13: FblFbStartAddress=2149842944, FblFbEndAddress=2149974015, FblFbDescription=PF0 PS12: 128KB Block13 (Application), FblFbLogicalBlockRef=FblLogicalBlock_ASW
        FblFlashBlock_2: FblFbStartAddress=2148401152, FblFbEndAddress=2148532223, FblFbDescription=PF0 PS1: 128KB Block2 (Application), FblFbLogicalBlockRef=FblLogicalBlock_ASW
        FblFlashBlock_4: FblFbStartAddress=2148663296, FblFbEndAddress=2148794367, FblFbDescription=PF0 PS3: 128KB Block4 (Application), FblFbLogicalBlockRef=FblLogicalBlock_ASW
        FblFlashBlock_6: FblFbStartAddress=2148925440, FblFbEndAddress=2149056511, FblFbDescription=PF0 PS5: 128KB Block6 (Application), FblFbLogicalBlockRef=FblLogicalBlock_ASW
        FblFlashBlock_8: FblFbStartAddress=2149187584, FblFbEndAddress=2149318655, FblFbDescription=PF0 PS7: 128KB Block8 (Application), FblFbLogicalBlockRef=FblLogicalBlock_ASW
        FblFlashBlock_10: FblFbStartAddress=2149449728, FblFbEndAddress=2149580799, FblFbDescription=PF0 PS9: 128KB Block10 (Application), FblFbLogicalBlockRef=FblLogicalBlock_ASW
        FblFlashBlock_12: FblFbStartAddress=2149711872, FblFbEndAddress=2149842943, FblFbDescription=PF0 PS11: 128KB Block12 (Application), FblFbLogicalBlockRef=FblLogicalBlock_ASW
        FblFlashBlock_14: FblFbStartAddress=2149974016, FblFbEndAddress=2150105087, FblFbDescription=PF0 PS13: 128KB Block14 (Application), FblFbLogicalBlockRef=FblLogicalBlock_ASW
        FblFlashBlock_15: FblFbStartAddress=2150105088, FblFbEndAddress=2150236159, FblFbDescription=PF0 PS14: 128KB Block15 (Application), FblFbLogicalBlockRef=FblLogicalBlock_ASW
        FblFlashBlock_16: FblFbStartAddress=2150236160, FblFbEndAddress=2150367231, FblFbDescription=PF0 PS15: 128KB Block16 (Application), FblFbLogicalBlockRef=FblLogicalBlock_ASW
        FblFlashBlock_17: FblFbStartAddress=2150367232, FblFbEndAddress=2150498303, FblFbDescription=PF0 PS16: 128KB Block17 (Application), FblFbLogicalBlockRef=FblLogicalBlock_ASW
        FblFlashBlock_18: FblFbStartAddress=2150498304, FblFbEndAddress=2150629375, FblFbDescription=PF0 PS17: 128KB Block18 (Application), FblFbLogicalBlockRef=FblLogicalBlock_ASW
        FblFlashBlock_19: FblFbStartAddress=2150629376, FblFbEndAddress=2150760447, FblFbDescription=PF1 PS0: 128KB Block19 (Application), FblFbLogicalBlockRef=FblLogicalBlock_ASW
        FblFlashBlock_20: FblFbStartAddress=2150760448, FblFbEndAddress=2150891519, FblFbDescription=PF1 PS1: 128KB Block20 (Application), FblFbLogicalBlockRef=FblLogicalBlock_ASW
        FblFlashBlock_21: FblFbStartAddress=2150891520, FblFbEndAddress=2151022591, FblFbDescription=PF1 PS2: 128KB Block21 (Application), FblFbLogicalBlockRef=FblLogicalBlock_ASW
        FblFlashBlock_22: FblFbStartAddress=2151022592, FblFbEndAddress=2151153663, FblFbDescription=PF1 PS3: 128KB Block22 (Application), FblFbLogicalBlockRef=FblLogicalBlock_ASW
        FblFlashBlock_23: FblFbStartAddress=2151153664, FblFbEndAddress=2151284735, FblFbDescription=PF1 PS4: 128KB Block23 (Application), FblFbLogicalBlockRef=FblLogicalBlock_ASW
        FblFlashBlock_24: FblFbStartAddress=2151284736, FblFbEndAddress=2151661567, FblFbDescription=PF1 PS0: 368KB Block24 (Calibration), FblFbLogicalBlockRef=FblLogicalBlock_CALIB
        FblFlashBlock_BM_A: FblFbStartAddress=2147745792, FblFbEndAddress=2147876863, FblFbDescription=PF0 PS0: 128KB Block0 (BootManager)
        FblFlashBlock_HwDataA: FblFbStartAddress=2151661568, FblFbEndAddress=2151661792, FblFbDescription=PF1 PS0: 234B Block24 (HwData)
        FblFlashBlock_BM_B: FblFbStartAddress=2154037248, FblFbEndAddress=2154168319, FblFbDescription=PF0 PS0: 128KB Block0 (BootManager)
        FblFlashBlock_Btl_B: FblFbStartAddress=2154168320, FblFbEndAddress=2154561535, FblFbDescription=PF0 PS0: 384KB Block0 (Bootloader)
        FblFlashBlock_Appl_B: FblFbStartAddress=2157445120, FblFbEndAddress=2157576191, FblFbDescription=PF1 PS4: 128KB Block23 (Application)
        FblFlashBlock_Cal_B: FblFbStartAddress=2157576192, FblFbEndAddress=2157953023, FblFbDescription=PF1 PS0: 368KB Block24 (Calibration)
        FblFlashBlock_HwDataB: FblFbStartAddress=2157953024, FblFbEndAddress=2157953248, FblFbDescription=PF1 PS0: 234B Block24 (HwData)
    FblGeneral:
      FblDataProcessingBufferSize = 4096
      FblDiagnosticBufferSize = 4095
      FblInternalMemoryCopy = true
      FblMaximumNumberOfSegments = 10
      FblP2Server = 50
      FblP2StarServer = 5000
      FblUnalignedDataTransfer = true
      FblWriteSegmentation = 4096
      FblApplicationStateTask = true
      FblApplicationTimerTask = true
      FblUserConfigFile = $(DpaProjectFolder)\Config_Right\user_config.cfg
      FblPipelinedVerification = false
      FblAdaptiveDataTransferRcrrp = false
      FblGatewaySupport = false
      FblInputVerification = false
      FblProcessedVerification = false
      FblS3ServerExtendedSession = 5000
      FblS3ServerProgrammingSession = 5000
      FblSuspendDriverOperation = false
      FblVerificationFunction = false
      FblCommonData = false
      FblPresencePattern = false
      FblFlashDriverUsage = DOWNLOAD_DRIVER
      FblResponseAfterReset = false
      FblSleepTime = 300000
      FblSleepMode = false
      FblStayInBoot = false
      FblVerificationSegmentation = 256
      FblOutputVerification = false
      FblGapFilling = false
      FblFillCode = 255
      FblProjectState = INTEGRATION
      FblHeaderAddress = 2148269824
      FblStartFunction = false
      FblUserSubfunction = true
      FblUserService = true
      FblUserRoutine = true
      FblWatchdogService = false
      FblWatchdogTriggerCycle = 1
      FblEncryptionMode = false
      FblCompressionMode = true
      FblPipelinedProgramming = true
      FblMaximumAmountOfLogicalBlocks = 8
      FblBlockStartAddress = 2147876864
      FblBlockLength = 393216
      FblOta = true
      FblOneStepUpdater = false
      FblHardwareSwap = true
    FblLogicalBlockTable
      3 x FblLogicalBlock, all with FblLbOutputVerification=SecM_Verification, FblLbPipelinedVerification=SecM_VerifySignature, FblLbInputVerification=V_NULL, FblLbProcessedVerification=V_NULL, FblLbDisposability=MANDATORY, FblLbMaxReprogAttempts=126, FblLbDescription=:
        FblLogicalBlock_FBL: FblLbBlockIndex=64768, FblLbStartAddress=2147876864, FblLbEndAddress=2148270079, FblLbBmHeaderAddress=2148269824
        FblLogicalBlock_ASW: FblLbBlockIndex=64769, FblLbStartAddress=2148270080, FblLbEndAddress=2151284735, FblLbBmHeaderAddress=2151284704
        FblLogicalBlock_CALIB: FblLbBlockIndex=64770, FblLbStartAddress=2151284736, FblLbEndAddress=2151661567, FblLbBmHeaderAddress=2151481340
    FblRenault:
      FblSystemInternalFailureDtc = false
      FblAccessDelayTime = 600000
      FblApplicationValidityFlag = false
      FblCheckProgrammingPreconditionsService = false
      FblBsAndStminSpecific = true
      FblCheckProgDepRoutine = true
      FblDtc06ForEachLogicalBlock = true
      FblSingleGlobal06Dtc = true
      FblSingleGlobal06DtcId = 65023
      FblEcuResetInDefault = true
      FblRoutineControlInDefault = false
    FblMemoryDeviceTable
      Flash (FblMemoryDevice):
        FblMdSegmentSize = 32
        FblMdErasedValue = 0
        FblMdIndex = 0
        FblMdInitHook = false
        FblMdDeinitHook = false
        FblMdReadHook = false
        FblMdEraseHook = false
        FblMdWriteHook = false
        FblMdVerifyHook = false

AUTOSAR XML (schema 00048)
package /ActiveEcuC
  module config Dcm: implementation-config-variant=VARIANT-PRE-COMPILE, module-description=Dcm_Impl
    DcmConfigSet
      DcmGeneral:
        DcmRespondAllRequest = true
        DcmVersionInfoApi = false
        DcmBaudrateSwitch = false
        DcmKeySlotMode = false
        DcmNwStatusRxBufferSize = 0
        DcmQueuedRequest = false
        DcmTaskTime = 0
        DcmCanHardwareLoopTimeout = 100
        DcmTaskCycle = 5
        DcmDevErrorDetect = true
        DcmBswInitializationFilter = Dcm
        DcmBswInitializationFilter = Fee
        DcmBswInitializationFilter = Fls
        DcmBswInitializationFilter = Ea
        DcmBswInitializationFilter = Eep
        DcmBswInitializationFilter = Gpt
        DcmBswInitializationFilter = Mcu
        DcmBswInitializationFilter = Port
        DcmBswInitializationFilter = Dio
      DcmDsp
        DcmDspSession
          DcmDspSessionRow: DcmDspSessionLevel=0, DcmDspSessionP2ServerMax=0, DcmDspSessionP2StarServerMax=0
      DcmDsl
        DcmDslBuffer: DcmDslBufferSize=8
        DcmDslDiagResp: DcmDslDiagRespMaxNumOfDeclinedRequests=3, DcmDslDiagRespOnSecondDeclinedRequest=false
        DcmDslProtocol
          DcmDslProtocolRow_29812fbf (DcmDslProtocolRow): DcmDslProtocolID=DCM_UDS_ON_CAN
            DcmDslConnection_64d54b0f (DcmDslConnection)
              DcmDslMainConnection: DcmDslProtocolRxTesterSourceAddr=0, DcmDslPayloadLimit=4095
                Demo_0_CAN_FD_Request_oDemoFBL_Vector_SLP3_20_797faa4e_Rx_26d06049 (DcmDslProtocolRx):
                  DcmDslProtocolRxAddrType = DCM_PHYSICAL_TYPE
                  DcmDslProtocolRxPduId = 0
                  DcmDslProtocolRxComMChannelRef = (unset)
                  DcmDslProtocolRxPduRef = Demo_0_CAN_FD_Request_oDemoFBL_Vector_SLP3_20_797faa4e_Rx
                Demo_0_CAN_FD_Response_oDemoFBL_Vector_SLP3_20_fac2fc54_Tx_7966a2bf (DcmDslProtocolTx): DcmDslTxConfirmationPduId=0, DcmDslProtocolTxPduRef=Demo_0_CAN_FD_Response_oDemoFBL_Vector_SLP3_20_fac2fc54_Tx
                Functional_CAN_FD_oDemoFBL_Vector_SLP3_20_57859879_Rx_0f27df12 (DcmDslProtocolRx):
                  DcmDslProtocolRxAddrType = DCM_FUNCTIONAL_TYPE
                  DcmDslProtocolRxPduId = 1
                  DcmDslProtocolRxComMChannelRef = (unset)
                  DcmDslProtocolRxPduRef = Functional_CAN_FD_oDemoFBL_Vector_SLP3_20_57859879_Rx
            DcmDslConnection_ab4f5c7d (DcmDslConnection)
              DcmDslMainConnection: DcmDslProtocolRxTesterSourceAddr=1, DcmDslPayloadLimit=4095
                Demo_1_CAN_Response_oDemoFBL_Vector_SLP3_ALPINE_RIGHT_93bb36bb_Tx_69ff48dc (DcmDslProtocolTx): DcmDslTxConfirmationPduId=1, DcmDslProtocolTxPduRef=Demo_1_CAN_Response_oDemoFBL_Vector_SLP3_ALPINE_RIGHT_93bb36bb_Tx
                Functional_CAN_oDemoFBL_Vector_SLP3_ALPINE_RIGHT_13a7a6c8_Rx_74452f00 (DcmDslProtocolRx):
                  DcmDslProtocolRxAddrType = DCM_FUNCTIONAL_TYPE
                  DcmDslProtocolRxPduId = 3
                  DcmDslProtocolRxComMChannelRef = (unset)
                  DcmDslProtocolRxPduRef = Functional_CAN_oDemoFBL_Vector_SLP3_ALPINE_RIGHT_13a7a6c8_Rx
                Demo_1_CAN_Request_oDemoFBL_Vector_SLP3_ALPINE_RIGHT_f486132d_Rx_d75c6646 (DcmDslProtocolRx):
                  DcmDslProtocolRxAddrType = DCM_PHYSICAL_TYPE
                  DcmDslProtocolRxPduId = 2
                  DcmDslProtocolRxComMChannelRef = (unset)
                  DcmDslProtocolRxPduRef = Demo_1_CAN_Request_oDemoFBL_Vector_SLP3_ALPINE_RIGHT_f486132d_Rx
      DcmGeneration:
        DcmInterfacesForDeactivatedData = false
        DcmReduceConstantData2Define = false
        DcmReduceNumericalDataByOffsetThreshold = 0
        DcmReferringKeysInComments = false
        DcmShortSymbols = false

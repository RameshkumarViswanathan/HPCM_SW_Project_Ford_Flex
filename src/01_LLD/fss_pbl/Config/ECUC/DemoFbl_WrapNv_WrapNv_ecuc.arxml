AUTOSAR XML (schema 00048)
package /ActiveEcuC
  module config WrapNv: implementation-config-variant=VARIANT-PRE-COMPILE, module-description=WrapNv_Impl
    WrapNvMemoryLayout
      16 x WrapNvDataBlock:
        DtcList: WrapNvDbDescription=This list holds the DTC status of all available DTCs, WrapNvDbCount=1, WrapNvDbIndex=11, WrapNvDbType=SINGLE
          DtcList (WrapNvDataElement):
            WrapNvDeDescription = please hold this value consistent with kNrOfSupportedDTCs (fbl_cfg.h) if you want to use the default implementation
            WrapNvDeLength = 10
            WrapNvDeIndex = 0
            WrapNvDeDefaultValue = 0x00 0x00 0x00 0x01 0x00 0x01 0x01 0x00 0x01 0x01
            WrapNvDeNVMBlockRef = NvMBlockDescriptor_DtcList
        DIDs: WrapNvDbCount=1, WrapNvDbDescription=DIDs List, WrapNvDbIndex=15, WrapNvDbType=STRUCT
          15 x WrapNvDataElement, all with WrapNvDeNVMBlockRef=NvMBlockDescriptor_DiDs:
            DID_F187: WrapNvDeDescription=10 Bytes ASCII (36-02-014/--H), WrapNvDeLength=10, WrapNvDeIndex=0, WrapNvDeDefaultValue=0xFF 0xFF 0xFF 0xFF 0xFF 0xFF 0xFF 0xFF 0xFF 0xFF
            DID_F188: WrapNvDeDescription=10 Bytes ASCII (36-02-014/--H), WrapNvDeLength=10, WrapNvDeIndex=1, WrapNvDeDefaultValue=0xFF 0xFF 0xFF 0xFF 0xFF 0xFF 0xFF 0xFF 0xFF 0xFF
            DID_F18A: WrapNvDeDescription=1..64 Bytes UTF-8 (36-02-014/--H), WrapNvDeLength=10, WrapNvDeIndex=2, WrapNvDeDefaultValue=0xFF 0xFF 0xFF 0xFF 0xFF 0xFF 0xFF 0xFF 0xFF 0xFF
            DID_F18C: WrapNvDeDescription=20 Bytes ASCII (36-02-014/--H), WrapNvDeLength=20, WrapNvDeIndex=3, WrapNvDeDefaultValue=0xFF 0xFF 0xFF 0xFF 0xFF 0xFF 0xFF 0xFF 0xFF 0xFF 0xFF 0xFF 0xFF 0xFF 0xFF 0xFF 0xFF 0xFF 0xFF 0xFF
            DID_F18E: WrapNvDeDescription=10 Bytes ASCII (36-02-014/--H), WrapNvDeLength=10, WrapNvDeIndex=4, WrapNvDeDefaultValue=0xFF 0xFF 0xFF 0xFF 0xFF 0xFF 0xFF 0xFF 0xFF 0xFF
            DID_F190: WrapNvDeDescription=17 Bytes ASCII (36-02-014/--H), WrapNvDeLength=17, WrapNvDeIndex=5, WrapNvDeDefaultValue=0xFF 0xFF 0xFF 0xFF 0xFF 0xFF 0xFF 0xFF 0xFF 0xFF 0xFF 0xFF 0xFF 0xFF 0xFF 0xFF 0xFF
            DID_F191: WrapNvDeDescription=10 Bytes ASCII (36-02-014/--H), WrapNvDeLength=10, WrapNvDeIndex=6, WrapNvDeDefaultValue=0xFF 0xFF 0xFF 0xFF 0xFF 0xFF 0xFF 0xFF 0xFF 0xFF
            DID_F194: WrapNvDeDescription=1..32 Bytes UTF-8 (36-02-014/--H), WrapNvDeLength=10, WrapNvDeIndex=7, WrapNvDeDefaultValue=0xFF 0xFF 0xFF 0xFF 0xFF 0xFF 0xFF 0xFF 0xFF 0xFF
            DID_F195: WrapNvDeDescription=1..32 Bytes UTF-8 (36-02-014/--H), WrapNvDeLength=32, WrapNvDeIndex=8, WrapNvDeDefaultValue=0xFF 0xFF 0xFF 0xFF 0xFF 0xFF 0xFF 0xFF 0xFF 0xFF 0xFF 0xFF 0xFF 0xFF 0xFF 0xFF 0xFF 0xFF 0xFF 0xFF 0xFF 0xFF 0xFF 0xFF 0xFF 0xFF 0xFF 0xFF 0xFF 0xFF 0xFF 0xFF
            DID_F196: WrapNvDeDescription=10 Bytes ASCII (36-02-014/--H), WrapNvDeLength=10, WrapNvDeIndex=9, WrapNvDeDefaultValue=0xFF 0xFF 0xFF 0xFF 0xFF 0xFF 0xFF 0xFF 0xFF 0xFF
            DID_F197: WrapNvDeDescription=1..32 Bytes UTF-8 (36-02-014/--H), WrapNvDeLength=32, WrapNvDeIndex=10, WrapNvDeDefaultValue=0xFF 0xFF 0xFF 0xFF 0xFF 0xFF 0xFF 0xFF 0xFF 0xFF 0xFF 0xFF 0xFF 0xFF 0xFF 0xFF 0xFF 0xFF 0xFF 0xFF 0xFF 0xFF 0xFF 0xFF 0xFF 0xFF 0xFF 0xFF 0xFF 0xFF 0xFF 0xFF
            DID_F010: WrapNvDeDescription=1..16 Bytes HEX (36-02-014/--H), WrapNvDeLength=16, WrapNvDeIndex=11, WrapNvDeDefaultValue=0xFF 0xFF 0xFF 0xFF 0xFF 0xFF 0xFF 0xFF 0xFF 0xFF 0xFF 0xFF 0xFF 0xFF 0xFF 0xFF
            DID_F011: WrapNvDeDescription=1..10 Bytes ASCII (36-02-014/--H), WrapNvDeLength=10, WrapNvDeIndex=12, WrapNvDeDefaultValue=0x50 0x52 0x4F 0x54 0x41 0x53 0x59 0x4D 0x56 0x32
            DID_F012: WrapNvDeDescription=10 Bytes ASCII (36-02-014/--H), WrapNvDeLength=10, WrapNvDeIndex=13, WrapNvDeDefaultValue=0xFF 0xFF 0xFF 0xFF 0xFF 0xFF 0xFF 0xFF 0xFF 0xFF
            dummy_block_DIDs: WrapNvDeIndex=14, WrapNvDeLength=1, WrapNvDeDescription=, WrapNvDeDefaultValue=0xFF
        MetaDataPartition: WrapNvDbCount=3, WrapNvDbDescription=Count must be identical to the number of partitions you use (2 for basic and 3 for extended OTA usecase), WrapNvDbType=TABLE, WrapNvDbIndex=13
          3 x WrapNvDataElement, all with WrapNvDeNVMBlockRef=NvMBlockDescriptor_MetaDataPartition:
            PartitionRevision: WrapNvDeDescription=Holds partition revision for OTA, WrapNvDeLength=4, WrapNvDeIndex=0, WrapNvDeDefaultValue=0xFF 0xFF 0xFF 0xFF
            PartitionValidity: WrapNvDeDescription=Holds partition validity for OTA, WrapNvDeLength=1, WrapNvDeIndex=1, WrapNvDeDefaultValue=0xFF
            ActivationPending: WrapNvDeDescription=Holds information for OTA if partition has been marked for activation, WrapNvDeLength=1, WrapNvDeIndex=2, WrapNvDeDefaultValue=0xFF
        MetaDataModule: WrapNvDbCount=6, WrapNvDbDescription=Count must be identical to the number of modules you use for all partitions, WrapNvDbType=TABLE, WrapNvDbIndex=12
          5 x WrapNvDataElement, all with WrapNvDeNVMBlockRef=NvMBlockDescriptor_MetaDataModule:
            ModuleRevision: WrapNvDeDescription=Holds module revision for OTA, WrapNvDeLength=4, WrapNvDeIndex=0, WrapNvDeDefaultValue=0xFF 0xFF 0xFF 0xFF
            ModuleValidity: WrapNvDeDescription=Holds module validity for OTA, WrapNvDeLength=1, WrapNvDeIndex=1, WrapNvDeDefaultValue=0xFF
            Digest: WrapNvDeDescription=Holds "Digest" of logical block. For default use case a hash value (20 bytes) SHA-1 and for OTA use case a signature value (256 bytes) RSA 2048 (SHA-256) is used., WrapNvDeLength=20, WrapNvDeIndex=2, WrapNvDeDefaultValue=0xFF 0xFF 0xFF 0xFF 0xFF 0xFF 0xFF 0xFF 0xFF 0xFF 0xFF 0xFF 0xFF 0xFF 0xFF 0xFF 0xFF 0xFF 0xFF 0xFF
            ProgAttemptCounter: WrapNvDeDescription=Holds programming counter of logical block. Just unmark the generate icon if you don't use programming counters at all and you want to save memory, WrapNvDeLength=1, WrapNvDeIndex=3, WrapNvDeDefaultValue=0x00
            dummy_block_MetadataNvBlocks: WrapNvDeIndex=4, WrapNvDeLength=2, WrapNvDeDescription=, WrapNvDeDefaultValue=0xFF 0xFF
        ProgReqFlag: WrapNvDbCount=1, WrapNvDbDescription=Default mechanism, how the bootloader detect entry from application, WrapNvDbIndex=2, WrapNvDbType=SINGLE
          ProgReqFlag (WrapNvDataElement):
            WrapNvDeDescription = Default mechanism, how the bootloader detect entry from application
            WrapNvDeLength = 1
            WrapNvDeIndex = 0
            WrapNvDeDefaultValue = 0xFF
            WrapNvDeNVMBlockRef = NvMBlockDescriptor_ProgReqFlag
        DcmDslRxTesterSourceAddr: WrapNvDbCount=1, WrapNvDbDescription=Tester source address to identify diagnostic connection during transitions bootloader <-> application, WrapNvDbIndex=8, WrapNvDbType=SINGLE
          DcmDslRxTesterSourceAddr (WrapNvDataElement):
            WrapNvDeDescription = Tester source address to identify diagnostic connection during transitions bootloader <-> application
            WrapNvDeLength = 2
            WrapNvDeIndex = 2
            WrapNvDeDefaultValue = 0xFF 0xFF
            WrapNvDeNVMBlockRef = NvMBlockDescriptor_DcmDslRxTesterSourceAddr
        InitFlag: WrapNvDbCount=1, WrapNvDbDescription=Defines if non-volatile memory has been initialized, WrapNvDbIndex=10, WrapNvDbType=SINGLE
          InitFlag (WrapNvDataElement):
            WrapNvDeDescription = Defines if non-volatile memory has been initialized
            WrapNvDeLength = 1
            WrapNvDeIndex = 3
            WrapNvDeDefaultValue = 0x55
            WrapNvDeNVMBlockRef = NvMBlockDescriptor_InitFlag
        DiagSecH: WrapNvDbIndex=14, WrapNvDbCount=1, WrapNvDbDescription=Default configuration for security access Renault DiagSecH, WrapNvDbType=STRUCT
          7 x WrapNvDataElement, all with WrapNvDeNVMBlockRef=NvMBlockDescriptor_DiagSecH:
            AuthentificationFlag: WrapNvDeDescription=AuthentificationFlag, WrapNvDeIndex=2, WrapNvDeLength=1, WrapNvDeDefaultValue=0xFF
            Counter: WrapNvDeDescription=Counter, WrapNvDeIndex=4, WrapNvDeLength=32, WrapNvDeDefaultValue=0x00 0x00 0x00 0x00 0x00 0x00 0x00 0x00 0x00 0x00 0x00 0x00 0x00 0x00 0x00 0x00 0x00 0x00 0x00 0x00 0x00 0x00 0x00 0x00 0x00 0x00 0x00 0x00 0x00 0x00 0x00 0x00
            FVirginFlag: WrapNvDeDescription=FVirginFlag (Default Valute F_NORMAL=0xFF), WrapNvDeIndex=1, WrapNvDeLength=1, WrapNvDeDefaultValue=0xFF
            PUN: WrapNvDeDescription=PUN (32 bytes for DiagSecH), WrapNvDeIndex=5, WrapNvDeLength=32, WrapNvDeDefaultValue=0xFF 0xFF 0xFF 0xFF 0xFF 0xFF 0xFF 0xFF 0xFF 0xFF 0xFF 0xFF 0xFF 0xFF 0xFF 0xFF 0xFF 0xFF 0xFF 0xFF 0xFF 0xFF 0xFF 0xFF 0xFF 0xFF 0xFF 0xFF 0xFF 0xFF 0xFF 0xFF
            SecretSeed: WrapNvDeDescription=SecretSeed, WrapNvDeIndex=3, WrapNvDeLength=256, WrapNvDeDefaultValue=0xFF 0xFF 0xFF 0xFF 0xFF 0xFF 0xFF 0xFF 0xFF 0xFF 0xFF 0xFF 0xFF 0xFF 0xFF 0xFF 0xFF 0xFF 0xFF 0xFF 0xFF 0xFF 0xFF 0xFF 0xFF 0xFF 0xFF 0xFF 0xFF 0xFF 0xFF 0xFF 0xFF 0xFF 0xFF 0xFF 0xFF 0xFF 0xFF 0xFF 0xFF 0xFF 0xFF 0xFF 0xFF 0xFF 0xFF 0xFF 0xFF 0xFF 0xFF 0xFF 0xFF 0xFF 0xFF 0xFF 0xFF 0xFF 0xFF 0xFF 0xFF 0xFF 0xFF 0xFF 0xFF 0xFF 0xFF 0xFF 0xFF 0xFF 0xFF 0xFF 0xFF 0xFF 0xFF 0xFF 0xFF 0xFF 0xFF 0xFF 0xFF 0xFF 0xFF 0xFF 0xFF 0xFF 0xFF 0xFF 0xFF 0xFF 0xFF 0xFF 0xFF 0xFF 0xFF 0xFF 0xFF 0xFF 0xFF 0xFF 0xFF 0xFF 0xFF 0xFF 0xFF 0xFF 0xFF 0xFF 0xFF 0xFF 0xFF 0xFF 0xFF 0xFF 0xFF 0xFF 0xFF 0xFF 0xFF 0xFF 0xFF 0xFF 0xFF 0xFF 0xFF 0xFF 0xFF 0xFF 0xFF 0xFF 0xFF 0xFF 0xFF 0xFF 0xFF 0xFF 0xFF 0xFF 0xFF 0xFF 0xFF 0xFF 0xFF 0xFF 0xFF 0xFF 0xFF 0xFF 0xFF 0xFF 0xFF 0xFF 0xFF 0xFF 0xFF 0xFF 0xFF 0xFF 0xFF 0xFF 0xFF 0xFF 0xFF 0xFF 0xFF 0xFF 0xFF 0xFF 0xFF 0xFF 0xFF 0xFF 0xFF 0xFF 0xFF 0xFF 0xFF 0xFF 0xFF 0xFF 0xFF 0xFF 0xFF 0xFF 0xFF 0xFF 0xFF 0xFF 0xFF 0xFF 0xFF 0xFF 0xFF 0xFF 0xFF 0xFF 0xFF 0xFF 0xFF 0xFF 0xFF 0xFF 0xFF 0xFF 0xFF 0xFF 0xFF 0xFF 0xFF 0xFF 0xFF 0xFF 0xFF 0xFF 0xFF 0xFF 0xFF 0xFF 0xFF 0xFF 0xFF 0xFF 0xFF 0xFF 0xFF 0xFF 0xFF 0xFF 0xFF 0xFF 0xFF 0xFF 0xFF 0xFF 0xFF 0xFF 0xFF 0xFF 0xFF 0xFF 0xFF 0xFF 0xFF 0xFF 0xFF 0xFF 0xFF 0xFF 0xFF 0xFF 0xFF 0xFF 0xFF 0xFF 0xFF 0xFF
            VirginFlag: WrapNvDeDescription=VirginFlag (Default Valute F_VIRGIN=0x00), WrapNvDeIndex=0, WrapNvDeLength=1, WrapNvDeDefaultValue=0x00
            dummy_block_DiagSecH: WrapNvDeIndex=6, WrapNvDeLength=1, WrapNvDeDescription=, WrapNvDeDefaultValue=0xFF
        ApplValidity: WrapNvDbType=SINGLE, WrapNvDbIndex=4, WrapNvDbCount=1, WrapNvDbDescription=Application validity flag
          ApplValidity (WrapNvDataElement):
            WrapNvDeIndex = 0
            WrapNvDeLength = 1
            WrapNvDeDescription = Application validity flag
            WrapNvDeDefaultValue = 0x01
            WrapNvDeNVMBlockRef = NvMBlockDescriptor_fblApplValidityNvBlock
        ResetResponseFlag: WrapNvDbType=SINGLE, WrapNvDbIndex=3, WrapNvDbCount=1, WrapNvDbDescription=Flag if a response to a request received before response is required
          ResetResponseFlag (WrapNvDataElement):
            WrapNvDeIndex = 0
            WrapNvDeLength = 1
            WrapNvDeDescription = Flag if a response to a request received before response is required
            WrapNvDeDefaultValue = 0xFF
            WrapNvDeNVMBlockRef = NvMBlockDescriptor_ResetResponseFlagNvBlock
        SecAccessDelayFlag: WrapNvDbType=SINGLE, WrapNvDbIndex=6, WrapNvDbCount=1, WrapNvDbDescription=Security Access delay flag
          SecAccessDelayFlag (WrapNvDataElement):
            WrapNvDeIndex = 0
            WrapNvDeLength = 1
            WrapNvDeDescription = Security Access delay flag
            WrapNvDeDefaultValue = 0xFF
            WrapNvDeNVMBlockRef = NvMBlockDescriptor_SecAccessDelayFlagNvBlock
        SecAccessInvalidCount: WrapNvDbType=SINGLE, WrapNvDbIndex=7, WrapNvDbCount=1, WrapNvDbDescription=Invalid security access attempt counter
          SecAccessInvalidCount (WrapNvDataElement):
            WrapNvDeIndex = 0
            WrapNvDeLength = 1
            WrapNvDeDescription = Invalid security access attempt counter
            WrapNvDeDefaultValue = 0xFF
            WrapNvDeNVMBlockRef = NvMBlockDescriptor_SecAccessInvalidCountNvBlock
        ValidityFlags: WrapNvDbType=SINGLE, WrapNvDbIndex=5, WrapNvDbCount=1, WrapNvDbDescription=Logical block validity information
          ValidityFlags (WrapNvDataElement):
            WrapNvDeIndex = 0
            WrapNvDeLength = 1
            WrapNvDeDescription = Logical block validity information
            WrapNvDeDefaultValue = 0xFE
            WrapNvDeNVMBlockRef = NvMBlockDescriptor_ValidityFlagsNvBlock
        MileageForNormalMode: WrapNvDbType=SINGLE, WrapNvDbIndex=0, WrapNvDbCount=1, WrapNvDbDescription=
          MileageForNormalMode (WrapNvDataElement): WrapNvDeIndex=0, WrapNvDeLength=1, WrapNvDeDescription=, WrapNvDeDefaultValue=0x00, WrapNvDeNVMBlockRef=NvMBlockDescriptor_MileageForNormalMode
        VIN: WrapNvDbType=SINGLE, WrapNvDbIndex=1, WrapNvDbCount=1, WrapNvDbDescription=
          VIN (WrapNvDataElement):
            WrapNvDeIndex = 0
            WrapNvDeLength = 17
            WrapNvDeDescription = 
            WrapNvDeDefaultValue = 0xFF 0xFF 0xFF 0xFF 0xFF 0xFF 0xFF 0xFF 0xFF 0xFF 0xFF 0xFF 0xFF 0xFF 0xFF 0xFF 0xFF
            WrapNvDeNVMBlockRef = NvMBlockDescriptor_VIN
        XcpRxTesterSourceAddr: WrapNvDbType=SINGLE, WrapNvDbIndex=16, WrapNvDbCount=1, WrapNvDbDescription=
          XcpRxTesterSourceAddr (WrapNvDataElement): WrapNvDeIndex=0, WrapNvDeLength=1, WrapNvDeDescription=, WrapNvDeDefaultValue=0x00, WrapNvDeNVMBlockRef=NvMBlockDescriptor_XcpRxTesterSourceAddr
    WrapNvGeneral:
      WrapNvMainFunctionPolling = true
      WrapNvEEPROMBaseAddress = 1879244800
      WrapNvFirstHandle = 1
      WrapNvNVMDataHandling = FEE
      WrapNvDevErrorDetect = true
      WrapNvUserConfigFile = $(DpaProjectFolder)\Config_Right\wrappnv_config.cfg
      WrapNvMainFunctionCycle_Fee (WrapNvMainFunctionCycle): WrapNvMainFunctionCycleValue=1, WrapNvMainFunctionCycleModuleRef=Fee
      WrapNvMainFunctionCycle_Fls (WrapNvMainFunctionCycle): WrapNvMainFunctionCycleValue=1, WrapNvMainFunctionCycleModuleRef=Fls

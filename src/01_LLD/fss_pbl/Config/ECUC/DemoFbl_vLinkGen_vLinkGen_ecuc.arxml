AUTOSAR XML (schema 00048)
package /ActiveEcuC
  module config vLinkGen: implementation-config-variant=VARIANT-PRE-COMPILE, module-description=vLinkGen_Impl
    vLinkGenMemLayout
      6 x vLinkGenMemoryRegion:
        Ram_RamCodeArea: vLinkGenMemoryRegionAddrOffset=2560, vLinkGenMemoryRegionSize=60928, vLinkGenMemoryRegionAddress=1880099328, vLinkGenMemoryRegionHwRegion=PSPR0
          RAMCODE (vLinkGenMemoryRegionBlock):
            vLinkGenMemoryRegionBlockPosition = 0
            vLinkGenMemoryRegionBlockBoundary = LOWER
            vLinkGenMemoryRegionBlockInitStage = NONE
            vLinkGenMemoryRegionBlockSize = 60928
            vLinkGenMemoryRegionBlockAddress = 1880099328
        Ram_RamConstArea: vLinkGenMemoryRegionAddrOffset=512, vLinkGenMemoryRegionSize=65536, vLinkGenMemoryRegionAddress=1879048704, vLinkGenMemoryRegionHwRegion=DSPR0
          RamConstSection (vLinkGenMemoryRegionBlock):
            vLinkGenMemoryRegionBlockPosition = 0
            vLinkGenMemoryRegionBlockBoundary = LOWER
            vLinkGenMemoryRegionBlockInitStage = NONE
            vLinkGenMemoryRegionBlockSize = 65536
            vLinkGenMemoryRegionBlockAddress = 1879048704
        Ram_MagicFlagArea: vLinkGenMemoryRegionSize=8, vLinkGenMemoryRegionAddrOffset=256, vLinkGenMemoryRegionAddress=1879048448, vLinkGenMemoryRegionHwRegion=DSPR0
          MagicFlag (vLinkGenMemoryRegionBlock):
            vLinkGenMemoryRegionBlockSize = 8
            vLinkGenMemoryRegionBlockBoundary = LOWER
            vLinkGenMemoryRegionBlockInitStage = NONE
            vLinkGenMemoryRegionBlockPosition = 0
            vLinkGenMemoryRegionBlockAddress = 1879048448
        Ram_FlashDriverArea: vLinkGenMemoryRegionAddrOffset=0, vLinkGenMemoryRegionSize=2048, vLinkGenMemoryRegionAddress=1880096768, vLinkGenMemoryRegionHwRegion=PSPR0
          FlashDrvArea (vLinkGenMemoryRegionBlock):
            vLinkGenMemoryRegionBlockPosition = 0
            vLinkGenMemoryRegionBlockBoundary = LOWER
            vLinkGenMemoryRegionBlockInitStage = NONE
            vLinkGenMemoryRegionBlockSize = 2048
            vLinkGenMemoryRegionBlockAddress = 1880096768
        Ram_EepDummyArea: vLinkGenMemoryRegionAddrOffset=0, vLinkGenMemoryRegionSize=256, vLinkGenMemoryRegionAddress=1879048192, vLinkGenMemoryRegionHwRegion=DSPR0
          EepDummy (vLinkGenMemoryRegionBlock):
            vLinkGenMemoryRegionBlockPosition = 0
            vLinkGenMemoryRegionBlockSize = 256
            vLinkGenMemoryRegionBlockBoundary = LOWER
            vLinkGenMemoryRegionBlockInitStage = NONE
            vLinkGenMemoryRegionBlockAddress = 1879048192
        Ram_DefaultRamArea: vLinkGenMemoryRegionAddrOffset=66048, vLinkGenMemoryRegionSize=179712, vLinkGenMemoryRegionAddress=1879114240, vLinkGenMemoryRegionHwRegion=DSPR0
          3 x vLinkGenMemoryRegionBlock, all with vLinkGenMemoryRegionBlockInitStage=NONE:
            DefaultRamArea_Bss_Data: vLinkGenMemoryRegionBlockPosition=0, vLinkGenMemoryRegionBlockBoundary=LOWER, vLinkGenMemoryRegionBlockSize=144896, vLinkGenMemoryRegionBlockAddress=1879114240
            DefaultRamArea_Stack: vLinkGenMemoryRegionBlockPosition=0, vLinkGenMemoryRegionBlockSize=2048, vLinkGenMemoryRegionBlockAddress=1879291904, vLinkGenMemoryRegionBlockBoundary=UPPER
            DefaultRamArea_Csa: vLinkGenMemoryRegionBlockPosition=1, vLinkGenMemoryRegionBlockSize=32768, vLinkGenMemoryRegionBlockAddress=1879259136, vLinkGenMemoryRegionBlockBoundary=LOWER
      brsExcVect_fls (vLinkGenLogicalConstGroup):
        vLinkGenConstGroupPosition = 1001
        vLinkGenConstGroupRegion = FlashDrvArea
        vLinkGenConstGroupVariant = vLinkGenVariantHandling/FlashDrv
        vLinkGenConstGroupVariant = FlashDrv_Xd
        traptab (vLinkGenConstSectionGroup):
          vLinkGenConstSectionGroupAlignment = 16
          vLinkGenConstSectionGroupEndAlignment = 8
          vLinkGenConstSectionGroupGapSize = 0
          vLinkGenConstSectionGroupPosition = 0
          vLinkGenConstSectionGroupInit = NONE
          vLinkGenConstSectionGroupInitStage = ONE
          vLinkGenConstSectionGroupRef = vLinkGenLinkerSections/traptab
      vLinkGenLinkerSections
        traptab (vLinkGenLinkerCodeSection): vLinkGenLinkerCodeSectionName=traptab, vLinkGenLinkerCodeSectionFast=false
        brsStartup (vLinkGenLinkerCodeSection):
          vLinkGenLinkerCodeSectionName = brsStartup
          vLinkGenLinkerCodeSectionAlignment = 8
          vLinkGenLinkerCodeSectionFast = false
          vLinkGenLinkerCodeSectionFlag = vLinkGenConstSectionFlags/KEEP
        brsExcVect (vLinkGenLinkerConstSection): vLinkGenLinkerConstSectionName=brsExcVect, vLinkGenLinkerConstSectionFast=true, vLinkGenLinkerConstSectionFlag=vLinkGenConstSectionFlags/KEEP
        BMHD0 (vLinkGenLinkerConstSection): vLinkGenLinkerConstSectionName=BMHD0, vLinkGenLinkerConstSectionFast=false, vLinkGenLinkerConstSectionFlag=vLinkGenConstSectionFlags/KEEP
        RamCodeCoreSection (vLinkGenLinkerCodeSection): vLinkGenLinkerCodeSectionName=RamCodeCoreSection, vLinkGenLinkerCodeSectionFast=false, vLinkGenLinkerCodeSectionAlignment=0
        EepDummySection (vLinkGenLinkerVarSection):
          vLinkGenLinkerVarSectionName = EepDummySection
          vLinkGenLinkerVarSectionFast = false
          vLinkGenLinkerVarSectionAlignment = 0
          vLinkGenLinkerVarSectionFlag = vLinkGenVarSectionFlags/KEEP
        BmHeaderSection (vLinkGenLinkerConstSection): vLinkGenLinkerConstSectionName=BmHeaderSection, vLinkGenLinkerConstSectionFast=false, vLinkGenLinkerConstSectionAlignment=0
        RamCodeCanSection (vLinkGenLinkerCodeSection): vLinkGenLinkerCodeSectionName=RamCodeCanSection, vLinkGenLinkerCodeSectionFast=false, vLinkGenLinkerCodeSectionAlignment=0
        3 x vLinkGenLinkerConstSection, all with vLinkGenLinkerConstSectionFast=false, vLinkGenLinkerConstSectionAlignment=0:
          RamConstSection: vLinkGenLinkerConstSectionName=RamConstSection
          FblHeaderSection: vLinkGenLinkerConstSectionName=FblHeaderSection, vLinkGenLinkerConstSectionFlag=vLinkGenConstSectionFlags/KEEP
          BmHdrHeaderSection: vLinkGenLinkerConstSectionName=BmHdrHeaderSection, vLinkGenLinkerConstSectionFlag=vLinkGenConstSectionFlags/KEEP
        MagicFlagSection (vLinkGenLinkerVarSection):
          vLinkGenLinkerVarSectionName = MagicFlagSection
          vLinkGenLinkerVarSectionFast = false
          vLinkGenLinkerVarSectionAlignment = 0
          vLinkGenLinkerVarSectionFlag = vLinkGenVarSectionFlags/KEEP
        brsResetLabel (vLinkGenLinkerCodeSection): vLinkGenLinkerCodeSectionName=brsResetLabel, vLinkGenLinkerCodeSectionFast=false, vLinkGenLinkerCodeSectionAlignment=0
        FblFlashDrvSection (vLinkGenLinkerVarSection): vLinkGenLinkerVarSectionName=FblFlashDrvSection, vLinkGenLinkerVarSectionFast=false, vLinkGenLinkerVarSectionAlignment=0
        RamCodeFrSection (vLinkGenLinkerCodeSection): vLinkGenLinkerCodeSectionName=RamCodeFrSection, vLinkGenLinkerCodeSectionFast=false, vLinkGenLinkerCodeSectionAlignment=0
        RamCodeCommServicesSection (vLinkGenLinkerCodeSection): vLinkGenLinkerCodeSectionName=RamCodeCommServicesSection, vLinkGenLinkerCodeSectionFast=false, vLinkGenLinkerCodeSectionAlignment=0
        7 x vLinkGenLinkerConstSection, all with vLinkGenLinkerConstSectionFast=false:
          FblPresencePatternSection: vLinkGenLinkerConstSectionName=FblPresencePatternSection, vLinkGenLinkerConstSectionFlag=vLinkGenConstSectionFlags/KEEP
          ApplVectSection: vLinkGenLinkerConstSectionName=ApplVectSection, vLinkGenLinkerConstSectionAlignment=8, vLinkGenLinkerConstSectionFlag=vLinkGenConstSectionFlags/KEEP
          FblManualConstSection: vLinkGenLinkerConstSectionFiles=*fbl_diag, vLinkGenLinkerConstSectionName=rodata
          SlpHeaderSection: vLinkGenLinkerConstSectionName=SlpHeaderSection
          SlpConstSection: vLinkGenLinkerConstSectionName=SlpConstSection
          FlashDrvHeaderSection: vLinkGenLinkerConstSectionName=FlashDrvHeaderSection, vLinkGenLinkerConstSectionFlag=vLinkGenConstSectionFlags/KEEP
          PseudoFlashDrvSection: vLinkGenLinkerConstSectionName=PseudoFlashDrvSection
        25 x vLinkGenLinkerSpecSection, all with vLinkGenLinkerSpecSectionPad=0:
          text: vLinkGenLinkerSpecSectionValue=.text
          text_all: vLinkGenLinkerSpecSectionValue=.text.*
          text_vle: vLinkGenLinkerSpecSectionValue=.text_vle
          text_vle_all: vLinkGenLinkerSpecSectionValue=.text_vle.*
          rodata: vLinkGenLinkerSpecSectionValue=.rodata
          rodata_all: vLinkGenLinkerSpecSectionValue=.rodata.*
          srodata: vLinkGenLinkerSpecSectionValue=.srodata
          srodata_all: vLinkGenLinkerSpecSectionValue=.srodata.*
          zrodata: vLinkGenLinkerSpecSectionValue=.zrodata
          zrodata_all: vLinkGenLinkerSpecSectionValue=.zrodata.*
          sdata2: vLinkGenLinkerSpecSectionValue=.sdata2
          sdata2_all: vLinkGenLinkerSpecSectionValue=.sdata2.*
          data: vLinkGenLinkerSpecSectionValue=.data
          data_all: vLinkGenLinkerSpecSectionValue=.data.*
          zdata: vLinkGenLinkerSpecSectionValue=.zdata
          zdata_all: vLinkGenLinkerSpecSectionValue=.zdata.*
          sdata: vLinkGenLinkerSpecSectionValue=.sdata
          sdata_all: vLinkGenLinkerSpecSectionValue=.sdata.*
          bss: vLinkGenLinkerSpecSectionValue=.bss
          bss_all: vLinkGenLinkerSpecSectionValue=.bss.*
          sbss: vLinkGenLinkerSpecSectionValue=.sbss
          sbss_all: vLinkGenLinkerSpecSectionValue=.sbss.*
          zbss: vLinkGenLinkerSpecSectionValue=.zbss
          zbss_all: vLinkGenLinkerSpecSectionValue=.zbss.*
          COMMON: vLinkGenLinkerSpecSectionValue=COMMON
        8 x vLinkGenLinkerConstSection, all with vLinkGenLinkerConstSectionFast=false, vLinkGenLinkerConstSectionFlag=vLinkGenConstSectionFlags/KEEP:
          asw_sw_version_area: vLinkGenLinkerConstSectionName=asw_sw_version_area
          bm_sw_version_area: vLinkGenLinkerConstSectionName=bm_sw_version_area
          btld_sw_version_area: vLinkGenLinkerConstSectionName=btld_sw_version_area
          cal_sw_version_area: vLinkGenLinkerConstSectionName=cal_sw_version_area
          cal_delib_area: vLinkGenLinkerConstSectionName=cal_delib_area
          hwData_did_customer_area: vLinkGenLinkerConstSectionName=hwData_did_customer_area
          hwData_did_---------_area: vLinkGenLinkerConstSectionName=hwData_did_---------_area
          hwData_did_InactiveBank_area: vLinkGenLinkerConstSectionName=hwData_did_InactiveBank_area
      MemRegion_BMHD0 (vLinkGenMemoryRegion): vLinkGenMemoryRegionAddrOffset=0, vLinkGenMemoryRegionSize=512, vLinkGenMemoryRegionAddress=2940207104, vLinkGenMemoryRegionHwRegion=BMHD0
        RegionBlock_BMHD0 (vLinkGenMemoryRegionBlock):
          vLinkGenMemoryRegionBlockPosition = 0
          vLinkGenMemoryRegionBlockSize = 512
          vLinkGenMemoryRegionBlockAddress = 2940207104
          vLinkGenMemoryRegionBlockBoundary = LOWER
          vLinkGenMemoryRegionBlockInitStage = NONE
      BMHD0 (vLinkGenLogicalConstGroup):
        vLinkGenConstGroupPosition = 5
        vLinkGenConstGroupRegion = RegionBlock_BMHD0
        vLinkGenConstGroupVariant = vLinkGenVariantHandling/DemoBm
        vLinkGenConstGroupVariant = vLinkGenVariantHandling/DemoFbl
        BMHD0 (vLinkGenConstSectionGroup):
          vLinkGenConstSectionGroupAlignment = 4
          vLinkGenConstSectionGroupPosition = 0
          vLinkGenConstSectionGroupInit = NONE
          vLinkGenConstSectionGroupInitStage = ONE
          vLinkGenConstSectionGroupRef = vLinkGenLinkerSections/BMHD0
      Startup_Code (vLinkGenLogicalConstGroup):
        vLinkGenConstGroupPosition = 0
        vLinkGenConstGroupRegion = FblRom_Startup
        vLinkGenConstGroupVariant = vLinkGenVariantHandling/DemoFbl
        vLinkGenConstGroupVariant = vLinkGenVariantHandling/DemoBm
        vLinkGenConstGroupVariant = vLinkGenVariantHandling/DemoUpd
        vLinkGenConstGroupVariant = DemoAppl
        vLinkGenConstGroupVariant = FblNotStandAloneBm
        Startup_Code (vLinkGenConstSectionGroup):
          vLinkGenConstSectionGroupAlignment = 4
          vLinkGenConstSectionGroupPosition = 0
          vLinkGenConstSectionGroupInit = NONE
          vLinkGenConstSectionGroupInitStage = ONE
          vLinkGenConstSectionGroupRef = brsStartup
        vLinkGenConstGroupVariantHandling
          3 x vLinkGenConstGroupVariantSpecifics:
            DemoBm: vLinkGenConstGroupSpecificVariant=vLinkGenVariantHandling/DemoBm, vLinkGenConstGroupSpecificRegion=BmRom_Startup, vLinkGenConstGroupSpecificVariant=FblNotStandAloneBm
            DemoFbl: vLinkGenConstGroupSpecificRegion=FblRom_Startup, vLinkGenConstGroupSpecificVariant=vLinkGenVariantHandling/DemoFbl
            DemoUpd_DemoAppl: vLinkGenConstGroupSpecificRegion=ApplRom_Startup, vLinkGenConstGroupSpecificVariant=vLinkGenVariantHandling/DemoUpd, vLinkGenConstGroupSpecificVariant=DemoAppl
      3 x vLinkGenLogicalVarGroup:
        Data_Default: vLinkGenVarGroupPosition=1000, vLinkGenVarGroupInitCore=0, vLinkGenVarGroupRegion=DefaultRamArea_Bss_Data, vLinkGenVarGroupRomRegion=FblRomArea, vLinkGenVarGroupVariant=vLinkGenVariantHandling/DemoFbl, vLinkGenVarGroupVariant=FblNotStandAloneBm, vLinkGenVarGroupVariant=vLinkGenVariantHandling/DemoBm, vLinkGenVarGroupVariant=vLinkGenVariantHandling/DemoUpd, vLinkGenVarGroupVariant=DemoAppl, vLinkGenVarGroupVariant=vLinkGenVariantHandling/FlashDrv, vLinkGenVarGroupModule=MemMap
          vLinkGenVarGroupVariantHandling
            4 x vLinkGenVarGroupVariantSpecifics:
              DemoBm: vLinkGenVarGroupSpecificRegion=DefaultRamArea_Bss_Data, vLinkGenVarGroupSpecificRomRegion=BmRomArea, vLinkGenVarGroupSpecificVariant=vLinkGenVariantHandling/DemoBm
              DemoFbl: vLinkGenVarGroupSpecificRegion=DefaultRamArea_Bss_Data, vLinkGenVarGroupSpecificRomRegion=FblRomArea, vLinkGenVarGroupSpecificVariant=vLinkGenVariantHandling/DemoFbl, vLinkGenVarGroupSpecificVariant=FblNotStandAloneBm
              DemoUpd_DemoAppl: vLinkGenVarGroupSpecificRegion=DefaultRamArea_Bss_Data, vLinkGenVarGroupSpecificRomRegion=ApplRomArea, vLinkGenVarGroupSpecificVariant=vLinkGenVariantHandling/DemoUpd, vLinkGenVarGroupSpecificVariant=DemoAppl
              FlashDrv: vLinkGenVarGroupSpecificRegion=FlashDrvArea, vLinkGenVarGroupSpecificRomRegion=FlashDrvArea, vLinkGenVarGroupSpecificVariant=vLinkGenVariantHandling/FlashDrv
          6 x vLinkGenVarSectionGroup, all with vLinkGenVarSectionGroupPosition=0, vLinkGenVarSectionGroupInitStage=ONE, vLinkGenVarSectionGroupAlignment=16, vLinkGenVarSectionGroupEndAlignment=4, vLinkGenVarSectionGroupFlag=vLinkGenVarGroupFlags/WRITE:
            data: vLinkGenVarSectionGroupInit=INIT, vLinkGenVarSectionGroupFlag=LOADABLE, vLinkGenVarSectionGroupRef=vLinkGenLinkerSections/data, vLinkGenVarSectionGroupRef=data_all
            sdata: vLinkGenVarSectionGroupInit=INIT, vLinkGenVarSectionGroupFlag=vLinkGenVarGroupFlags/SMALL_ADDRESSING, vLinkGenVarSectionGroupFlag=LOADABLE, vLinkGenVarSectionGroupRef=vLinkGenLinkerSections/sdata, vLinkGenVarSectionGroupRef=sdata_all
            zdata: vLinkGenVarSectionGroupInit=INIT, vLinkGenVarSectionGroupFlag=vLinkGenVarGroupFlags/ABSOLUTE_ADDRESSING, vLinkGenVarSectionGroupFlag=LOADABLE, vLinkGenVarSectionGroupRef=vLinkGenLinkerSections/zdata, vLinkGenVarSectionGroupRef=zdata_all
            bss: vLinkGenVarSectionGroupInit=ZERO_INIT, vLinkGenVarSectionGroupRef=vLinkGenLinkerSections/bss, vLinkGenVarSectionGroupRef=bss_all, vLinkGenVarSectionGroupRef=COMMON
            sbss: vLinkGenVarSectionGroupInit=ZERO_INIT, vLinkGenVarSectionGroupFlag=vLinkGenVarGroupFlags/SMALL_ADDRESSING, vLinkGenVarSectionGroupRef=vLinkGenLinkerSections/sbss, vLinkGenVarSectionGroupRef=sbss_all
            zbss: vLinkGenVarSectionGroupInit=ZERO_INIT, vLinkGenVarSectionGroupFlag=vLinkGenVarGroupFlags/ABSOLUTE_ADDRESSING, vLinkGenVarSectionGroupRef=vLinkGenLinkerSections/zbss, vLinkGenVarSectionGroupRef=zbss_all
        STACK_C0: vLinkGenVarGroupInitCore=0, vLinkGenVarGroupPosition=5, vLinkGenVarGroupRegion=DefaultRamArea_Stack
          STACK_C0 (vLinkGenVarSectionGroup):
            vLinkGenVarSectionGroupAlignment = 4
            vLinkGenVarSectionGroupEndAlignment = 4
            vLinkGenVarSectionGroupSize = 1024
            vLinkGenVarSectionGroupInit = ZERO_INIT
            vLinkGenVarSectionGroupInitStage = EARLY
            vLinkGenVarSectionGroupPosition = 0
        CSA_CORE0: vLinkGenVarGroupPosition=5, vLinkGenVarGroupRegion=DefaultRamArea_Csa, vLinkGenVarGroupVariant=DemoAppl, vLinkGenVarGroupVariant=vLinkGenVariantHandling/DemoBm, vLinkGenVarGroupVariant=vLinkGenVariantHandling/DemoFbl, vLinkGenVarGroupVariant=vLinkGenVariantHandling/DemoUpd, vLinkGenVarGroupVariant=FblNotStandAloneBm
          CSA_CORE0 (vLinkGenVarSectionGroup):
            vLinkGenVarSectionGroupAlignment = 64
            vLinkGenVarSectionGroupSize = 32768
            vLinkGenVarSectionGroupPosition = 0
            vLinkGenVarSectionGroupInit = NONE
            vLinkGenVarSectionGroupInitStage = ONE
      3 x vLinkGenLogicalSymbolGroup, all with vLinkGenSymbolGroupPosition=5:
        Startup_Labels: vLinkGenSymbolGroupVariant=DemoAppl, vLinkGenSymbolGroupVariant=vLinkGenVariantHandling/DemoBm, vLinkGenSymbolGroupVariant=vLinkGenVariantHandling/DemoFbl, vLinkGenSymbolGroupVariant=vLinkGenVariantHandling/DemoUpd, vLinkGenSymbolGroupVariant=FblNotStandAloneBm
          5 x vLinkGenLinkerSymbol, all with vLinkGenLinkerSymbolValue=brsStartupEntry, vLinkGenLinkerSymbolPosition=0:
            Startup_Labels1: vLinkGenLinkerSymbolName=_RESET
            Startup_Labels2: vLinkGenLinkerSymbolName=_start
            Startup_Labels3: vLinkGenLinkerSymbolName=StartupEntry
            Startup_Labels4: vLinkGenLinkerSymbolName=_brsStartupEntry
            Startup_Labels5: vLinkGenLinkerSymbolName=_start_tc0
        CSA_LABELS: vLinkGenSymbolGroupVariant=DemoAppl, vLinkGenSymbolGroupVariant=vLinkGenVariantHandling/DemoBm, vLinkGenSymbolGroupVariant=vLinkGenVariantHandling/DemoFbl, vLinkGenSymbolGroupVariant=vLinkGenVariantHandling/DemoUpd, vLinkGenSymbolGroupVariant=FblNotStandAloneBm
          CSA_LABELS1 (vLinkGenLinkerSymbol): vLinkGenLinkerSymbolName=__CSA_BEGIN_CPU0_, vLinkGenLinkerSymbolValue=_CSA_CORE0_START, vLinkGenLinkerSymbolPosition=0
          CSA_LABELS2 (vLinkGenLinkerSymbol): vLinkGenLinkerSymbolName=__CSA_END_CPU0_, vLinkGenLinkerSymbolValue=_CSA_CORE0_LIMIT, vLinkGenLinkerSymbolPosition=0
        Startup_Stack
          Startup_Stack_c0 (vLinkGenLinkerSymbol): vLinkGenLinkerSymbolName=__STARTUPSTACK_CORE0, vLinkGenLinkerSymbolValue=_STACK_C0_LIMIT, vLinkGenLinkerSymbolPosition=0
      brsExcVect (vLinkGenLogicalConstGroup):
        vLinkGenConstGroupPosition = 5
        vLinkGenConstGroupRegion = BmExcVect
        vLinkGenConstGroupVariant = vLinkGenVariantHandling/DemoBm
        vLinkGenConstGroupVariant = vLinkGenVariantHandling/DemoFbl
        vLinkGenConstGroupVariant = FblNotStandAloneBm
        vLinkGenConstGroupVariant = vLinkGenVariantHandling/DemoUpd
        vLinkGenConstGroupVariant = DemoAppl
        brsExcVect (vLinkGenConstSectionGroup):
          vLinkGenConstSectionGroupPosition = 0
          vLinkGenConstSectionGroupInit = NONE
          vLinkGenConstSectionGroupInitStage = ONE
          vLinkGenConstSectionGroupAlignment = 256
          vLinkGenConstSectionGroupEndAlignment = 8
          vLinkGenConstSectionGroupGapSize = 16
          vLinkGenConstSectionGroupRef = vLinkGenLinkerSections/brsExcVect
        vLinkGenConstGroupVariantHandling
          3 x vLinkGenConstGroupVariantSpecifics, all with vLinkGenConstGroupSpecificRegion=BmExcVect:
            DemoBm: vLinkGenConstGroupSpecificVariant=vLinkGenVariantHandling/DemoBm
            DemoFbl: vLinkGenConstGroupSpecificVariant=vLinkGenVariantHandling/DemoFbl, vLinkGenConstGroupSpecificVariant=FblNotStandAloneBm
            DemoUpd_DemoAppl: vLinkGenConstGroupSpecificVariant=vLinkGenVariantHandling/DemoUpd, vLinkGenConstGroupSpecificVariant=DemoAppl
      FlashDrvGroup (vLinkGenLogicalVarGroup):
        vLinkGenVarGroupPosition = 1
        vLinkGenVarGroupRegion = FlashDrvArea
        vLinkGenVarGroupVariant = vLinkGenVariantHandling/DemoFbl
        vLinkGenVarGroupVariant = FblNotStandAloneBm
        vLinkGenVarGroupVariant = vLinkGenVariantHandling/DemoUpd
        FlashDrvSection (vLinkGenVarSectionGroup):
          vLinkGenVarSectionGroupPosition = 0
          vLinkGenVarSectionGroupInitStage = TWO
          vLinkGenVarSectionGroupInit = NONE
          vLinkGenVarSectionGroupAlignment = 16
          vLinkGenVarSectionGroupRef = FblFlashDrvSection
      3 x vLinkGenMemoryRegion, all with vLinkGenMemoryRegionHwRegion=PFlash0_Cached:
        Rom_BmMemoryArea: vLinkGenMemoryRegionAddrOffset=262144, vLinkGenMemoryRegionSize=131072, vLinkGenMemoryRegionAddress=2147745792
          5 x vLinkGenMemoryRegionBlock, all with vLinkGenMemoryRegionBlockInitStage=NONE:
            BmRomArea: vLinkGenMemoryRegionBlockPosition=2, vLinkGenMemoryRegionBlockBoundary=LOWER, vLinkGenMemoryRegionBlockSize=129216, vLinkGenMemoryRegionBlockAddress=2147747584
            BmHeader: vLinkGenMemoryRegionBlockPosition=0, vLinkGenMemoryRegionBlockSize=32, vLinkGenMemoryRegionBlockBoundary=UPPER, vLinkGenMemoryRegionBlockAddress=2147876832
            BmRom_Startup: vLinkGenMemoryRegionBlockPosition=0, vLinkGenMemoryRegionBlockBoundary=LOWER, vLinkGenMemoryRegionBlockSize=1024, vLinkGenMemoryRegionBlockAddress=2147745792
            BmExcVect: vLinkGenMemoryRegionBlockPosition=1, vLinkGenMemoryRegionBlockSize=768, vLinkGenMemoryRegionBlockAddress=2147746816, vLinkGenMemoryRegionBlockBoundary=LOWER
            BmRomBlock_BM_INFO: vLinkGenMemoryRegionBlockPosition=3, vLinkGenMemoryRegionBlockSize=32, vLinkGenMemoryRegionBlockAddress=2147876800, vLinkGenMemoryRegionBlockBoundary=LOWER
        Rom_FblMemoryArea: vLinkGenMemoryRegionAddrOffset=393216, vLinkGenMemoryRegionSize=393216, vLinkGenMemoryRegionAddress=2147876864
          8 x vLinkGenMemoryRegionBlock, all with vLinkGenMemoryRegionBlockInitStage=NONE:
            FblRomArea: vLinkGenMemoryRegionBlockPosition=2, vLinkGenMemoryRegionBlockBoundary=LOWER, vLinkGenMemoryRegionBlockSize=358880, vLinkGenMemoryRegionBlockAddress=2147878144
            FblBmHdrHeader: vLinkGenMemoryRegionBlockPosition=1, vLinkGenMemoryRegionBlockSize=64, vLinkGenMemoryRegionBlockBoundary=UPPER, vLinkGenMemoryRegionBlockAddress=2148269888
            FblHeader: vLinkGenMemoryRegionBlockPosition=0, vLinkGenMemoryRegionBlockSize=64, vLinkGenMemoryRegionBlockBoundary=UPPER, vLinkGenMemoryRegionBlockAddress=2148269824
            FblRom_Startup: vLinkGenMemoryRegionBlockPosition=0, vLinkGenMemoryRegionBlockBoundary=LOWER, vLinkGenMemoryRegionBlockSize=768, vLinkGenMemoryRegionBlockAddress=2147876864
            FblRomLB_PP: vLinkGenMemoryRegionBlockPosition=3, vLinkGenMemoryRegionBlockBoundary=UPPER, vLinkGenMemoryRegionBlockSize=64, vLinkGenMemoryRegionBlockAddress=2148270016
            FblSlpSpecificArea: vLinkGenMemoryRegionBlockPosition=3, vLinkGenMemoryRegionBlockBoundary=LOWER, vLinkGenMemoryRegionBlockSize=32, vLinkGenMemoryRegionBlockAddress=2148237024
            FblRom_exec: vLinkGenMemoryRegionBlockPosition=1, vLinkGenMemoryRegionBlockSize=512, vLinkGenMemoryRegionBlockAddress=2147877632, vLinkGenMemoryRegionBlockBoundary=LOWER
            Rom_FblMemoryArea: vLinkGenMemoryRegionBlockPosition=2, vLinkGenMemoryRegionBlockSize=64, vLinkGenMemoryRegionBlockAddress=2148269952, vLinkGenMemoryRegionBlockBoundary=UPPER
        Rom_ApplMemoryArea_PF0: vLinkGenMemoryRegionAddrOffset=786432, vLinkGenMemoryRegionSize=2359296, vLinkGenMemoryRegionAddress=2148270080
          4 x vLinkGenMemoryRegionBlock, all with vLinkGenMemoryRegionBlockBoundary=LOWER, vLinkGenMemoryRegionBlockInitStage=NONE:
            ApplRomArea: vLinkGenMemoryRegionBlockPosition=2, vLinkGenMemoryRegionBlockSize=2358240, vLinkGenMemoryRegionBlockAddress=2148270880
            ApplRom_Startup: vLinkGenMemoryRegionBlockPosition=1, vLinkGenMemoryRegionBlockSize=768, vLinkGenMemoryRegionBlockAddress=2148270112
            ApplRom_ApplVect: vLinkGenMemoryRegionBlockSize=32, vLinkGenMemoryRegionBlockPosition=0, vLinkGenMemoryRegionBlockAddress=2148270080
            ApplSlpSpecificArea: vLinkGenMemoryRegionBlockPosition=3, vLinkGenMemoryRegionBlockSize=256, vLinkGenMemoryRegionBlockAddress=2150629120
      Const_Default (vLinkGenLogicalConstGroup):
        vLinkGenConstGroupPosition = 1000
        vLinkGenConstGroupRegion = FblRomArea
        vLinkGenConstGroupVariant = vLinkGenVariantHandling/DemoFbl
        vLinkGenConstGroupVariant = FblNotStandAloneBm
        vLinkGenConstGroupVariant = vLinkGenVariantHandling/DemoBm
        vLinkGenConstGroupVariant = DemoAppl
        vLinkGenConstGroupVariant = vLinkGenVariantHandling/DemoUpd
        vLinkGenConstGroupVariantHandling
          3 x vLinkGenConstGroupVariantSpecifics:
            DemoBm: vLinkGenConstGroupSpecificVariant=vLinkGenVariantHandling/DemoBm, vLinkGenConstGroupSpecificRegion=BmRomArea
            DemoFbl: vLinkGenConstGroupSpecificRegion=FblRomArea, vLinkGenConstGroupSpecificVariant=vLinkGenVariantHandling/DemoFbl, vLinkGenConstGroupSpecificVariant=FblNotStandAloneBm
            DemoUpd_DemoAppl: vLinkGenConstGroupSpecificRegion=ApplRomArea, vLinkGenConstGroupSpecificVariant=vLinkGenVariantHandling/DemoUpd, vLinkGenConstGroupSpecificVariant=DemoAppl
        6 x vLinkGenConstSectionGroup, all with vLinkGenConstSectionGroupPosition=0, vLinkGenConstSectionGroupInit=NONE, vLinkGenConstSectionGroupInitStage=ONE:
          text: vLinkGenConstSectionGroupFlag=vLinkGenConstGroupFlags/EXECUTE, vLinkGenConstSectionGroupRef=vLinkGenLinkerSections/text, vLinkGenConstSectionGroupRef=text_all
          text_vle: vLinkGenConstSectionGroupFlag=vLinkGenConstGroupFlags/EXECUTE, vLinkGenConstSectionGroupFlag=VLE_CODE, vLinkGenConstSectionGroupRef=vLinkGenLinkerSections/text_vle, vLinkGenConstSectionGroupRef=text_vle_all
          rodata: vLinkGenConstSectionGroupFlag=vLinkGenConstGroupFlags/READ, vLinkGenConstSectionGroupRef=vLinkGenLinkerSections/rodata, vLinkGenConstSectionGroupRef=rodata_all
          srodata: vLinkGenConstSectionGroupFlag=vLinkGenConstGroupFlags/READ, vLinkGenConstSectionGroupFlag=vLinkGenConstGroupFlags/SMALL_ADDRESSING, vLinkGenConstSectionGroupRef=vLinkGenLinkerSections/srodata, vLinkGenConstSectionGroupRef=srodata_all
          zrodata: vLinkGenConstSectionGroupFlag=vLinkGenConstGroupFlags/READ, vLinkGenConstSectionGroupFlag=vLinkGenConstGroupFlags/ABSOLUTE_ADDRESSING, vLinkGenConstSectionGroupRef=vLinkGenLinkerSections/zrodata, vLinkGenConstSectionGroupRef=zrodata_all
          sdata2: vLinkGenConstSectionGroupFlag=vLinkGenConstGroupFlags/READ, vLinkGenConstSectionGroupFlag=vLinkGenConstGroupFlags/SMALL_ADDRESSING, vLinkGenConstSectionGroupRef=vLinkGenLinkerSections/sdata2, vLinkGenConstSectionGroupRef=sdata2_all
      RamCodeGroup (vLinkGenLogicalConstGroup):
        vLinkGenConstGroupPosition = 1
        vLinkGenConstGroupInitCore = 0
        vLinkGenConstGroupRegion = FblRomArea
        vLinkGenConstGroupVariant = vLinkGenVariantHandling/DemoFbl
        vLinkGenConstGroupRamRegion = RAMCODE
        vLinkGenConstGroupVariant = FblNotStandAloneBm
        vLinkGenConstGroupVariant = vLinkGenVariantHandling/DemoBm
        vLinkGenConstGroupVariant = vLinkGenVariantHandling/DemoUpd
        4 x vLinkGenConstSectionGroup, all with vLinkGenConstSectionGroupInit=COPY_TO_RAM, vLinkGenConstSectionGroupInitStage=ONE, vLinkGenConstSectionGroupAlignment=4, vLinkGenConstSectionGroupEndAlignment=4:
          RamCodeCoreSection: vLinkGenConstSectionGroupPosition=0, vLinkGenConstSectionGroupRef=vLinkGenLinkerSections/RamCodeCoreSection
          RamCodeCanSection: vLinkGenConstSectionGroupPosition=2, vLinkGenConstSectionGroupRef=vLinkGenLinkerSections/RamCodeCanSection
          RamCodeCommServicesSection: vLinkGenConstSectionGroupPosition=1, vLinkGenConstSectionGroupRef=vLinkGenLinkerSections/RamCodeCommServicesSection
          RamCodeFrSection: vLinkGenConstSectionGroupPosition=3, vLinkGenConstSectionGroupRef=vLinkGenLinkerSections/RamCodeFrSection
        vLinkGenConstGroupVariantHandling
          3 x vLinkGenConstGroupVariantSpecifics, all with vLinkGenConstGroupSpecificRamRegion=RAMCODE:
            DemoBm: vLinkGenConstGroupSpecificVariant=vLinkGenVariantHandling/DemoBm, vLinkGenConstGroupSpecificRegion=BmRomArea
            DemoFbl: vLinkGenConstGroupSpecificRegion=FblRomArea, vLinkGenConstGroupSpecificVariant=vLinkGenVariantHandling/DemoFbl, vLinkGenConstGroupSpecificVariant=FblNotStandAloneBm
            DemoUpd: vLinkGenConstGroupSpecificRegion=ApplRomArea, vLinkGenConstGroupSpecificVariant=vLinkGenVariantHandling/DemoUpd
      EepDummyGroup (vLinkGenLogicalVarGroup):
        vLinkGenVarGroupPosition = 1
        vLinkGenVarGroupInitCore = 0
        vLinkGenVarGroupRegion = EepDummy
        vLinkGenVarGroupVariant = vLinkGenVariantHandling/DemoBm
        vLinkGenVarGroupVariant = DemoAppl
        vLinkGenVarGroupVariant = vLinkGenVariantHandling/DemoFbl
        vLinkGenVarGroupVariant = vLinkGenVariantHandling/DemoUpd
        vLinkGenVarGroupVariant = FblNotStandAloneBm
        EepDummySection (vLinkGenVarSectionGroup):
          vLinkGenVarSectionGroupPosition = 0
          vLinkGenVarSectionGroupInit = ZERO_INIT
          vLinkGenVarSectionGroupInitStage = HARD_RESET_ONLY
          vLinkGenVarSectionGroupAlignment = 16
          vLinkGenVarSectionGroupEndAlignment = 4
          vLinkGenVarSectionGroupRef = vLinkGenLinkerSections/EepDummySection
          vLinkGenVarSectionGroupFlag = vLinkGenVarGroupFlags/NOLOAD
      3 x vLinkGenLogicalConstGroup, all with vLinkGenConstGroupPosition=0, vLinkGenConstGroupVariant=vLinkGenVariantHandling/DemoFbl, vLinkGenConstGroupVariant=FblNotStandAloneBm:
        FblHeaderGroup: vLinkGenConstGroupRegion=FblHeader
          FblHeaderSectionGroup (vLinkGenConstSectionGroup):
            vLinkGenConstSectionGroupPosition = 0
            vLinkGenConstSectionGroupInit = NONE
            vLinkGenConstSectionGroupInitStage = ONE
            vLinkGenConstSectionGroupRef = FblHeaderSection
        BmHdrHeaderGroup: vLinkGenConstGroupRegion=FblBmHdrHeader, vLinkGenConstGroupVariant=vLinkGenVariantHandling/DemoUpd, vLinkGenConstGroupVariant=DemoAppl
          FblBmHdrHeaderGroup (vLinkGenConstSectionGroup):
            vLinkGenConstSectionGroupPosition = 0
            vLinkGenConstSectionGroupInit = NONE
            vLinkGenConstSectionGroupInitStage = ONE
            vLinkGenConstSectionGroupRef = BmHdrHeaderSection
          vLinkGenConstGroupVariantHandling
            DemoFbl (vLinkGenConstGroupVariantSpecifics):
              vLinkGenConstGroupSpecificRegion = FblBmHdrHeader
              vLinkGenConstGroupSpecificVariant = vLinkGenVariantHandling/DemoFbl
              vLinkGenConstGroupSpecificVariant = FblNotStandAloneBm
            DemoUpd_DemoAppl (vLinkGenConstGroupVariantSpecifics):
              vLinkGenConstGroupSpecificRegion = UpdBmHdrHeader
              vLinkGenConstGroupSpecificVariant = vLinkGenVariantHandling/DemoUpd
              vLinkGenConstGroupSpecificVariant = DemoAppl
        RamConstGroup: vLinkGenConstGroupInitCore=0, vLinkGenConstGroupRegion=FblRomArea, vLinkGenConstGroupRamRegion=Ram_RamConstArea/RamConstSection, vLinkGenConstGroupVariant=vLinkGenVariantHandling/DemoBm, vLinkGenConstGroupVariant=vLinkGenVariantHandling/DemoUpd
          RamConstSection (vLinkGenConstSectionGroup):
            vLinkGenConstSectionGroupPosition = 0
            vLinkGenConstSectionGroupInit = COPY_TO_RAM
            vLinkGenConstSectionGroupInitStage = ONE
            vLinkGenConstSectionGroupAlignment = 4
            vLinkGenConstSectionGroupEndAlignment = 4
            vLinkGenConstSectionGroupRef = vLinkGenLinkerSections/RamConstSection
            vLinkGenConstSectionGroupRef = FblManualConstSection
          vLinkGenConstGroupVariantHandling
            3 x vLinkGenConstGroupVariantSpecifics, all with vLinkGenConstGroupSpecificRamRegion=Ram_RamConstArea/RamConstSection:
              DemoBm: vLinkGenConstGroupSpecificVariant=vLinkGenVariantHandling/DemoBm, vLinkGenConstGroupSpecificRegion=BmRomArea
              DemoFbl: vLinkGenConstGroupSpecificRegion=FblRomArea, vLinkGenConstGroupSpecificVariant=vLinkGenVariantHandling/DemoFbl, vLinkGenConstGroupSpecificVariant=FblNotStandAloneBm
              DemoUpd: vLinkGenConstGroupSpecificRegion=ApplRomArea, vLinkGenConstGroupSpecificVariant=vLinkGenVariantHandling/DemoUpd
      MagicFlagGroup (vLinkGenLogicalVarGroup):
        vLinkGenVarGroupPosition = 0
        vLinkGenVarGroupRegion = MagicFlag
        vLinkGenVarGroupVariant = vLinkGenVariantHandling/DemoUpd
        vLinkGenVarGroupVariant = vLinkGenVariantHandling/DemoFbl
        vLinkGenVarGroupVariant = DemoAppl
        vLinkGenVarGroupVariant = vLinkGenVariantHandling/DemoBm
        vLinkGenVarGroupVariant = FblNotStandAloneBm
        MagicFlagSection (vLinkGenVarSectionGroup):
          vLinkGenVarSectionGroupPosition = 0
          vLinkGenVarSectionGroupInit = NONE
          vLinkGenVarSectionGroupInitStage = HARD_RESET_ONLY
          vLinkGenVarSectionGroupAlignment = 16
          vLinkGenVarSectionGroupEndAlignment = 4
          vLinkGenVarSectionGroupRef = vLinkGenLinkerSections/MagicFlagSection
          vLinkGenVarSectionGroupFlag = vLinkGenVarGroupFlags/NOLOAD
      TargetCompilerSpecificOptions_FlashDrv (vLinkGenLogicalSymbolGroup): vLinkGenSymbolGroupPosition=4096, vLinkGenSymbolGroupVariant=vLinkGenVariantHandling/FlashDrv
        StartupEntry (vLinkGenLinkerSymbol): vLinkGenLinkerSymbolPosition=0, vLinkGenLinkerSymbolName=StartupEntry, vLinkGenLinkerSymbolValue=_FlashDrvHeaderGroup_ALL_START
        TriCore_trap_table (vLinkGenLinkerSymbol): vLinkGenLinkerSymbolPosition=0, vLinkGenLinkerSymbolName=TriCore_trap_table, vLinkGenLinkerSymbolValue=_traptab_START
      5 x vLinkGenLogicalConstGroup:
        PresencePatternGroup: vLinkGenConstGroupPosition=1, vLinkGenConstGroupRegion=FblRomLB_PP, vLinkGenConstGroupVariant=vLinkGenVariantHandling/DemoFbl, vLinkGenConstGroupVariant=FblNotStandAloneBm
          Fbl_PP (vLinkGenConstSectionGroup):
            vLinkGenConstSectionGroupPosition = 0
            vLinkGenConstSectionGroupInit = NONE
            vLinkGenConstSectionGroupInitStage = ONE
            vLinkGenConstSectionGroupRef = FblPresencePatternSection
        SlpSpecificGroup: vLinkGenConstGroupPosition=2, vLinkGenConstGroupVariant=vLinkGenVariantHandling/DemoFbl, vLinkGenConstGroupVariant=FblNotStandAloneBm, vLinkGenConstGroupRegion=FblSlpSpecificArea, vLinkGenConstGroupVariant=vLinkGenVariantHandling/DemoUpd, vLinkGenConstGroupVariant=DemoAppl
          vLinkGenConstGroupVariantHandling
            DemoFbl (vLinkGenConstGroupVariantSpecifics):
              vLinkGenConstGroupSpecificRegion = FblSlpSpecificArea
              vLinkGenConstGroupSpecificVariant = vLinkGenVariantHandling/DemoFbl
              vLinkGenConstGroupSpecificVariant = FblNotStandAloneBm
            DemoUpd_DemoAppl (vLinkGenConstGroupVariantSpecifics):
              vLinkGenConstGroupSpecificRegion = ApplSlpSpecificArea
              vLinkGenConstGroupSpecificVariant = vLinkGenVariantHandling/DemoUpd
              vLinkGenConstGroupSpecificVariant = DemoAppl
          FblSlpHeadersGroup (vLinkGenConstSectionGroup):
            vLinkGenConstSectionGroupPosition = 0
            vLinkGenConstSectionGroupInit = NONE
            vLinkGenConstSectionGroupInitStage = ONE
            vLinkGenConstSectionGroupRef = SlpHeaderSection
          FblSlpConstsGroup (vLinkGenConstSectionGroup):
            vLinkGenConstSectionGroupPosition = 0
            vLinkGenConstSectionGroupInit = NONE
            vLinkGenConstSectionGroupInitStage = ONE
            vLinkGenConstSectionGroupRef = SlpConstSection
        Demo_ApplVect: vLinkGenConstGroupPosition=5, vLinkGenConstGroupRegion=ApplRom_ApplVect, vLinkGenConstGroupVariant=vLinkGenVariantHandling/DemoFbl, vLinkGenConstGroupVariant=FblNotStandAloneBm, vLinkGenConstGroupVariant=DemoAppl, vLinkGenConstGroupVariant=vLinkGenVariantHandling/DemoUpd
          APPLVECT (vLinkGenConstSectionGroup):
            vLinkGenConstSectionGroupSize = 8
            vLinkGenConstSectionGroupAlignment = 4
            vLinkGenConstSectionGroupPosition = 0
            vLinkGenConstSectionGroupInit = NONE
            vLinkGenConstSectionGroupInitStage = ONE
            vLinkGenConstSectionGroupRef = ApplVectSection
        BmHeaderGroup: vLinkGenConstGroupPosition=0, vLinkGenConstGroupRegion=BmHeader, vLinkGenConstGroupVariant=vLinkGenVariantHandling/DemoBm, vLinkGenConstGroupVariant=FblNotStandAloneBm
          BmHeaderSectionGroup (vLinkGenConstSectionGroup):
            vLinkGenConstSectionGroupPosition = 0
            vLinkGenConstSectionGroupInit = NONE
            vLinkGenConstSectionGroupInitStage = ONE
            vLinkGenConstSectionGroupRef = BmHeaderSection
        Const_Default_FlashDrv: vLinkGenConstGroupPosition=50, vLinkGenConstGroupRegion=FlashDrvArea, vLinkGenConstGroupVariant=vLinkGenVariantHandling/FlashDrv, vLinkGenConstGroupVariant=FlashDrv_Xd
          4 x vLinkGenConstSectionGroup, all with vLinkGenConstSectionGroupPosition=0, vLinkGenConstSectionGroupInit=NONE, vLinkGenConstSectionGroupInitStage=ONE:
            text: vLinkGenConstSectionGroupFlag=vLinkGenConstGroupFlags/EXECUTE, vLinkGenConstSectionGroupRef=vLinkGenLinkerSections/text, vLinkGenConstSectionGroupRef=text_all
            rodata: vLinkGenConstSectionGroupFlag=vLinkGenConstGroupFlags/READ, vLinkGenConstSectionGroupRef=vLinkGenLinkerSections/rodata, vLinkGenConstSectionGroupRef=rodata_all
            srodata: vLinkGenConstSectionGroupFlag=vLinkGenConstGroupFlags/READ, vLinkGenConstSectionGroupFlag=vLinkGenConstGroupFlags/SMALL_ADDRESSING, vLinkGenConstSectionGroupRef=vLinkGenLinkerSections/srodata, vLinkGenConstSectionGroupRef=srodata_all
            zrodata: vLinkGenConstSectionGroupFlag=vLinkGenConstGroupFlags/READ, vLinkGenConstSectionGroupFlag=vLinkGenConstGroupFlags/ABSOLUTE_ADDRESSING, vLinkGenConstSectionGroupRef=vLinkGenLinkerSections/zrodata, vLinkGenConstSectionGroupRef=zrodata_all
      ApplVectSymbols (vLinkGenLogicalSymbolGroup):
        vLinkGenSymbolGroupPosition = 5
        vLinkGenSymbolGroupVariant = vLinkGenVariantHandling/DemoFbl
        vLinkGenSymbolGroupVariant = vLinkGenVariantHandling/DemoUpd
        vLinkGenSymbolGroupVariant = FblNotStandAloneBm
        vLinkGenSymbolGroupVariant = DemoAppl
        vLinkGenSymbolGroupVariant = vLinkGenVariantHandling/DemoBm
        RESETVECT (vLinkGenLinkerSymbol): vLinkGenLinkerSymbolName=RESETVECT, vLinkGenLinkerSymbolValue=brsStartupEntry, vLinkGenLinkerSymbolPosition=0
        RESETVECT_1 (vLinkGenLinkerSymbol): vLinkGenLinkerSymbolName=start, vLinkGenLinkerSymbolValue=brsStartupEntry, vLinkGenLinkerSymbolPosition=0
      3 x vLinkGenLogicalConstGroup:
        FlashDrvHeaderGroup: vLinkGenConstGroupPosition=10, vLinkGenConstGroupVariant=vLinkGenVariantHandling/FlashDrv, vLinkGenConstGroupVariant=FlashDrv_Xd, vLinkGenConstGroupRegion=FlashDrvArea
          FlashDrvHeaderSectionGroup (vLinkGenConstSectionGroup):
            vLinkGenConstSectionGroupPosition = 0
            vLinkGenConstSectionGroupInit = NONE
            vLinkGenConstSectionGroupInitStage = ONE
            vLinkGenConstSectionGroupRef = FlashDrvHeaderSection
        ASW_INFO: vLinkGenConstGroupPosition=5, vLinkGenConstGroupRegion=ApplRomBlock_ASW_INFO, vLinkGenConstGroupVariant=vLinkGenVariantHandling/DemoFbl
          ASW_---------_PRIVATE_AREA (vLinkGenConstSectionGroup):
            vLinkGenConstSectionGroupPosition = 0
            vLinkGenConstSectionGroupInit = NONE
            vLinkGenConstSectionGroupInitStage = ONE
            vLinkGenConstSectionGroupAlignment = 4
            vLinkGenConstSectionGroupRef = asw_sw_version_area
        BM_INFO: vLinkGenConstGroupPosition=5, vLinkGenConstGroupRegion=BmRomBlock_BM_INFO, vLinkGenConstGroupVariant=vLinkGenVariantHandling/DemoFbl
          BM_---------_PRIVATE_AREA (vLinkGenConstSectionGroup):
            vLinkGenConstSectionGroupPosition = 0
            vLinkGenConstSectionGroupInit = NONE
            vLinkGenConstSectionGroupInitStage = ONE
            vLinkGenConstSectionGroupAlignment = 4
            vLinkGenConstSectionGroupRef = bm_sw_version_area
      Rom_CalMemoryArea (vLinkGenMemoryRegion):
        vLinkGenMemoryRegionAddrOffset = 655360
        vLinkGenMemoryRegionSize = 196608
        vLinkGenMemoryRegionAddress = 2151284736
        vLinkGenMemoryRegionHwRegion = PFlash1_Cached
        CalRomBlock_CAL_INFO (vLinkGenMemoryRegionBlock):
          vLinkGenMemoryRegionBlockPosition = 1
          vLinkGenMemoryRegionBlockSize = 32
          vLinkGenMemoryRegionBlockAddress = 2151481248
          vLinkGenMemoryRegionBlockBoundary = LOWER
          vLinkGenMemoryRegionBlockInitStage = NONE
        CalRomBlock_CAL_DELIB (vLinkGenMemoryRegionBlock):
          vLinkGenMemoryRegionBlockPosition = 0
          vLinkGenMemoryRegionBlockSize = 196512
          vLinkGenMemoryRegionBlockAddress = 2151284736
          vLinkGenMemoryRegionBlockBoundary = LOWER
          vLinkGenMemoryRegionBlockInitStage = NONE
      3 x vLinkGenLogicalConstGroup, all with vLinkGenConstGroupPosition=5, vLinkGenConstGroupVariant=vLinkGenVariantHandling/DemoFbl:
        BTLD_INFO: vLinkGenConstGroupRegion=Rom_FblMemoryArea/Rom_FblMemoryArea
          BTLD_---------_PRIVATE_AREA (vLinkGenConstSectionGroup):
            vLinkGenConstSectionGroupPosition = 0
            vLinkGenConstSectionGroupInit = NONE
            vLinkGenConstSectionGroupInitStage = ONE
            vLinkGenConstSectionGroupAlignment = 4
            vLinkGenConstSectionGroupRef = btld_sw_version_area
        CAL_INFO: vLinkGenConstGroupRegion=CalRomBlock_CAL_INFO
          CAL_---------_PRIVATE_AREA (vLinkGenConstSectionGroup):
            vLinkGenConstSectionGroupPosition = 0
            vLinkGenConstSectionGroupInit = NONE
            vLinkGenConstSectionGroupInitStage = ONE
            vLinkGenConstSectionGroupAlignment = 4
            vLinkGenConstSectionGroupRef = cal_sw_version_area
        CAL_DELIB: vLinkGenConstGroupRegion=CalRomBlock_CAL_DELIB
          CAL_DELIB_--------- (vLinkGenConstSectionGroup):
            vLinkGenConstSectionGroupPosition = 0
            vLinkGenConstSectionGroupInit = NONE
            vLinkGenConstSectionGroupInitStage = ONE
            vLinkGenConstSectionGroupAlignment = 4
            vLinkGenConstSectionGroupRef = cal_delib_area
      Rom_ApplMemoryArea_PF1 (vLinkGenMemoryRegion):
        vLinkGenMemoryRegionAddrOffset = 0
        vLinkGenMemoryRegionSize = 655360
        vLinkGenMemoryRegionAddress = 2150629376
        vLinkGenMemoryRegionHwRegion = PFlash1_Cached
        UpdBmHdrHeader (vLinkGenMemoryRegionBlock):
          vLinkGenMemoryRegionBlockPosition = 1
          vLinkGenMemoryRegionBlockSize = 32
          vLinkGenMemoryRegionBlockBoundary = UPPER
          vLinkGenMemoryRegionBlockInitStage = NONE
          vLinkGenMemoryRegionBlockAddress = 2151284704
        ApplRomBlock_ASW_INFO (vLinkGenMemoryRegionBlock):
          vLinkGenMemoryRegionBlockPosition = 0
          vLinkGenMemoryRegionBlockSize = 64
          vLinkGenMemoryRegionBlockAddress = 2151284640
          vLinkGenMemoryRegionBlockBoundary = UPPER
          vLinkGenMemoryRegionBlockInitStage = NONE
      Rom_HwDataMemoryArea_PF1 (vLinkGenMemoryRegion):
        vLinkGenMemoryRegionAddrOffset = 1032192
        vLinkGenMemoryRegionSize = 16384
        vLinkGenMemoryRegionAddress = 2151661568
        vLinkGenMemoryRegionHwRegion = PFlash1_Cached
        HwDataDID_--------- (vLinkGenMemoryRegionBlock):
          vLinkGenMemoryRegionBlockPosition = 0
          vLinkGenMemoryRegionBlockSize = 112
          vLinkGenMemoryRegionBlockAddress = 2151661568
          vLinkGenMemoryRegionBlockBoundary = LOWER
          vLinkGenMemoryRegionBlockInitStage = NONE
        HwDataDID_Customer (vLinkGenMemoryRegionBlock):
          vLinkGenMemoryRegionBlockPosition = 1
          vLinkGenMemoryRegionBlockSize = 256
          vLinkGenMemoryRegionBlockAddress = 2151661680
          vLinkGenMemoryRegionBlockBoundary = LOWER
          vLinkGenMemoryRegionBlockInitStage = NONE
      DID_CUSTOMER (vLinkGenLogicalConstGroup): vLinkGenConstGroupPosition=5, vLinkGenConstGroupRegion=HwDataDID_Customer, vLinkGenConstGroupVariant=vLinkGenVariantHandling/DemoFbl
        HWDATA_DID_CUSTOMER_AREA (vLinkGenConstSectionGroup):
          vLinkGenConstSectionGroupPosition = 0
          vLinkGenConstSectionGroupInit = NONE
          vLinkGenConstSectionGroupInitStage = ONE
          vLinkGenConstSectionGroupRef = hwData_did_customer_area
      DID_--------- (vLinkGenLogicalConstGroup): vLinkGenConstGroupPosition=5, vLinkGenConstGroupRegion=HwDataDID_---------, vLinkGenConstGroupVariant=vLinkGenVariantHandling/DemoFbl
        HWDATA_DID_---------_AREA (vLinkGenConstSectionGroup):
          vLinkGenConstSectionGroupPosition = 0
          vLinkGenConstSectionGroupInit = NONE
          vLinkGenConstSectionGroupInitStage = ONE
          vLinkGenConstSectionGroupRef = hwData_did_---------_area
      Rom_HwDataMemoryArea_PF3 (vLinkGenMemoryRegion):
        vLinkGenMemoryRegionAddrOffset = 1032192
        vLinkGenMemoryRegionSize = 64
        vLinkGenMemoryRegionAddress = 2157953024
        vLinkGenMemoryRegionHwRegion = PFlash3_Cached
        HwData_InactiveBank (vLinkGenMemoryRegionBlock):
          vLinkGenMemoryRegionBlockPosition = 0
          vLinkGenMemoryRegionBlockSize = 16
          vLinkGenMemoryRegionBlockAddress = 2157953024
          vLinkGenMemoryRegionBlockBoundary = LOWER
          vLinkGenMemoryRegionBlockInitStage = NONE
      DID_INACTIVEBANK (vLinkGenLogicalConstGroup): vLinkGenConstGroupPosition=5, vLinkGenConstGroupRegion=HwData_InactiveBank, vLinkGenConstGroupVariant=vLinkGenVariantHandling/DemoFbl
        HWDATA_DID_INACTIVEBANK_AREA (vLinkGenConstSectionGroup):
          vLinkGenConstSectionGroupPosition = 0
          vLinkGenConstSectionGroupInit = NONE
          vLinkGenConstSectionGroupInitStage = ONE
          vLinkGenConstSectionGroupRef = hwData_did_InactiveBank_area
    vLinkGenPublishedInformation: vLinkGenDefaultVarGroupAlignment=16, vLinkGenGeneration=2, vLinkGenDuplicatedLabels=false
      vLinkGenConstGroupFlags
        7 x vLinkGenConstGroupFlag:
          EXECUTE
          READ
          VLE_CODE
          PCP_CODE
          SMALL_ADDRESSING
          ABSOLUTE_ADDRESSING
          NOLOAD
      vLinkGenVarGroupFlags
        7 x vLinkGenVarGroupFlag:
          EXECUTE
          READ
          WRITE
          LOADABLE
          SMALL_ADDRESSING
          ABSOLUTE_ADDRESSING
          NOLOAD
      vLinkGenRegionBlockFlags
        3 x vLinkGenRegionBlockFlag:
          EXECUTE
          READ
          WRITE
      vLinkGenConstSectionFlags
        KEEP (vLinkGenConstSectionFlag)
      vLinkGenVarSectionFlags
        KEEP (vLinkGenVarSectionFlag)
    vLinkGenGeneral: vLinkGenFileGeneration=ONE_FILE_PER_VARIANT, vLinkGenEntrySymbol=StartupEntry
    vLinkGenVariantHandling
      7 x vLinkGenVariant:
        DemoBm
        DemoFbl
        FlashDrv
        DemoAppl
        DemoUpd
        FblNotStandAloneBm
        FlashDrv_Xd

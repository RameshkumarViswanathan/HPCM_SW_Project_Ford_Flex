AUTOSAR XML (schema 00048)
package /ActiveEcuC
  module config CanIf: implementation-config-variant=VARIANT-PRE-COMPILE, module-description=CanIf_Impl
    CanIfCtrlDrvCfg_7d254554 (CanIfCtrlDrvCfg): CanIfCtrlDrvTxCancellation=false, CanIfCtrlDrvInitHohConfigRef=CanIfInitHohCfg, CanIfCtrlDrvNameRef=CanGeneral
      CT_DemoFBL_Vector_SLP3_ALPINE_RIGHT_05fb22d0 (CanIfCtrlCfg):
        CanIfCtrlId = 1
        CanIfCtrlWakeupSupport = false
        CanIfCtrlJ1939DynAddrSupport = DISABLED
        CanIfCtrlCanCtrlRef = CT_DemoFBL_Vector_SLP3_ALPINE_RIGHT_05fb22d0
        CanIfCtrlTrcvCfgRef = CanIfTrcvCfg
      CT_DemoFBL_Vector_SLP3_216858f6 (CanIfCtrlCfg): CanIfCtrlId=0, CanIfCtrlWakeupSupport=false, CanIfCtrlJ1939DynAddrSupport=DISABLED, CanIfCtrlCanCtrlRef=CT_DemoFBL_Vector_SLP3_216858f6
    CanIfDispatchCfg:
      CanIfDispatchUserCtrlBusOffName = FblCw_ControllerBusOff
      CanIfDispatchUserCtrlBusOffUL = CDD
      CanIfDispatchUserCtrlModeIndicationName = FblCw_ControllerModeIndication
      CanIfDispatchUserCtrlModeIndicationUL = CDD
      CanIfDispatchUserTrcvModeIndicationUL = CDD
      CanIfDispatchUserTrcvModeIndicationName = Appl_TrcvModeIndication
    CanIfInitCfg
      CanIfInitHohCfg: CanIfInitRefCfgSet=CanConfigSet
        CN_DemoFBL_Vector_SLP3_dfd96cca_Rx (CanIfHrhCfg): CanIfHrhSoftwareFilter=true, CanIfHrhCanCtrlIdRef=CT_DemoFBL_Vector_SLP3_216858f6, CanIfHrhIdSymRef=CN_DemoFBL_Vector_SLP3_dfd96cca_Rx
        CN_DemoFBL_Vector_SLP3_ALPINE_RIGHT_962a16ee_Tx (CanIfHthCfg): CanIfHthCanCtrlIdRef=CT_DemoFBL_Vector_SLP3_ALPINE_RIGHT_05fb22d0, CanIfHthIdSymRef=CN_DemoFBL_Vector_SLP3_ALPINE_RIGHT_962a16ee_Tx
        CN_DemoFBL_Vector_SLP3_ALPINE_RIGHT_259ca90a_Rx (CanIfHrhCfg):
          CanIfHrhSoftwareFilter = true
          CanIfHrhCanCtrlIdRef = CT_DemoFBL_Vector_SLP3_ALPINE_RIGHT_05fb22d0
          CanIfHrhIdSymRef = CN_DemoFBL_Vector_SLP3_ALPINE_RIGHT_259ca90a_Rx
        CN_DemoFBL_Vector_SLP3_abba4211_Tx (CanIfHthCfg): CanIfHthCanCtrlIdRef=CT_DemoFBL_Vector_SLP3_216858f6, CanIfHthIdSymRef=CN_DemoFBL_Vector_SLP3_abba4211_Tx
      CHNL_3b54cc70 (CanIfBufferCfg):
        CanIfBufferSize = 2
        CanIfTxBufferHandlingType = PRIO_BY_CANID
        CanIfTxBufferMappedTxPdus = 2
        CanIfTxBufferMaxPduLength = 8
        CanIfBufferHthRef = CN_DemoFBL_Vector_SLP3_abba4211_Tx
      4 x CanIfRxPduCfg, all with CanIfRxPduDlc=8, CanIfRxPduReadData=false, CanIfRxPduReadNotifyStatus=false, CanIfRxPduDlcCheck=false:
        Functional_CAN_Tp_oDemoFBL_Vector_SLP3_ALPINE_RIGHT_e4969e4a_Rx: CanIfRxPduCanId=417018865, CanIfRxPduCanIdType=EXTENDED_NO_FD_CAN, CanIfRxPduUserRxIndicationName=CanTp_RxIndication, CanIfRxPduUserRxIndicationType=PDUID_PDUINFOPTR, CanIfRxPduUserRxIndicationUL=CAN_TP, CanIfRxPduId=4, CanIfRxPduHrhIdRef=CN_DemoFBL_Vector_SLP3_ALPINE_RIGHT_259ca90a_Rx, CanIfRxPduRef=Functional_CAN_Tp_oDemoFBL_Vector_SLP3_ALPINE_RIGHT_66de96ef_Rx
        Demo_0_CAN_FD_Request_Tp_oDemoFBL_Vector_SLP3_20_507d1247_Rx: CanIfRxPduCanId=1442, CanIfRxPduCanIdType=STANDARD_NO_FD_CAN, CanIfRxPduUserRxIndicationName=CanTp_RxIndication, CanIfRxPduUserRxIndicationType=PDUID_PDUINFOPTR, CanIfRxPduUserRxIndicationUL=CAN_TP, CanIfRxPduId=2, CanIfRxPduHrhIdRef=CN_DemoFBL_Vector_SLP3_dfd96cca_Rx, CanIfRxPduRef=Demo_0_CAN_FD_Request_Tp_oDemoFBL_Vector_SLP3_20_f2ebe614_Rx
        Functional_CAN_FD_Tp_oDemoFBL_Vector_SLP3_20_12cf71bb_Rx: CanIfRxPduCanId=1913, CanIfRxPduCanIdType=STANDARD_NO_FD_CAN, CanIfRxPduUserRxIndicationName=CanTp_RxIndication, CanIfRxPduUserRxIndicationType=PDUID_PDUINFOPTR, CanIfRxPduUserRxIndicationUL=CAN_TP, CanIfRxPduId=1, CanIfRxPduHrhIdRef=CN_DemoFBL_Vector_SLP3_dfd96cca_Rx, CanIfRxPduRef=Functional_CAN_FD_Tp_oDemoFBL_Vector_SLP3_20_883488d5_Rx
        Demo_0_XCP_CAN_Request_oDemoFBL_Vector_SLP3_2b3cc8ca_Rx: CanIfRxPduCanId=1980, CanIfRxPduCanIdType=STANDARD_CAN, CanIfRxPduUserRxIndicationName=Xcp_CanIfRxIndication, CanIfRxPduUserRxIndicationUL=XCP, CanIfRxPduId=0, CanIfRxPduHrhIdRef=CN_DemoFBL_Vector_SLP3_dfd96cca_Rx, CanIfRxPduRef=Demo_0_XCP_CAN_Request_oDemoFBL_Vector_SLP3_64ae11cc_Rx
      Demo_1_CAN_Response_Tp_oDemoFBL_Vector_SLP3_ALPINE_RIGHT_c4906a5a_Tx (CanIfTxPduCfg):
        CanIfTxPduCanId = 417001962
        CanIfTxPduCanIdType = EXTENDED_CAN
        CanIfTxPduDlc = 8
        CanIfTxPduUserTxConfirmationName = CanTp_TxConfirmation
        CanIfTxPduUserTxConfirmationUL = CAN_TP
        CanIfTxPduId = 3
        CanIfTxPduReadNotifyStatus = false
        CanIfTxPduType = STATIC
        CanIfTxPduTruncation = true
        CanIfTxPduBufferRef = CHNL_f13a08d4
        CanIfTxPduRef = Demo_1_CAN_Response_Tp_oDemoFBL_Vector_SLP3_ALPINE_RIGHT_54cb25de_Tx
      Demo_0_CAN_FD_Response_Tp_oDemoFBL_Vector_SLP3_20_cf88ffc8_Tx (CanIfTxPduCfg):
        CanIfTxPduCanId = 1458
        CanIfTxPduCanIdType = STANDARD_CAN
        CanIfTxPduDlc = 8
        CanIfTxPduUserTxConfirmationName = CanTp_TxConfirmation
        CanIfTxPduUserTxConfirmationUL = CAN_TP
        CanIfTxPduId = 1
        CanIfTxPduReadNotifyStatus = false
        CanIfTxPduType = STATIC
        CanIfTxPduTruncation = true
        CanIfTxPduBufferRef = CHNL_3b54cc70
        CanIfTxPduRef = Demo_0_CAN_FD_Response_Tp_oDemoFBL_Vector_SLP3_20_ee1db9f7_Tx
      Demo_1_CAN_Request_Tp_oDemoFBL_Vector_SLP3_ALPINE_RIGHT_aab39190_Rx (CanIfRxPduCfg):
        CanIfRxPduCanId = 417000177
        CanIfRxPduCanIdType = EXTENDED_NO_FD_CAN
        CanIfRxPduDlc = 8
        CanIfRxPduUserRxIndicationName = CanTp_RxIndication
        CanIfRxPduUserRxIndicationType = PDUID_PDUINFOPTR
        CanIfRxPduUserRxIndicationUL = CAN_TP
        CanIfRxPduId = 5
        CanIfRxPduReadData = false
        CanIfRxPduReadNotifyStatus = false
        CanIfRxPduDlcCheck = false
        CanIfRxPduHrhIdRef = CN_DemoFBL_Vector_SLP3_ALPINE_RIGHT_259ca90a_Rx
        CanIfRxPduRef = Demo_1_CAN_Request_Tp_oDemoFBL_Vector_SLP3_ALPINE_RIGHT_8bdd5adc_Rx
      CHNL_f13a08d4 (CanIfBufferCfg):
        CanIfBufferSize = 2
        CanIfTxBufferHandlingType = PRIO_BY_CANID
        CanIfTxBufferMappedTxPdus = 2
        CanIfTxBufferMaxPduLength = 8
        CanIfBufferHthRef = CN_DemoFBL_Vector_SLP3_ALPINE_RIGHT_962a16ee_Tx
      Demo_0_XCP_CAN_Response_oDemoFBL_Vector_SLP3_6533c86c_Tx (CanIfTxPduCfg):
        CanIfTxPduCanId = 1981
        CanIfTxPduCanIdType = STANDARD_CAN
        CanIfTxPduDlc = 8
        CanIfTxPduUserTxConfirmationName = Xcp_CanIfTxConfirmation
        CanIfTxPduUserTxConfirmationUL = XCP
        CanIfTxPduId = 0
        CanIfTxPduReadNotifyStatus = false
        CanIfTxPduType = STATIC
        CanIfTxPduTruncation = true
        CanIfTxPduBufferRef = CHNL_3b54cc70
        CanIfTxPduRef = Demo_0_XCP_CAN_Response_oDemoFBL_Vector_SLP3_3d0163c6_Tx
      XCP_ALP_RIGHT_Rx (CanIfRxPduCfg):
        CanIfRxPduDlcCheck = false
        CanIfRxPduCanIdType = EXTENDED_NO_FD_CAN
        CanIfRxPduDlc = 8
        CanIfRxPduId = 3
        CanIfRxPduReadData = false
        CanIfRxPduReadNotifyStatus = false
        CanIfRxPduUserRxIndicationName = Xcp_CanIfRxIndication
        CanIfRxPduUserRxIndicationUL = XCP
        CanIfRxPduCanId = 507068650
        CanIfRxPduHrhIdRef = CN_DemoFBL_Vector_SLP3_ALPINE_RIGHT_259ca90a_Rx
        CanIfRxPduRef = XCP_ALPINE_RIGHT_Rx
      XCP_ALP_RIGHT_TX (CanIfTxPduCfg):
        CanIfTxPduCanId = 507330794
        CanIfTxPduCanIdType = EXTENDED_CAN
        CanIfTxPduDlc = 8
        CanIfTxPduId = 2
        CanIfTxPduReadNotifyStatus = false
        CanIfTxPduType = STATIC
        CanIfTxPduUserTxConfirmationUL = XCP
        CanIfTxPduTruncation = true
        CanIfTxPduUserTxConfirmationName = Xcp_CanIfTxConfirmation
        CanIfTxPduBufferRef = CHNL_f13a08d4
        CanIfTxPduRef = XCP_ALPINE_RIGHT_Tx
    CanIfPrivateCfg:
      CanIfPrivateSoftwareFilterType = LINEAR
      CanIfPrivateDlcCheck = false
      CanIfSupportTTCAN = false
      CanIfTransceiverMapping = false
      CanIfTransceiverHandling = true
      CanIfSupportExtendedIds = true
      CanIfSupportNmOsek = false
      CanIfTxBufferType = BYTE_QUEUE
      CanIfWakeupSupport = false
      CanIfStaticFdTxBufferSupport = false
      CanIfRxSearchConsiderMsgType = true
      CanIfTxBufferFifoSupport = false
      CanIfSetPduReceptionModeSupport = false
      CanIfCheckWakeupCanRetType = false
      CanIfDataChecksumRxSupport = false
      CanIfDataChecksumTxSupport = false
    CanIfPublicCfg:
      CanIfPublicPnSupport = false
      CanIfPublicCddHeaderFile = CanIf_Cdd.h
      CanIfPublicVersionInfoApi = false
      CanIfPublicCancelTransmitSupport = false
      CanIfPublicDevErrorDetect = true
      CanIfPublicHandleTypeEnum = UINT8
      CanIfPublicMultipleDrvSupport = false
      CanIfPublicNumberOfCanHwUnits = 1
      CanIfPublicReadRxPduDataApi = false
      CanIfPublicReadRxPduNotifyStatusApi = false
      CanIfPublicReadTxPduNotifyStatusApi = false
      CanIfPublicSetDynamicTxIdApi = false
      CanIfPublicTxBuffering = true
      CanIfPublicTxConfirmPollingSupport = false
      CanIfPublicWakeupCheckValidSupport = false
      CanIfPnWakeupTxPduFilterSupport = false
      CanIfPnTrcvHandlingSupport = false
      CanIfJ1939DynAddrSupport = DISABLED
      CanIfSafeBswChecks = false
      CanIfBusMirroringSupport = false
      CanIfEnableSecurityEventReporting = false
      CanIfSupportCanDrvAsr440 = false
      CanIfPublicChangeBaudrateSupport = false
      CanIfSetBaudrateApi = false
      CanIfPublicCddHeaderFile = Appl_stub.h
    CanIfTrcvDrvCfg
      CanIfTrcvCfg: CanIfTrcvId=0, CanIfTrcvWakeupSupport=false, CanIfTrcvCanTrcvRef=CanTrcvChannel_0

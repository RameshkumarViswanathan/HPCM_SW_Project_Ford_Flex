AUTOSAR XML (schema 4-0-3)
package /Ford_Traction_Inverter_project
  ecuc value collection Configuration: ecuc-values=OsRTA
  module config OsRTA: definition=Os
    OsOS:
      OsNumberOfCores = 3
      OsScalabilityClass = SC3
      OsStatus = EXTENDED
      OsStackMonitoring = false
      OsUseGetServiceId = true
      OsUseParameterAccess = true
      OsSuppressVectorGen = false
      OsCyclesPerSecond = 300000000
      OsUseResScheduler = true
      OsTicksPerSecond = 100000000
      OsDefaultInterrupt = DefaultInterruptHandler
      OsHooks: OsProtectionHook=true, OsShutdownHook=true, OsStartupHook=true, OsPreTaskHook=false, OsPostTaskHook=false, OsStackFaultHook=false, OsErrorHook=true
      26 x Param:
        meter_execution: Value=true
        no_timing_protection: Value=true
        std_sc34_checks: Value=true
        core_local: Value=false
        lightweight: Value=true
        no_upward_activation: Value=true
        no_chain: Value=true
        optimize_schedule: Value=true
        sc234_alarmcallbacks: Value=false
        no_ecc_activate_in_wait: Value=true
        function_protection: Value=true
        no_memory_protection: Value=true
        protection_allows_os_reads: Value=true
        no_service_protection: Value=true
        no_terminate_application: Value=false
        only_terminate_untrusted: Value=false
        monitor_activations: Value=true
        delayed_tasks: Value=false
        task_lifetime_hooks: Value=true
        task_activation_hooks: Value=true
        isr_lifetime_hooks: Value=true
        spinlock_info: Value=true
        spinlock_std_check: Value=false
        unchecked_spinlocks: Value=false
        stack_sampling: Value=false
        memmap_level: Value=NONE
    8 x OsTask, all with OsTaskSchedule=FULL, OsTaskActivation=2, OsTaskResourceRef=RES_USER_CORE0, OsTaskAccessingApplication=OsAppCore0:
      TaskA0_1ms_Core0: OsTaskPriority=20, OsTaskCanCallSchedule=false
      TaskB0_2ms_Core0: OsTaskPriority=19, OsTaskCanCallSchedule=false
      TaskC0_8ms_Core0: OsTaskPriority=18, OsTaskCanCallSchedule=false
      TaskD0_10ms_Core0: OsTaskPriority=17, OsTaskCanCallSchedule=false
      TaskE0_16ms_Core0: OsTaskPriority=16
      TaskF0_30ms_Core0: OsTaskPriority=15, OsTaskCanCallSchedule=false
      TaskG0_50ms_Core0: OsTaskPriority=14, OsTaskCanCallSchedule=false
      TaskH0_100ms_Core0: OsTaskPriority=13, OsTaskCanCallSchedule=false
    Counter_1ms (OsCounter):
      OsCounterMinCycle = 1
      OsCounterTicksPerBase = 1
      OsCounterType = SOFTWARE
      OsSecondsPerTick = 0.001
      OsCounterMaxAllowedValue = 100
      OsCounterAccessingApplication = OsAppCore0
    OSDEFAULTAPPMODE (OsAppMode)
    OsAppCore0 (OsApplication):
      OsTrusted = true
      OsTrustedApplicationDelayTimingViolationCall = false
      OsTrustedApplicationWithProtection = false
      OsApplicationCoreAssignment = 0
      OsAppIsrRef = DMACH34SR_ISR
      OsAppIsrRef = GTMATOM0SR1_ISR
      OsAppScheduleTableRef = FORD_ScheduleTable_Core0
      OsAppTaskRef = Os_Init_Task_Core0
      OsAppTaskRef = Task_BGTask_Core0
      OsAppTaskRef = TaskA0_1ms_Core0
      OsAppTaskRef = TaskH0_100ms_Core0
      OsAppTaskRef = TaskG0_50ms_Core0
      OsAppTaskRef = TaskF0_30ms_Core0
      OsAppTaskRef = TaskE0_16ms_Core0
      OsAppTaskRef = TaskD0_10ms_Core0
      OsAppTaskRef = TaskC0_8ms_Core0
      OsAppTaskRef = TaskB0_2ms_Core0
      OsAppCounterRef = SystemTimer
      OsAppIsrRef = GTMATOM0SR0_ISR
      OsAppIsrRef = GTMATOM0SR2_ISR
      OsAppIsrRef = RTOS_TRAP_CL_7
      OsAppIsrRef = RTOS_TRAP_CL_6
      OsAppIsrRef = RTOS_TRAP_CL_5
      OsAppIsrRef = RTOS_TRAP_CL_4
      OsAppIsrRef = RTOS_TRAP_CL_3
      OsAppIsrRef = RTOS_TRAP_CL_2
      OsAppIsrRef = RTOS_TRAP_CL_1
      OsAppIsrRef = RTOS_TRAP_CL_0
      OsAppIsrRef = WdgGptSrvISR
      OsAppIsrRef = OSK_OsTickISR
      OsAppIsrRef = QSPI2ERR_ISR
      OsAppIsrRef = SCUERUSR0_ISR
      OsAppCounterRef = Counter_1ms
      OsAppAlarmRef = init_core0
      OsAppIsrRef = DMACH{28..32}SR_ISR
      OsAppIsrRef = DMACH{12..27}SR_ISR
      OsAppIsrRef = GTMATOM0SR3_ISR
      OsAppIsrRef = DMACH11SR_ISR
      OsAppIsrRef = DMACH33SR_ISR
      OsAppIsrRef = DMACH{35..37}SR_ISR
      OsAppIsrRef = CAN1SR0_ISR
      OsAppIsrRef = CAN0SR1_ISR
      OsAppIsrRef = CAN0SR{10..15}_ISR
      OsAppIsrRef = CAN0SR{2..9}_ISR
      OsAppIsrRef = CAN0SR0_ISR
      OsAppIsrRef = CAN1SR{1..15}_ISR
      OsApplicationHooks: OsAppStartupHook=true, OsAppShutdownHook=true, OsAppErrorHook=true
      31 x OsApplicationTrustedFunction:
        UserApplResetEndInit_Core0: OsTrustedFunctionName=UserApplResetEndInit_Core0
        UserApplSetEndInit_Core0: OsTrustedFunctionName=UserApplSetEndInit_Core0
        UserWritePeripheral32_Core0: OsTrustedFunctionName=UserWritePeripheral32_Core0
        UserModifyPeripheral32_Core0: OsTrustedFunctionName=UserModifyPeripheral32_Core0
        UserReadPeripheral32_Core0: OsTrustedFunctionName=UserReadPeripheral32_Core0
        UserApplSafetyResetEndInit_Timed_Core0: OsTrustedFunctionName=UserApplSafetyResetEndInit_Timed_Core0
        UserApplSafetySetEndInit_Timed_Core0: OsTrustedFunctionName=UserApplSafetySetEndInit_Timed_Core0
        UserDmaChClrIntrFlags_Core0: OsTrustedFunctionName=UserDmaChClrIntrFlags_Core0
        UserDmaGetTransferIntStatus_Core0: OsTrustedFunctionName=UserDmaGetTransferIntStatus_Core0
        UserDmaSetSourceAddr_Core0: OsTrustedFunctionName=UserDmaSetSourceAddr_Core0
        UserDmaSetDestAddr_Core0: OsTrustedFunctionName=UserDmaSetDestAddr_Core0
        UserDmaCfgIntControl_Core0: OsTrustedFunctionName=UserDmaCfgIntControl_Core0
        UserDmaSetDataWidth_Core0: OsTrustedFunctionName=UserDmaSetDataWidth_Core0
        UserDmaSetTxCount_Core0: OsTrustedFunctionName=UserDmaSetTxCount_Core0
        UserDmaEnableChIntrTrigger_Core0: OsTrustedFunctionName=UserDmaEnableChIntrTrigger_Core0
        UserDmaEnableIntr_Core0: OsTrustedFunctionName=UserDmaEnableIntr_Core0
        UserDmaSetAdicr_Core0: OsTrustedFunctionName=UserDmaSetAdicr_Core0
        UserDmaEnableHwTransfer_Core0: OsTrustedFunctionName=UserDmaEnableHwTransfer_Core0
        UserDmaDisableIntr_Core0: OsTrustedFunctionName=UserDmaDisableIntr_Core0
        UserDmaChClrIntctEtrlFlags_Core0: OsTrustedFunctionName=UserDmaChClrIntctEtrlFlags_Core0
        UserDmaGetTransReqLostFlag_Core0: OsTrustedFunctionName=UserDmaGetTransReqLostFlag_Core0
        UserDmaClrErrFlags_Core0: OsTrustedFunctionName=UserDmaClrErrFlags_Core0
        UserDmaDisableChIntrTrigger_Core0: OsTrustedFunctionName=UserDmaDisableChIntrTrigger_Core0
        UserVD_PDN_Func_Core0: OsTrustedFunctionName=UserVD_PDN_Func_Core0
        UserQSpi4DmaTransmit_Core0: OsTrustedFunctionName=UserQSpi4DmaTransmit_Core0
        UserProtRamLckUnlck_Core0: OsTrustedFunctionName=UserProtRamLckUnlck_Core0
        UserProtDisableOverlayRegInit_Core0: OsTrustedFunctionName=UserProtDisableOverlayRegInit_Core0
        UserProtetk_setObaseTBase_protected_Core0: OsTrustedFunctionName=UserProtetk_setObaseTBase_protected_Core0
        UserProtSwitchPageToReferencePage_Core0: OsTrustedFunctionName=UserProtSwitchPageToReferencePage_Core0
        UserProtSwitchPageToWorkingPage_Core0: OsTrustedFunctionName=UserProtSwitchPageToWorkingPage_Core0
        UserProtEnableOverlayRegInit_Core0: OsTrustedFunctionName=UserProtEnableOverlayRegInit_Core0
    RES_USER_CORE0 (OsResource): OsResourceProperty=STANDARD, OsResourceAccessingApplication=OsAppCore0
    7 x OsIsr, all with OsIsrCategory=CATEGORY_1, OsIsrPriority=256:
      RTOS_TRAP_CL_{0..5}: OsIsrAddress=Trap{0..5}
      RTOS_TRAP_CL_7: OsIsrAddress=Trap7
    OsAppCore0_untusted (OsApplication): OsTrusted=false, OsTrustedApplicationDelayTimingViolationCall=false, OsTrustedApplicationWithProtection=false, OsApplicationCoreAssignment=0
      OsApplicationHooks: OsAppStartupHook=false, OsAppShutdownHook=false, OsAppErrorHook=false
    Task_BGTask_Core0 (OsTask): OsTaskActivation=1, OsTaskPriority=2, OsTaskSchedule=FULL, OsTaskResourceRef=RES_USER_CORE0, OsTaskAccessingApplication=OsAppCore0
      OsTaskAutostart: OsTaskAppModeRef=OSDEFAULTAPPMODE
    OsRTATarget: OsRTATargetName=TriCoreHighTec, OsRTATargetVersion=5.0.28, OsRTATargetVariant=TC37x
      14 x Param:
        Orti22Lauterbach: Value=true
        OrtiStackFill: Value=true
        OrtiSMPProposal: Value=true
        UserMode: Value=User-0
        SpPreStartOS: Value=16,64
        SpStartOS: Value=0,64
        SpIDisp: Value=224,64
        SpECC: Value=96,64
        SpPreemption: Value=104,64
        OsMemoryModel: Value=large
        Optimization: Value=2
        TWPprs: Value=2
        AlignUntrustedStacks: Value=true
        far_jumps: Value=true
    FORD_ScheduleTable_Core0 (OsScheduleTable): OsScheduleTableDuration=101, OsScheduleTableRepeating=true, OsSchTblAccessingApplication=OsAppCore0, OsScheduleTableCounterRef=Counter_1ms
      100 x OsScheduleTableExpiryPoint:
        ExpiryPoint1: OsScheduleTblExpPointOffset=1
          Ac0 (OsScheduleTableTaskActivation): OsScheduleTableActivateTaskRef=TaskA0_1ms_Core0
        ExpiryPoint2: OsScheduleTblExpPointOffset=2
          Ac0 (OsScheduleTableTaskActivation): OsScheduleTableActivateTaskRef=TaskA0_1ms_Core0
          Ac1 (OsScheduleTableTaskActivation): OsScheduleTableActivateTaskRef=TaskB0_2ms_Core0
        ExpiryPoint3: OsScheduleTblExpPointOffset=3
          Ac0 (OsScheduleTableTaskActivation): OsScheduleTableActivateTaskRef=TaskA0_1ms_Core0
        ExpiryPoint4: OsScheduleTblExpPointOffset=4
          Ac0 (OsScheduleTableTaskActivation): OsScheduleTableActivateTaskRef=TaskA0_1ms_Core0
          Ac1 (OsScheduleTableTaskActivation): OsScheduleTableActivateTaskRef=TaskB0_2ms_Core0
        ExpiryPoint5: OsScheduleTblExpPointOffset=5
          Ac0 (OsScheduleTableTaskActivation): OsScheduleTableActivateTaskRef=TaskA0_1ms_Core0
        ExpiryPoint6: OsScheduleTblExpPointOffset=6
          Ac0 (OsScheduleTableTaskActivation): OsScheduleTableActivateTaskRef=TaskA0_1ms_Core0
          Ac1 (OsScheduleTableTaskActivation): OsScheduleTableActivateTaskRef=TaskB0_2ms_Core0
        ExpiryPoint7: OsScheduleTblExpPointOffset=7
          Ac0 (OsScheduleTableTaskActivation): OsScheduleTableActivateTaskRef=TaskA0_1ms_Core0
        ExpiryPoint8: OsScheduleTblExpPointOffset=8
          3 x OsScheduleTableTaskActivation:
            Ac0: OsScheduleTableActivateTaskRef=TaskA0_1ms_Core0
            Ac1: OsScheduleTableActivateTaskRef=TaskB0_2ms_Core0
            Ac2: OsScheduleTableActivateTaskRef=TaskC0_8ms_Core0
        ExpiryPoint9: OsScheduleTblExpPointOffset=9
          Ac0 (OsScheduleTableTaskActivation): OsScheduleTableActivateTaskRef=TaskA0_1ms_Core0
        ExpiryPoint10: OsScheduleTblExpPointOffset=10
          3 x OsScheduleTableTaskActivation:
            Ac0: OsScheduleTableActivateTaskRef=TaskA0_1ms_Core0
            Ac1: OsScheduleTableActivateTaskRef=TaskB0_2ms_Core0
            Ac2: OsScheduleTableActivateTaskRef=TaskD0_10ms_Core0
        ExpiryPoint11: OsScheduleTblExpPointOffset=11
          Ac0 (OsScheduleTableTaskActivation): OsScheduleTableActivateTaskRef=TaskA0_1ms_Core0
        ExpiryPoint12: OsScheduleTblExpPointOffset=12
          Ac0 (OsScheduleTableTaskActivation): OsScheduleTableActivateTaskRef=TaskA0_1ms_Core0
          Ac1 (OsScheduleTableTaskActivation): OsScheduleTableActivateTaskRef=TaskB0_2ms_Core0
        ExpiryPoint13: OsScheduleTblExpPointOffset=13
          Ac0 (OsScheduleTableTaskActivation): OsScheduleTableActivateTaskRef=TaskA0_1ms_Core0
        ExpiryPoint14: OsScheduleTblExpPointOffset=14
          Ac0 (OsScheduleTableTaskActivation): OsScheduleTableActivateTaskRef=TaskA0_1ms_Core0
          Ac1 (OsScheduleTableTaskActivation): OsScheduleTableActivateTaskRef=TaskB0_2ms_Core0
        ExpiryPoint15: OsScheduleTblExpPointOffset=15
          Ac0 (OsScheduleTableTaskActivation): OsScheduleTableActivateTaskRef=TaskA0_1ms_Core0
        ExpiryPoint16: OsScheduleTblExpPointOffset=16
          4 x OsScheduleTableTaskActivation:
            Ac0: OsScheduleTableActivateTaskRef=TaskA0_1ms_Core0
            Ac1: OsScheduleTableActivateTaskRef=TaskB0_2ms_Core0
            Ac2: OsScheduleTableActivateTaskRef=TaskC0_8ms_Core0
            Ac3: OsScheduleTableActivateTaskRef=TaskE0_16ms_Core0
        ExpiryPoint17: OsScheduleTblExpPointOffset=17
          Ac1 (OsScheduleTableTaskActivation): OsScheduleTableActivateTaskRef=TaskA0_1ms_Core0
        ExpiryPoint18: OsScheduleTblExpPointOffset=18
          Ac0 (OsScheduleTableTaskActivation): OsScheduleTableActivateTaskRef=TaskA0_1ms_Core0
          Ac1 (OsScheduleTableTaskActivation): OsScheduleTableActivateTaskRef=TaskB0_2ms_Core0
        ExpiryPoint19: OsScheduleTblExpPointOffset=19
          Ac0 (OsScheduleTableTaskActivation): OsScheduleTableActivateTaskRef=TaskA0_1ms_Core0
        ExpiryPoint20: OsScheduleTblExpPointOffset=20
          3 x OsScheduleTableTaskActivation:
            Ac0: OsScheduleTableActivateTaskRef=TaskA0_1ms_Core0
            Ac1: OsScheduleTableActivateTaskRef=TaskB0_2ms_Core0
            Ac2: OsScheduleTableActivateTaskRef=TaskD0_10ms_Core0
        ExpiryPoint21: OsScheduleTblExpPointOffset=21
          Ac0 (OsScheduleTableTaskActivation): OsScheduleTableActivateTaskRef=TaskA0_1ms_Core0
        ExpiryPoint22: OsScheduleTblExpPointOffset=22
          Ac0 (OsScheduleTableTaskActivation): OsScheduleTableActivateTaskRef=TaskA0_1ms_Core0
          Ac1 (OsScheduleTableTaskActivation): OsScheduleTableActivateTaskRef=TaskB0_2ms_Core0
        ExpiryPoint23: OsScheduleTblExpPointOffset=23
          Ac0 (OsScheduleTableTaskActivation): OsScheduleTableActivateTaskRef=TaskA0_1ms_Core0
        ExpiryPoint24: OsScheduleTblExpPointOffset=24
          3 x OsScheduleTableTaskActivation:
            Ac0: OsScheduleTableActivateTaskRef=TaskA0_1ms_Core0
            Ac1: OsScheduleTableActivateTaskRef=TaskB0_2ms_Core0
            Ac2: OsScheduleTableActivateTaskRef=TaskC0_8ms_Core0
        ExpiryPoint25: OsScheduleTblExpPointOffset=25
          Ac0 (OsScheduleTableTaskActivation): OsScheduleTableActivateTaskRef=TaskA0_1ms_Core0
        ExpiryPoint26: OsScheduleTblExpPointOffset=26
          Ac0 (OsScheduleTableTaskActivation): OsScheduleTableActivateTaskRef=TaskA0_1ms_Core0
          Ac1 (OsScheduleTableTaskActivation): OsScheduleTableActivateTaskRef=TaskB0_2ms_Core0
        ExpiryPoint27: OsScheduleTblExpPointOffset=27
          Ac0 (OsScheduleTableTaskActivation): OsScheduleTableActivateTaskRef=TaskA0_1ms_Core0
        ExpiryPoint28: OsScheduleTblExpPointOffset=28
          Ac0 (OsScheduleTableTaskActivation): OsScheduleTableActivateTaskRef=TaskA0_1ms_Core0
          Ac1 (OsScheduleTableTaskActivation): OsScheduleTableActivateTaskRef=TaskB0_2ms_Core0
        ExpiryPoint29: OsScheduleTblExpPointOffset=29
          Ac0 (OsScheduleTableTaskActivation): OsScheduleTableActivateTaskRef=TaskA0_1ms_Core0
        ExpiryPoint30: OsScheduleTblExpPointOffset=30
          4 x OsScheduleTableTaskActivation:
            Ac0: OsScheduleTableActivateTaskRef=TaskA0_1ms_Core0
            Ac1: OsScheduleTableActivateTaskRef=TaskB0_2ms_Core0
            Ac2: OsScheduleTableActivateTaskRef=TaskD0_10ms_Core0
            Ac3: OsScheduleTableActivateTaskRef=TaskF0_30ms_Core0
        ExpiryPoint31: OsScheduleTblExpPointOffset=31
          Ac0 (OsScheduleTableTaskActivation): OsScheduleTableActivateTaskRef=TaskA0_1ms_Core0
        ExpiryPoint32: OsScheduleTblExpPointOffset=32
          4 x OsScheduleTableTaskActivation:
            Ac0: OsScheduleTableActivateTaskRef=TaskA0_1ms_Core0
            Ac1: OsScheduleTableActivateTaskRef=TaskB0_2ms_Core0
            Ac2: OsScheduleTableActivateTaskRef=TaskC0_8ms_Core0
            Ac3: OsScheduleTableActivateTaskRef=TaskE0_16ms_Core0
        ExpiryPoint33: OsScheduleTblExpPointOffset=33
          Ac0 (OsScheduleTableTaskActivation): OsScheduleTableActivateTaskRef=TaskA0_1ms_Core0
        ExpiryPoint34: OsScheduleTblExpPointOffset=34
          Ac0 (OsScheduleTableTaskActivation): OsScheduleTableActivateTaskRef=TaskA0_1ms_Core0
          Ac1 (OsScheduleTableTaskActivation): OsScheduleTableActivateTaskRef=TaskB0_2ms_Core0
        ExpiryPoint35: OsScheduleTblExpPointOffset=35
          Ac0 (OsScheduleTableTaskActivation): OsScheduleTableActivateTaskRef=TaskA0_1ms_Core0
        ExpiryPoint36: OsScheduleTblExpPointOffset=36
          Ac0 (OsScheduleTableTaskActivation): OsScheduleTableActivateTaskRef=TaskA0_1ms_Core0
          Ac1 (OsScheduleTableTaskActivation): OsScheduleTableActivateTaskRef=TaskB0_2ms_Core0
        ExpiryPoint37: OsScheduleTblExpPointOffset=37
          Ac0 (OsScheduleTableTaskActivation): OsScheduleTableActivateTaskRef=TaskA0_1ms_Core0
        ExpiryPoint38: OsScheduleTblExpPointOffset=38
          Ac0 (OsScheduleTableTaskActivation): OsScheduleTableActivateTaskRef=TaskA0_1ms_Core0
          Ac1 (OsScheduleTableTaskActivation): OsScheduleTableActivateTaskRef=TaskB0_2ms_Core0
        ExpiryPoint39: OsScheduleTblExpPointOffset=39
          Ac0 (OsScheduleTableTaskActivation): OsScheduleTableActivateTaskRef=TaskA0_1ms_Core0
        ExpiryPoint40: OsScheduleTblExpPointOffset=40
          4 x OsScheduleTableTaskActivation:
            Ac0: OsScheduleTableActivateTaskRef=TaskA0_1ms_Core0
            Ac1: OsScheduleTableActivateTaskRef=TaskB0_2ms_Core0
            Ac2: OsScheduleTableActivateTaskRef=TaskC0_8ms_Core0
            Ac3: OsScheduleTableActivateTaskRef=TaskD0_10ms_Core0
        ExpiryPoint41: OsScheduleTblExpPointOffset=41
          Ac0 (OsScheduleTableTaskActivation): OsScheduleTableActivateTaskRef=TaskA0_1ms_Core0
        ExpiryPoint42: OsScheduleTblExpPointOffset=42
          Ac0 (OsScheduleTableTaskActivation): OsScheduleTableActivateTaskRef=TaskA0_1ms_Core0
          Ac1 (OsScheduleTableTaskActivation): OsScheduleTableActivateTaskRef=TaskB0_2ms_Core0
        ExpiryPoint43: OsScheduleTblExpPointOffset=43
          Ac0 (OsScheduleTableTaskActivation): OsScheduleTableActivateTaskRef=TaskA0_1ms_Core0
        ExpiryPoint44: OsScheduleTblExpPointOffset=44
          Ac0 (OsScheduleTableTaskActivation): OsScheduleTableActivateTaskRef=TaskA0_1ms_Core0
          Ac1 (OsScheduleTableTaskActivation): OsScheduleTableActivateTaskRef=TaskB0_2ms_Core0
        ExpiryPoint45: OsScheduleTblExpPointOffset=45
          Ac0 (OsScheduleTableTaskActivation): OsScheduleTableActivateTaskRef=TaskA0_1ms_Core0
        ExpiryPoint46: OsScheduleTblExpPointOffset=46
          Ac0 (OsScheduleTableTaskActivation): OsScheduleTableActivateTaskRef=TaskA0_1ms_Core0
          Ac1 (OsScheduleTableTaskActivation): OsScheduleTableActivateTaskRef=TaskB0_2ms_Core0
        ExpiryPoint47: OsScheduleTblExpPointOffset=47
          Ac0 (OsScheduleTableTaskActivation): OsScheduleTableActivateTaskRef=TaskA0_1ms_Core0
        ExpiryPoint48: OsScheduleTblExpPointOffset=48
          4 x OsScheduleTableTaskActivation:
            Ac0: OsScheduleTableActivateTaskRef=TaskA0_1ms_Core0
            Ac1: OsScheduleTableActivateTaskRef=TaskB0_2ms_Core0
            Ac2: OsScheduleTableActivateTaskRef=TaskC0_8ms_Core0
            Ac3: OsScheduleTableActivateTaskRef=TaskE0_16ms_Core0
        ExpiryPoint49: OsScheduleTblExpPointOffset=49
          Ac0 (OsScheduleTableTaskActivation): OsScheduleTableActivateTaskRef=TaskA0_1ms_Core0
        ExpiryPoint50: OsScheduleTblExpPointOffset=50
          4 x OsScheduleTableTaskActivation:
            Ac0: OsScheduleTableActivateTaskRef=TaskA0_1ms_Core0
            Ac1: OsScheduleTableActivateTaskRef=TaskB0_2ms_Core0
            Ac2: OsScheduleTableActivateTaskRef=TaskD0_10ms_Core0
            Ac3: OsScheduleTableActivateTaskRef=TaskG0_50ms_Core0
        ExpiryPoint51: OsScheduleTblExpPointOffset=51
          Ac0 (OsScheduleTableTaskActivation): OsScheduleTableActivateTaskRef=TaskA0_1ms_Core0
        ExpiryPoint52: OsScheduleTblExpPointOffset=52
          Ac0 (OsScheduleTableTaskActivation): OsScheduleTableActivateTaskRef=TaskA0_1ms_Core0
          Ac1 (OsScheduleTableTaskActivation): OsScheduleTableActivateTaskRef=TaskB0_2ms_Core0
        ExpiryPoint53: OsScheduleTblExpPointOffset=53
          Ac0 (OsScheduleTableTaskActivation): OsScheduleTableActivateTaskRef=TaskA0_1ms_Core0
        ExpiryPoint54: OsScheduleTblExpPointOffset=54
          Ac0 (OsScheduleTableTaskActivation): OsScheduleTableActivateTaskRef=TaskA0_1ms_Core0
          Ac1 (OsScheduleTableTaskActivation): OsScheduleTableActivateTaskRef=TaskB0_2ms_Core0
        ExpiryPoint55: OsScheduleTblExpPointOffset=55
          Ac0 (OsScheduleTableTaskActivation): OsScheduleTableActivateTaskRef=TaskA0_1ms_Core0
        ExpiryPoint56: OsScheduleTblExpPointOffset=56
          3 x OsScheduleTableTaskActivation:
            Ac0: OsScheduleTableActivateTaskRef=TaskA0_1ms_Core0
            Ac1: OsScheduleTableActivateTaskRef=TaskB0_2ms_Core0
            Ac2: OsScheduleTableActivateTaskRef=TaskC0_8ms_Core0
        ExpiryPoint57: OsScheduleTblExpPointOffset=57
          Ac0 (OsScheduleTableTaskActivation): OsScheduleTableActivateTaskRef=TaskA0_1ms_Core0
        ExpiryPoint58: OsScheduleTblExpPointOffset=58
          Ac0 (OsScheduleTableTaskActivation): OsScheduleTableActivateTaskRef=TaskA0_1ms_Core0
          Ac1 (OsScheduleTableTaskActivation): OsScheduleTableActivateTaskRef=TaskB0_2ms_Core0
        ExpiryPoint59: OsScheduleTblExpPointOffset=59
          Ac0 (OsScheduleTableTaskActivation): OsScheduleTableActivateTaskRef=TaskA0_1ms_Core0
        ExpiryPoint60: OsScheduleTblExpPointOffset=60
          4 x OsScheduleTableTaskActivation:
            Ac0: OsScheduleTableActivateTaskRef=TaskA0_1ms_Core0
            Ac1: OsScheduleTableActivateTaskRef=TaskB0_2ms_Core0
            Ac2: OsScheduleTableActivateTaskRef=TaskD0_10ms_Core0
            Ac3: OsScheduleTableActivateTaskRef=TaskF0_30ms_Core0
        ExpiryPoint61: OsScheduleTblExpPointOffset=61
          Ac0 (OsScheduleTableTaskActivation): OsScheduleTableActivateTaskRef=TaskA0_1ms_Core0
        ExpiryPoint62: OsScheduleTblExpPointOffset=62
          Ac0 (OsScheduleTableTaskActivation): OsScheduleTableActivateTaskRef=TaskA0_1ms_Core0
          Ac1 (OsScheduleTableTaskActivation): OsScheduleTableActivateTaskRef=TaskB0_2ms_Core0
        ExpiryPoint63: OsScheduleTblExpPointOffset=63
          Ac0 (OsScheduleTableTaskActivation): OsScheduleTableActivateTaskRef=TaskA0_1ms_Core0
        ExpiryPoint64: OsScheduleTblExpPointOffset=64
          4 x OsScheduleTableTaskActivation:
            Ac0: OsScheduleTableActivateTaskRef=TaskA0_1ms_Core0
            Ac1: OsScheduleTableActivateTaskRef=TaskB0_2ms_Core0
            Ac2: OsScheduleTableActivateTaskRef=TaskC0_8ms_Core0
            Ac3: OsScheduleTableActivateTaskRef=TaskE0_16ms_Core0
        ExpiryPoint65: OsScheduleTblExpPointOffset=65
          Ac0 (OsScheduleTableTaskActivation): OsScheduleTableActivateTaskRef=TaskA0_1ms_Core0
        ExpiryPoint66: OsScheduleTblExpPointOffset=66
          Ac0 (OsScheduleTableTaskActivation): OsScheduleTableActivateTaskRef=TaskA0_1ms_Core0
          Ac1 (OsScheduleTableTaskActivation): OsScheduleTableActivateTaskRef=TaskB0_2ms_Core0
        ExpiryPoint67: OsScheduleTblExpPointOffset=67
          Ac0 (OsScheduleTableTaskActivation): OsScheduleTableActivateTaskRef=TaskA0_1ms_Core0
        ExpiryPoint68: OsScheduleTblExpPointOffset=68
          Ac0 (OsScheduleTableTaskActivation): OsScheduleTableActivateTaskRef=TaskA0_1ms_Core0
          Ac1 (OsScheduleTableTaskActivation): OsScheduleTableActivateTaskRef=TaskB0_2ms_Core0
        ExpiryPoint69: OsScheduleTblExpPointOffset=69
          Ac0 (OsScheduleTableTaskActivation): OsScheduleTableActivateTaskRef=TaskA0_1ms_Core0
        ExpiryPoint70: OsScheduleTblExpPointOffset=70
          3 x OsScheduleTableTaskActivation:
            Ac0: OsScheduleTableActivateTaskRef=TaskA0_1ms_Core0
            Ac1: OsScheduleTableActivateTaskRef=TaskB0_2ms_Core0
            Ac2: OsScheduleTableActivateTaskRef=TaskD0_10ms_Core0
        ExpiryPoint71: OsScheduleTblExpPointOffset=71
          Ac0 (OsScheduleTableTaskActivation): OsScheduleTableActivateTaskRef=TaskA0_1ms_Core0
        ExpiryPoint72: OsScheduleTblExpPointOffset=72
          3 x OsScheduleTableTaskActivation:
            Ac0: OsScheduleTableActivateTaskRef=TaskA0_1ms_Core0
            Ac1: OsScheduleTableActivateTaskRef=TaskB0_2ms_Core0
            Ac2: OsScheduleTableActivateTaskRef=TaskC0_8ms_Core0
        ExpiryPoint73: OsScheduleTblExpPointOffset=73
          Ac0 (OsScheduleTableTaskActivation): OsScheduleTableActivateTaskRef=TaskA0_1ms_Core0
        ExpiryPoint74: OsScheduleTblExpPointOffset=74
          Ac0 (OsScheduleTableTaskActivation): OsScheduleTableActivateTaskRef=TaskA0_1ms_Core0
          Ac1 (OsScheduleTableTaskActivation): OsScheduleTableActivateTaskRef=TaskB0_2ms_Core0
        ExpiryPoint75: OsScheduleTblExpPointOffset=75
          Ac0 (OsScheduleTableTaskActivation): OsScheduleTableActivateTaskRef=TaskA0_1ms_Core0
        ExpiryPoint76: OsScheduleTblExpPointOffset=76
          Ac0 (OsScheduleTableTaskActivation): OsScheduleTableActivateTaskRef=TaskA0_1ms_Core0
          Ac1 (OsScheduleTableTaskActivation): OsScheduleTableActivateTaskRef=TaskB0_2ms_Core0
        ExpiryPoint77: OsScheduleTblExpPointOffset=77
          Ac0 (OsScheduleTableTaskActivation): OsScheduleTableActivateTaskRef=TaskA0_1ms_Core0
        ExpiryPoint78: OsScheduleTblExpPointOffset=78
          Ac0 (OsScheduleTableTaskActivation): OsScheduleTableActivateTaskRef=TaskA0_1ms_Core0
          Ac1 (OsScheduleTableTaskActivation): OsScheduleTableActivateTaskRef=TaskB0_2ms_Core0
        ExpiryPoint79: OsScheduleTblExpPointOffset=79
          Ac0 (OsScheduleTableTaskActivation): OsScheduleTableActivateTaskRef=TaskA0_1ms_Core0
        ExpiryPoint80: OsScheduleTblExpPointOffset=80
          5 x OsScheduleTableTaskActivation:
            Ac0: OsScheduleTableActivateTaskRef=TaskA0_1ms_Core0
            Ac1: OsScheduleTableActivateTaskRef=TaskB0_2ms_Core0
            Ac2: OsScheduleTableActivateTaskRef=TaskC0_8ms_Core0
            Ac3: OsScheduleTableActivateTaskRef=TaskD0_10ms_Core0
            Ac4: OsScheduleTableActivateTaskRef=TaskE0_16ms_Core0
        ExpiryPoint81: OsScheduleTblExpPointOffset=81
          Ac0 (OsScheduleTableTaskActivation): OsScheduleTableActivateTaskRef=TaskA0_1ms_Core0
        ExpiryPoint82: OsScheduleTblExpPointOffset=82
          Ac0 (OsScheduleTableTaskActivation): OsScheduleTableActivateTaskRef=TaskA0_1ms_Core0
          Ac1 (OsScheduleTableTaskActivation): OsScheduleTableActivateTaskRef=TaskB0_2ms_Core0
        ExpiryPoint83: OsScheduleTblExpPointOffset=83
          Ac0 (OsScheduleTableTaskActivation): OsScheduleTableActivateTaskRef=TaskA0_1ms_Core0
        ExpiryPoint84: OsScheduleTblExpPointOffset=84
          Ac0 (OsScheduleTableTaskActivation): OsScheduleTableActivateTaskRef=TaskA0_1ms_Core0
          Ac1 (OsScheduleTableTaskActivation): OsScheduleTableActivateTaskRef=TaskB0_2ms_Core0
        ExpiryPoint85: OsScheduleTblExpPointOffset=85
          Ac0 (OsScheduleTableTaskActivation): OsScheduleTableActivateTaskRef=TaskA0_1ms_Core0
        ExpiryPoint86: OsScheduleTblExpPointOffset=86
          Ac0 (OsScheduleTableTaskActivation): OsScheduleTableActivateTaskRef=TaskA0_1ms_Core0
          Ac1 (OsScheduleTableTaskActivation): OsScheduleTableActivateTaskRef=TaskB0_2ms_Core0
        ExpiryPoint87: OsScheduleTblExpPointOffset=87
          Ac0 (OsScheduleTableTaskActivation): OsScheduleTableActivateTaskRef=TaskA0_1ms_Core0
        ExpiryPoint88: OsScheduleTblExpPointOffset=88
          3 x OsScheduleTableTaskActivation:
            Ac0: OsScheduleTableActivateTaskRef=TaskA0_1ms_Core0
            Ac1: OsScheduleTableActivateTaskRef=TaskB0_2ms_Core0
            Ac2: OsScheduleTableActivateTaskRef=TaskC0_8ms_Core0
        ExpiryPoint89: OsScheduleTblExpPointOffset=89
          Ac0 (OsScheduleTableTaskActivation): OsScheduleTableActivateTaskRef=TaskA0_1ms_Core0
        ExpiryPoint90: OsScheduleTblExpPointOffset=90
          4 x OsScheduleTableTaskActivation:
            Ac0: OsScheduleTableActivateTaskRef=TaskA0_1ms_Core0
            Ac1: OsScheduleTableActivateTaskRef=TaskB0_2ms_Core0
            Ac2: OsScheduleTableActivateTaskRef=TaskD0_10ms_Core0
            Ac3: OsScheduleTableActivateTaskRef=TaskF0_30ms_Core0
        ExpiryPoint91: OsScheduleTblExpPointOffset=91
          Ac0 (OsScheduleTableTaskActivation): OsScheduleTableActivateTaskRef=TaskA0_1ms_Core0
        ExpiryPoint92: OsScheduleTblExpPointOffset=92
          Ac0 (OsScheduleTableTaskActivation): OsScheduleTableActivateTaskRef=TaskA0_1ms_Core0
          Ac1 (OsScheduleTableTaskActivation): OsScheduleTableActivateTaskRef=TaskB0_2ms_Core0
        ExpiryPoint93: OsScheduleTblExpPointOffset=93
          Ac0 (OsScheduleTableTaskActivation): OsScheduleTableActivateTaskRef=TaskA0_1ms_Core0
        ExpiryPoint94: OsScheduleTblExpPointOffset=94
          Ac0 (OsScheduleTableTaskActivation): OsScheduleTableActivateTaskRef=TaskA0_1ms_Core0
          Ac1 (OsScheduleTableTaskActivation): OsScheduleTableActivateTaskRef=TaskB0_2ms_Core0
        ExpiryPoint95: OsScheduleTblExpPointOffset=95
          Ac0 (OsScheduleTableTaskActivation): OsScheduleTableActivateTaskRef=TaskA0_1ms_Core0
        ExpiryPoint96: OsScheduleTblExpPointOffset=96
          4 x OsScheduleTableTaskActivation:
            Ac0: OsScheduleTableActivateTaskRef=TaskA0_1ms_Core0
            Ac1: OsScheduleTableActivateTaskRef=TaskB0_2ms_Core0
            Ac2: OsScheduleTableActivateTaskRef=TaskC0_8ms_Core0
            Ac3: OsScheduleTableActivateTaskRef=TaskE0_16ms_Core0
        ExpiryPoint97: OsScheduleTblExpPointOffset=97
          Ac0 (OsScheduleTableTaskActivation): OsScheduleTableActivateTaskRef=TaskA0_1ms_Core0
        ExpiryPoint98: OsScheduleTblExpPointOffset=98
          Ac0 (OsScheduleTableTaskActivation): OsScheduleTableActivateTaskRef=TaskA0_1ms_Core0
          Ac1 (OsScheduleTableTaskActivation): OsScheduleTableActivateTaskRef=TaskB0_2ms_Core0
        ExpiryPoint99: OsScheduleTblExpPointOffset=99
          Ac0 (OsScheduleTableTaskActivation): OsScheduleTableActivateTaskRef=TaskA0_1ms_Core0
        ExpiryPoint100: OsScheduleTblExpPointOffset=100
          5 x OsScheduleTableTaskActivation:
            Ac0: OsScheduleTableActivateTaskRef=TaskA0_1ms_Core0
            Ac1: OsScheduleTableActivateTaskRef=TaskB0_2ms_Core0
            Ac2: OsScheduleTableActivateTaskRef=TaskD0_10ms_Core0
            Ac3: OsScheduleTableActivateTaskRef=TaskG0_50ms_Core0
            Ac4: OsScheduleTableActivateTaskRef=TaskH0_100ms_Core0
      OsScheduleTableAutostart: OsScheduleTableAutostartType=ABSOLUTE, OsScheduleTableStartValue=0, OsScheduleTableAppModeRef=OSDEFAULTAPPMODE
      OsScheduleTableSync: OsScheduleTblSyncStrategy=NONE
    6 x OsIsr:
      RTOS_TRAP_CL_6: OsIsrCategory=CATEGORY_1, OsIsrPriority=256, OsIsrAddress=Trap6
      OSK_OsTickISR: OsIsrCategory=CATEGORY_2, OsIsrPriority=255, OsIsrAddress=SRC_STM0SR0, OsIsrResourceRef=RES_USER_CORE0
      DMACH34SR_ISR: OsIsrAddress=SRC_DMACH34, OsIsrCategory=CATEGORY_2, OsIsrPriority=34
      GTMATOM0SR1_ISR: OsIsrAddress=SRC_GTMATOM01, OsIsrPriority=173, OsIsrCategory=CATEGORY_2
      GTMATOM0SR0_ISR: OsIsrAddress=SRC_GTMATOM00, OsIsrPriority=172, OsIsrCategory=CATEGORY_2
      GTMATOM0SR2_ISR: OsIsrCategory=CATEGORY_2, OsIsrAddress=SRC_GTMATOM02, OsIsrPriority=174
    Os_Init_Task_Core0 (OsTask): OsTaskPriority=23, OsTaskSchedule=FULL, OsTaskActivation=1, OsTaskAccessingApplication=OsAppCore0, OsTaskResourceRef=RES_USER_CORE0
      OsTaskAutostart: OsTaskAppModeRef=OSDEFAULTAPPMODE
    Os_Init_Task_Core1 (OsTask): OsTaskPriority=22, OsTaskSchedule=FULL, OsTaskActivation=1, OsTaskAccessingApplication=OsAppCore1, OsTaskResourceRef=RES_USER_CORE1
      OsTaskAutostart: OsTaskAppModeRef=OSDEFAULTAPPMODE
    4 x OsIsr, all with OsIsrCategory=CATEGORY_2:
      ISR_MotorControl: OsIsrPriority=3, OsIsrAddress=SRC_GPSR01
      ISR_MpsVadc: OsIsrPriority=2, OsIsrAddress=SRC_GPSR02
      ISR_OuterLoop: OsIsrPriority=5, OsIsrAddress=SRC_GPSR03
      ISR_InnerLoop_2: OsIsrPriority=4, OsIsrAddress=SRC_GPSR04
    3 x OsTask, all with OsTaskSchedule=FULL, OsTaskActivation=1:
      Task_BGTask_Core1: OsTaskPriority=1, OsTaskAccessingApplication=OsAppCore1, OsTaskResourceRef=RES_USER_CORE1
        OsTaskAutostart: OsTaskAppModeRef=OSDEFAULTAPPMODE
      Os_Init_Task_Core2: OsTaskPriority=21, OsTaskAccessingApplication=OsAppCore2, OsTaskResourceRef=RES_USER_CORE2
        OsTaskAutostart: OsTaskAppModeRef=OSDEFAULTAPPMODE
      Task_BGtask_Core2: OsTaskPriority=0, OsTaskAccessingApplication=OsAppCore2, OsTaskResourceRef=RES_USER_CORE2
        OsTaskAutostart: OsTaskAppModeRef=OSDEFAULTAPPMODE
    SystemTimer (OsCounter):
      OsCounterMinCycle = 1
      OsCounterMaxAllowedValue = 4294967295
      OsCounterTicksPerBase = 1
      OsSecondsPerTick = 1E-08
      OsCounterType = HARDWARE
      OsCounterAccessingApplication = OsAppCore0
      OsCounterAccessingApplication = OsAppCore0_untusted
    3 x OsIsr:
      QSPI2ERR_ISR: OsIsrCategory=CATEGORY_2, OsIsrPriority=33, OsIsrAddress=SRC_QSPI2ERR
      SCUERUSR0_ISR: OsIsrCategory=CATEGORY_1, OsIsrPriority=255, OsIsrAddress=SRC_SCUERU0
      WdgGptSrvISR: OsIsrCategory=CATEGORY_2, OsIsrPriority=152, OsIsrAddress=SRC_GTMATOM30
    init_core0 (OsAlarm): OsAlarmCounterRef=SystemTimer, OsAlarmAccessingApplication=OsAppCore0
      OsAlarmAction
        OsAlarmActivateTask: OsAlarmActivateTaskRef=Os_Init_Task_Core0
        OsAlarmIncrementCounter: OsAlarmIncrementCounterRef=Counter_1ms
      OsAlarmAutostart: OsAlarmAutostartType=ABSOLUTE, OsAlarmAlarmTime=100, OsAlarmCycleTime=100, OsAlarmAppModeRef=OSDEFAULTAPPMODE
    4 x OsApplication, all with OsTrustedApplicationDelayTimingViolationCall=false, OsTrustedApplicationWithProtection=false:
      OsAppCore1: OsTrusted=true, OsApplicationCoreAssignment=1, OsAppIsrRef=ISR_MpsVadc, OsAppIsrRef=ISR_MotorControl, OsAppTaskRef=Task_BGTask_Core1, OsAppTaskRef=Os_Init_Task_Core1, OsAppTaskRef=TaskH0_100ms_Core1, OsAppCounterRef=Counter_C1_100ms, OsAppScheduleTableRef=FORD_ScheduleTable_Core1, OsAppIsrRef=SystemTimer_ISR_core1
        OsApplicationHooks: OsAppStartupHook=true, OsAppShutdownHook=true, OsAppErrorHook=true
      OsAppCore1_untrusted: OsTrusted=false, OsApplicationCoreAssignment=1
        OsApplicationHooks: OsAppStartupHook=false, OsAppShutdownHook=false, OsAppErrorHook=false
      OsAppCore2: OsTrusted=true, OsApplicationCoreAssignment=2, OsAppIsrRef=ISR_OuterLoop, OsAppIsrRef=ISR_InnerLoop_2, OsAppTaskRef=Task_BGtask_Core2, OsAppTaskRef=Os_Init_Task_Core2, OsAppTaskRef=TaskH0_100ms_Core2, OsAppCounterRef=Counter_C2_100ms, OsAppScheduleTableRef=FORD_ScheduleTable_Core2, OsAppIsrRef=SystemTimer_ISR_core2
        OsApplicationHooks: OsAppStartupHook=true, OsAppShutdownHook=true, OsAppErrorHook=true
      OsAppCore2_untrusted: OsTrusted=false, OsApplicationCoreAssignment=2
        OsApplicationHooks: OsAppStartupHook=false, OsAppShutdownHook=false, OsAppErrorHook=false
    FORD_ScheduleTable_Core1 (OsScheduleTable): OsScheduleTableRepeating=true, OsScheduleTableDuration=2, OsScheduleTableCounterRef=Counter_C1_100ms, OsSchTblAccessingApplication=OsAppCore1
      ExpiryPoint1 (OsScheduleTableExpiryPoint): OsScheduleTblExpPointOffset=1
        AC0 (OsScheduleTableTaskActivation): OsScheduleTableActivateTaskRef=TaskH0_100ms_Core1
      OsScheduleTableAutostart: OsScheduleTableStartValue=1, OsScheduleTableAutostartType=ABSOLUTE, OsScheduleTableAppModeRef=OSDEFAULTAPPMODE
      OsScheduleTableSync: OsScheduleTblSyncStrategy=NONE
    TaskH0_100ms_Core1 (OsTask): OsTaskActivation=2, OsTaskPriority=13, OsTaskSchedule=FULL, OsTaskAccessingApplication=OsAppCore1, OsTaskResourceRef=RES_USER_CORE1
    TaskH0_100ms_Core2 (OsTask): OsTaskActivation=2, OsTaskPriority=13, OsTaskSchedule=FULL, OsTaskAccessingApplication=OsAppCore2, OsTaskResourceRef=RES_USER_CORE2
    Counter_C1_100ms (OsCounter):
      OsCounterMinCycle = 1
      OsCounterMaxAllowedValue = 10
      OsCounterTicksPerBase = 1
      OsSecondsPerTick = 0.1
      OsCounterType = SOFTWARE
      OsCounterAccessingApplication = OsAppCore1
    Counter_C2_100ms (OsCounter):
      OsCounterMinCycle = 1
      OsCounterMaxAllowedValue = 10
      OsCounterTicksPerBase = 1
      OsSecondsPerTick = 0.1
      OsCounterType = SOFTWARE
      OsCounterAccessingApplication = OsAppCore2
    FORD_ScheduleTable_Core2 (OsScheduleTable): OsScheduleTableRepeating=true, OsScheduleTableDuration=2, OsScheduleTableCounterRef=Counter_C2_100ms, OsSchTblAccessingApplication=OsAppCore2
      OsScheduleTableAutostart: OsScheduleTableAutostartType=ABSOLUTE, OsScheduleTableStartValue=1, OsScheduleTableAppModeRef=OSDEFAULTAPPMODE
      ExpiryPoint1 (OsScheduleTableExpiryPoint): OsScheduleTblExpPointOffset=1
        AC0 (OsScheduleTableTaskActivation): OsScheduleTableActivateTaskRef=TaskH0_100ms_Core2
      OsScheduleTableSync: OsScheduleTblSyncStrategy=NONE
    SystemTimer_ISR_core1 (OsIsr): OsIsrCategory=CATEGORY_2, OsIsrAddress=SRC_STM1SR0, OsIsrPriority=255, OsIsrResourceRef=RES_USER_CORE1
    RES_USER_CORE1 (OsResource): OsResourceProperty=STANDARD, OsResourceAccessingApplication=OsAppCore1
    RES_USER_CORE2 (OsResource): OsResourceProperty=STANDARD, OsResourceAccessingApplication=OsAppCore2
    60 x OsIsr, all with OsIsrCategory=CATEGORY_2:
      SystemTimer_ISR_core2: OsIsrAddress=SRC_STM2SR0, OsIsrPriority=255, OsIsrResourceRef=RES_USER_CORE2
      DMACH{28..32}SR_ISR: OsIsrPriority={28..32}, OsIsrAddress=SRC_DMACH{28..32}
      DMACH{12..25}SR_ISR: OsIsrPriority={12..25}, OsIsrAddress=SRC_DMACH{12..25}
      DMACH26SR_ISR: OsIsrAddress=SRC_DMACH26, OsIsrPriority=26
      DMACH27SR_ISR: OsIsrAddress=SRC_DMACH27, OsIsrPriority=27
      GTMATOM0SR3_ISR: OsIsrAddress=SRC_GTMATOM03, OsIsrPriority=175
      DMACH11SR_ISR: OsIsrAddress=SRC_DMACH11, OsIsrPriority=11
      DMACH33SR_ISR: OsIsrPriority=33, OsIsrAddress=SRC_DMACH33
      DMACH36SR_ISR: OsIsrPriority=36, OsIsrAddress=SRC_DMACH36
      DMACH35SR_ISR: OsIsrPriority=35, OsIsrAddress=SRC_DMACH35
      DMACH37SR_ISR: OsIsrPriority=37, OsIsrAddress=SRC_DMACH37
      CAN1SR0_ISR: OsIsrPriority=117, OsIsrAddress=SRC_CAN1INT0
      CAN0SR1_ISR: OsIsrAddress=SRC_CAN0INT1, OsIsrPriority=102
      CAN0SR10_ISR: OsIsrAddress=SRC_CAN0INT10, OsIsrPriority=111
      CAN0SR11_ISR: OsIsrAddress=SRC_CAN0INT11, OsIsrPriority=112
      CAN0SR12_ISR: OsIsrAddress=SRC_CAN0INT12, OsIsrPriority=113
      CAN0SR13_ISR: OsIsrAddress=SRC_CAN0INT13, OsIsrPriority=114
      CAN0SR14_ISR: OsIsrAddress=SRC_CAN0INT14, OsIsrPriority=115
      CAN0SR15_ISR: OsIsrAddress=SRC_CAN0INT15, OsIsrPriority=116
      CAN0SR2_ISR: OsIsrAddress=SRC_CAN0INT2, OsIsrPriority=103
      CAN0SR3_ISR: OsIsrAddress=SRC_CAN0INT3, OsIsrPriority=104
      CAN0SR4_ISR: OsIsrAddress=SRC_CAN0INT4, OsIsrPriority=105
      CAN0SR5_ISR: OsIsrAddress=SRC_CAN0INT5, OsIsrPriority=106
      CAN0SR6_ISR: OsIsrAddress=SRC_CAN0INT6, OsIsrPriority=107
      CAN0SR7_ISR: OsIsrAddress=SRC_CAN0INT7, OsIsrPriority=108
      CAN0SR8_ISR: OsIsrAddress=SRC_CAN0INT8, OsIsrPriority=109
      CAN0SR9_ISR: OsIsrAddress=SRC_CAN0INT9, OsIsrPriority=110
      CAN0SR0_ISR: OsIsrAddress=SRC_CAN0INT0, OsIsrPriority=101
      CAN1SR1_ISR: OsIsrAddress=SRC_CAN1INT1, OsIsrPriority=118
      CAN1SR2_ISR: OsIsrAddress=SRC_CAN1INT2, OsIsrPriority=119
      CAN1SR3_ISR: OsIsrAddress=SRC_CAN1INT3, OsIsrPriority=120
      CAN1SR4_ISR: OsIsrAddress=SRC_CAN1INT4, OsIsrPriority=121
      CAN1SR5_ISR: OsIsrAddress=SRC_CAN1INT5, OsIsrPriority=122
      CAN1SR6_ISR: OsIsrAddress=SRC_CAN1INT6, OsIsrPriority=123
      CAN1SR7_ISR: OsIsrAddress=SRC_CAN1INT7, OsIsrPriority=124
      CAN1SR8_ISR: OsIsrAddress=SRC_CAN1INT8, OsIsrPriority=125
      CAN1SR9_ISR: OsIsrAddress=SRC_CAN1INT9, OsIsrPriority=126
      CAN1SR10_ISR: OsIsrAddress=SRC_CAN1INT10, OsIsrPriority=127
      CAN1SR11_ISR: OsIsrAddress=SRC_CAN1INT11, OsIsrPriority=128
      CAN1SR12_ISR: OsIsrAddress=SRC_CAN1INT12, OsIsrPriority=129
      CAN1SR13_ISR: OsIsrAddress=SRC_CAN1INT13, OsIsrPriority=130
      CAN1SR14_ISR: OsIsrAddress=SRC_CAN1INT14, OsIsrPriority=131
      CAN1SR15_ISR: OsIsrAddress=SRC_CAN1INT15, OsIsrPriority=132

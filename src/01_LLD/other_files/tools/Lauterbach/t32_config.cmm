; Uncommented setting will be used instead of interactive dialogs
	; Commonn settings
;&cpu="TC397XP"                              ; for simulator mode
&clock=16.                                   ; decimal: [MHz]
&jtagclock=10.                               ; decimal: [MHz]
&cable="DAP2"                                ; target depending, "JTAG","DAP","DAP2",...
;&mp_interfaces=0.                           ; 0:single core; 1:smp
;&special_interfaces=""	                     ; "": none; "HSM" (tc), "eTPU" (ppc)
&root_0="."                                  ; root dir for core's 0 (first) interface
&root_1="."                                  ;         "           1 interface
&root_2="."                                  ;         "           2 interface
&root_3="."                                  ;         "           3 interface
&root_4="."                                  ;         "           4 interface
&root_5="."                                  ;         "           5 interface
;&root_s="."                                 ; root dir for special interface
&file_0="dev/bm.elf"                         ; path/name file to be loaded into core's 0 (first) interface
&ghs_compiler=false()
;&attach=true()                              ; will attach instead of up
&fill_flash=true()
&fill_calib=true()                           ; fill all calibration sectors
;&start_label="__main"                       ; default to "start"
&virtual_to_reference=false()
&low_addr=0xA0000000                        ; Lower address to be loaded
&high_addr=0xA0017FFF                       ; Higher  address to be loaded
&trace_method="NONE"
        ; GDB interface only (usually passed as parameters)
;&gdb_port=
;&start_address=
        ; Tricore/AURIX settings
&mcds_array="TCM"                            ; "XTM" or "TCM" (tc27x defaults to TCM)
&mcds_size="576.KB"                          ; "-" if EMEM non present
&mcds_position="DOWN"                        ; "DOWN", on first tiles, or "UP", on higher tiles
        ;XC2xxx settings
;&waitreset=5000.                            ; decimal: [ms]
enddo

// T32_1000004 Wed Dec 27 13:41:40 2023

B::

TOOLBAR   ON
STATUSBAR ON
FramePOS 22.286,13.0,,,Maximized
WinPAGE.RESet

WinPAGE.Create P000
WinCLEAR

WinPOS 0.0 36.0 132. 32. 5. 0. W001
Frame.view /Locals /Caller

WinPOS 0.0 0.0 191. 32. 13. 1. W000
WinTABS 10. 10. 25.
List.auto

WinPOS 136.43 36.0 132. 32. 0. 0. W002
Var.Watch

Var.AddWatch flags
Var.AddWatch ast
Var.AddWatch TaskCounter_PeriodicTask
Var.AddWatch atd_Results
Var.AddWatch PwmNotification_counter
Var.AddWatch u32_DmaCh21_AdcG11_Ch0_Notification
Var.AddWatch u32_DmaCh25_AdcG8_Ch1_Notification
Var.AddWatch u32_DmaCh29_AdcG11_Ch1_Notification
Var.AddWatch u32_DmaCh11_AdcG2_Ch2_Notification
Var.AddWatch u32_DmaCh17_AdcG3_Ch1_Notification
Var.AddWatch u32_DmaCh31_AdcG3_Ch0_Notification
Var.AddWatch PwmNotification_counter
Var.AddWatch CAN_TxConfirmCount
Var.AddWatch CAN_RxConfirmCount

WinPAGE.select P000

ENDDO

; --------------------------------------------------------------------------------
; @Title: Demo script for TC377TP on TriBoard-TC3x7 (Flash, sieve app)
; @Description:
;   Programs the sieve demo application (single-core) into the processor
;   internal flash and sets up a demo debug scenario. This script can be used
;   as a template for flashing an application.
; @Keywords: AURIX2G, flash, Infineon, TriCore
; @Author: MOB
; @Board: TriBoard-TC3x7
; @Chip: TC377TP
; @Copyright: (C) 1989-2021 Lauterbach GmbH, licensed for use with TRACE32(R) only
; --------------------------------------------------------------------------------
; $Id: demo_flash.cmm 20050 2022-11-08 17:02:43Z hdammak $


; --------------------------------------------------------------------------------
; initialize and start the debugger
RESet
SYStem.CPU TC377TP
; The TriBoard-TC3x7 comes with a TLF35584 power supply
; This power supply has integrated watchdog functionality which will cut all
; power if not served correctly. By default this demo will disable this
; watchdog functionality. This includes configuring the QSPI controller as
; well as writing data to the QSPI.

;SYStem.CONFIG CoreNumber 3  // Chip has two cores
CORE.ASSIGN 1 2 3

// Use 1st and 2nd core with current TRACE32 PowerView GUI
IF !STATE.POWER()
(
  DO ~~~~/tc37x_sieve_intflash.cmm
)
SYStem.Up

; --------------------------------------------------------------------------------
; Flash programming
LOCAL &elfFile &progFlash &bmhdResult
;&elfFile="~~~~\01_LLD.elf"

&basedir_cwd=OS.PWD()
;PRINT "&basedir_cwd"
DIALOG.MESSAGE "Please select outputs directory for elf files to flash in next dial"
ChDir *
&basedir_outputs=OS.PWD()
;PRINT "&basedir_outputs"

;&elfFile     ="&basedir_outputs"+"\outputs_FBL\fss_btxh.elf"
;&pblelffile  ="&basedir_outputs"+"\outputs_FBL\fss_pbl.elf"
;&sblelffile  ="&basedir_outputs"+"\outputs_FBL\fss_sbl.elf"

&elfFile     ="&basedir_outputs"+"\fss_btxh.elf"
&pblelffile  ="&basedir_outputs"+"\fss_pbl.elf"
;&applelffile ="&basedir_outputs"+"\fss_lld.elf"

;PRINT "&elfFile"
;PRINT "&pblelffile"
;PRINT "&sblelffile"
;PRINT "&applelffile"

;Run this cmd after every flash
;Data.LOAD.Elf "D:\home\user123\user\Shilpa\DMA\02.Software_MT1_WIP_08_08\02.Software_MT1_WIP\src\01_LLD\outputs\fss_lld.elf" /NoCODE /Noclear
;Data.LOAD.Elf "&basedir_outputs"+"\fss_lld.elf"

; prepare flash programming (declarations)
DO ~~/demo/tricore/flash/tc37x.cmm CPU=TC377TP PREPAREONLY

; check if application is already in flash and load symbols
;Data.LOAD.Elf "&elfFile" /DIFF /SingleLineAdjacent
;Data.LOAD.Elf "&applelffile" /DIFF /SingleLineAdjacent
;IF FOUND()
(
  ; ==== Step 1: Program TriCore code ====

  DIALOG.YESNO "Program Lauterbach demo into flash memory?"
  ENTRY &progFlash
  IF (&progFlash)
  (
    ; enable flash programming
    FLASH.ReProgram ALL

    ; load demo application
    Data.LOAD.Elf "&elfFile"
    Data.LOAD.Elf "&pblelffile" /noclear
    ;Data.LOAD.Elf "&sblelffile" /noclear
    ;Data.LOAD.Elf "&applelffile" /noclear
    FLASH.ReProgram OFF
  )

  ; ==== Step 2: Write boot mode header ====

  PRIVATE &progUcb &ucbOrigDiff &ucbCopyDiff &supported &diffAddress &DMU_HF_CONFIRM0 &result
  &progUcb=FALSE()
  ; Check if both UCBs are in state UNLOCKED or UNREAD. Other states are not supported by this script
  &DMU_HF_CONFIRM0=Data.Long(ED:0xF8040020)
  &supported=(((&DMU_HF_CONFIRM0)&(0x00020002))==0x00000000)

  IF !&supported
  (
    DIALOG.MESSAGE "UCB_BMHD0_ORIG or UCB_BMHD0_COPY are not in state unlocked or unread"
  )

  ; Check if we need to program the BMHD
  &ucbOrigDiff=FALSE()
  &ucbCopyDiff=FALSE()
  IF &supported
  (
    Data.LOAD.Elf "&elfFile" 0xAF400000++0x1FF /DIFF
    &ucbOrigDiff=FOUND()
    Data.LOAD.Elf "&elfFile" 0xAF401000++0x1FF /DIFF
    &ucbCopyDiff=FOUND()
  )

  IF (&ucbOrigDiff)||(&ucbCopyDiff)
  (
    DIALOG.YESNO "Configure UCB_BMHD0_ORIG and UCB_BMHD0_COPY to start demo application?"
    ENTRY &progUcb
  )

  IF (&progUcb)
  (
    ; programming UCB_BMHD0_COPY
    IF (&ucbCopyDiff)
    (
      ; activate UCB_BMHD0_COPY modification
      DO ~~/demo/tricore/flash/tc3xx-ucb.cmm UCB=BMHD0_COPY ACTIVATE

      ; load data of UCB_BMHD0_COPY
      Data.LOAD.Elf "&elfFile" 0xAF401000++0x1FF

      ; Perform a formal verification of the UCB_BMHD0_COPY content.
      ; If the content is formally correct then program the changes to the device.
      ; If the check detected invalid content the flash programming is aborted.
      ; In any case NOP protection is restored for UCB_BMHD0_COPY range.
      DO ~~/demo/tricore/flash/tc3xx-ucb.cmm UCB=BMHD0_COPY PROGRAM
      ENTRY &result

      IF ("&result"!="UCBOK")
        ENDDO

      Data.LOAD.Elf "&elfFile" 0xAF401000++0x1FF /DIFF
      IF FOUND()
      (
        &diffAddress=TRACK.ADDRESS()
        DIALOG.MESSAGE "File &elfFile has not been fully flashed, difference found at address &diffAddress (BMHD0_COPY)"
        ENDDO
      )
    )

    ; programming UCB_BMHD0_ORIG
    IF (&ucbOrigDiff)
    (
      ; activate UCB_BMHD0_ORIG modification
      DO ~~/demo/tricore/flash/tc3xx-ucb.cmm UCB=BMHD0_ORIG ACTIVATE

      ; load data of UCB_BMHD0_ORIG
      Data.LOAD.Elf "&elfFile" 0xAF400000++0x1FF

      ; Perform a formal verification of the UCB_BMHD0_ORIG content.
      ; If the content is formally correct then program the changes to the device.
      ; If the check detected invalid content the flash programming is aborted.
      ; In any case NOP protection is restored for UCB_BMHD0_ORIG range.
      DO ~~/demo/tricore/flash/tc3xx-ucb.cmm UCB=BMHD0_ORIG PROGRAM
      ENTRY &result

      IF ("&result"!="UCBOK")
        ENDDO

      Data.LOAD.Elf "&elfFile" 0xAF400000++0x1FF /DIFF
      IF FOUND()
      (
        &diffAddress=TRACK.ADDRESS()
        DIALOG.MESSAGE "File &elfFile has not been fully flashed, difference found at address &diffAddress (BMHD0_ORIG)"
        ENDDO
      )
    )
  )
  ; ==== Step 3: Verify programming ====

  Data.LOAD.Elf "&elfFile" /DIFF
  IF FOUND()
  (
    ; maybe some sections are still declared as NOP?
    &diffAddress=TRACK.ADDRESS()
    DIALOG.MESSAGE "File &elfFile has not been fully flashed, difference found at address &diffAddress (check flash declaration)"
  )
)

;--------------------------------------------------------------------------------
; select trace method
Trace.Method Onchip
;--------------------------------------------------------------------------------
; set up MCDS trace

; reset all MCDS settings to their defaults
MCDS.RESet

; enable program flow trace for TriCore0
MCDS.ProgramTrace Agents Core0
MCDS.ProgramTrace Mode FlowTrace

Trace.OFF

; --------------------------------------------------------------------------------
; start program execution
Go.direct main
;SYStem.RESetTarget
;Register.Set PC 805F8000

; --------------------------------------------------------------------------------
; open some windows
WinCLEAR
WinPOS 0% 0% 100% 50%
List.auto
WinPOS 0% 50% 50% 50%
Frame.view /Locals /Caller
WinPOS 50% 50% 50% 50%
Var.Watch
Var.AddWatch ast flags
ChDir &basedir_cwd
;SYStem.RESetTarget
;Register.Set PC 805F8000

ENDDO

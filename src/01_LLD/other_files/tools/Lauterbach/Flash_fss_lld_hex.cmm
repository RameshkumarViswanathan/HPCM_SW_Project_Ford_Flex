LOCAL &file_fss_lld_pp_hex &range_fss_lld_pp
LOCAL &elfDir
LOCAL &tmp

&HexDir="D:\home\user123\user\Mohan6_VectorSIP\26Sep\Git_clone27Sep\Git27Sep\25_Software_2\Release\src\01_LLD\outputs"



&range_fss_lld_pp="0x802A4020--0x802FFFFF"
&file_fss_lld_pp_hex="&HexDir"+"/fss_lld_pp.hex"



//fss_lld_pp hex flashing
flash.changetype &range_fss_lld_pp TARGET
flash.auto &range_fss_lld_pp 
Data.LOAD.IntelHex &file_fss_lld_pp_hex &range_fss_lld_pp
flash.auto off

SYStem.RESetTarget
Register.Set PC 805F8000


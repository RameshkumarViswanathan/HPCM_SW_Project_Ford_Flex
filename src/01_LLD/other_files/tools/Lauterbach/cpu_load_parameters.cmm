; Read by cpu_load
; %name: cpu_load_parameters.cmm %
; Define here number of tasks and relative periods in s for cpu load
; Set to empty string for background task
; Set to 0 for aperiodic tasks
; Set to -1 for angular tasks
GLOBAL &tasks_number &task_period_0 &task_period_1 &task_period_2 &task_period_3
GLOBAL &task_period_4 &task_period_5 &task_period_6 &task_period_7
GLOBAL &task_period_8 &task_period_9 &task_period_10 &task_period_11
GLOBAL &task_period_12 &task_period_13 &task_period_14 &task_period_15
&tasks_number=16.     ; Number of tasks
&task_period_0=""     ; Background
&task_period_1=0.024
&task_period_2=1.0
&task_period_3=0.
&task_period_4=0.
&task_period_5=0.
&task_period_6=0.1
&task_period_7=0.012
&task_period_8=0.
&task_period_9=0.
&task_period_10=0.
&task_period_11=0.004
&task_period_12=0.002
&task_period_13=-1.    ; half TDC
&task_period_14=-1.    ; TDC
&task_period_15=-1.    ; Knock

; Auto startup of Lauterbach
PRIVATE &EMUL_PATH &EMUL_VERSION &parameters
ENTRY %line &parameters
				; Look for 'EMUL' scripts
path emul
&EMUL_VERSION=OS.ENV(EMUL)
if "&EMUL_VERSION"==""
(
	LOCAL &result
	DIALOG.YESNO "emul absent in configuration. " \
			"Would you continue anyway?"
	ENTRY &result
	if !&result
		quit
)
else
(
	&EMUL_PATH=OS.FILE.PATH(&EMUL_VERSION)
	&EMUL_VERSION=OS.FILE.NAME(&EMUL_VERSION)
	do t32_config		; only to set an eventual project's &EMUL_VERSION
	&EMUL_VERSION="&EMUL_PATH/&EMUL_VERSION"
	path + &EMUL_VERSION
)
run t32start &parameters

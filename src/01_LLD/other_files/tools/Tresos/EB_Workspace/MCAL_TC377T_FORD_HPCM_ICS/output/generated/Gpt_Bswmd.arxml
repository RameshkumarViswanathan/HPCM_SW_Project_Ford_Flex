AUTOSAR XML (schema 4-2-2)
# Copyright (C) Infineon Technologies (2022)
# All rights reserved.
package /AUTOSAR_Gpt/BswModuleDescriptions
  bsw module description Gpt: category=BSW_MODULE, module-id=100  # GPT Driver
    provided-entrys:
      Gpt_Init
      Gpt_DeInit
      Gpt_GetTimeElapsed
      Gpt_StartTimer
      Gpt_StopTimer
      Gpt_EnableNotification
      Gpt_DisableNotification
      Gpt_SetMode
      Gpt_DisableWakeup
      Gpt_EnableWakeup
      Gpt_GetVersionInfo
      Gpt_Isr
      Gpt_InitCheck
    5 x bsw module dependency:
      DetDependency: category=BSW_MODULE, target-module-id=15, required-entrys=Det_ReportError
      EcuMDependency: category=BSW_MODULE, target-module-id=10, required-entrys=EcuM_SetWakeupEvent
      McalLibDependency: target-module-id=255, required-entrys=[Mcal_SetBitAtomic, Mcal_GetBitAtomic, Mcal_GetCpuIndex]
      McuDependency: target-module-id=101
        required-entrys:
          Mcu_17_Gtm_TomChannelInit
          Mcu_17_Gtm_TomChannelShadowTransfer
          Mcu_17_Gtm_TomChannelEnable
          Mcu_17_Gtm_TomChannelDisable
          Mcu_17_Gtm_TomChannelDeInit
          Mcu_17_Gtm_TomChInitCheck
          Mcu_17_Gtm_AtomChannelInit
          Mcu_17_Gtm_AtomChannelShadowTransfer
          Mcu_17_Gtm_AtomChannelEnable
          Mcu_17_Gtm_AtomChannelDisable
          Mcu_17_Gtm_AtomChannelDeInit
          Mcu_17_Gtm_AtomChInitCheck
      McalSafetyErrorDependency: target-module-id=255, required-entrys=Mcal_ReportSafetyError
    bsw internal behavior GptBehavior
      exclusive area GtmStartTimer
      12 x bsw called entity:
        Gpt_Init: reentrancy-level=NON-REENTRANT, implemented-entry=Gpt_Init
        Gpt_InitCheck: reentrancy-level=NON-REENTRANT, implemented-entry=Gpt_InitCheck
        Gpt_DeInit: reentrancy-level=NON-REENTRANT, implemented-entry=Gpt_DeInit
        Gpt_GetTimeElapsed: reentrancy-level=MULTICORE-REENTRANT, implemented-entry=Gpt_GetTimeElapsed
        Gpt_StartTimer: can-enter-exclusive-area=GtmStartTimer, reentrancy-level=MULTICORE-REENTRANT, implemented-entry=Gpt_StartTimer
        Gpt_StopTimer: reentrancy-level=MULTICORE-REENTRANT, implemented-entry=Gpt_StopTimer
        Gpt_EnableNotification: reentrancy-level=MULTICORE-REENTRANT, implemented-entry=Gpt_EnableNotification
        Gpt_DisableNotification: reentrancy-level=MULTICORE-REENTRANT, implemented-entry=Gpt_DisableNotification
        Gpt_SetMode: reentrancy-level=NON-REENTRANT, implemented-entry=Gpt_SetMode
        Gpt_DisableWakeup: reentrancy-level=MULTICORE-REENTRANT, implemented-entry=Gpt_DisableWakeup
        Gpt_EnableWakeup: reentrancy-level=MULTICORE-REENTRANT, implemented-entry=Gpt_EnableWakeup
        Gpt_GetVersionInfo: reentrancy-level=MULTICORE-REENTRANT, implemented-entry=Gpt_GetVersionInfo
      bsw interrupt entity Gpt_Isr: reentrancy-level=MULTICORE-REENTRANT, implemented-entry=Gpt_Isr, interrupt-category=CAT-1
package /AUTOSAR_Gpt/BswModuleEntrys
  13 x bsw module entry, all with is-synchronous=true:
    Gpt_Init: service-id=1, is-reentrant=false, call-type=REGULAR, execution-context=TASK, sw-service-impl-policy=STANDARD
      sw service arg ConfigPtr: category=DATA_REFERENCE, sw-pointer-target-props={target-category=TYPE_REFERENCE, implementation-data-type=Gpt_ConfigType}
    Gpt_InitCheck: service-id=14, is-reentrant=false, call-type=REGULAR, execution-context=TASK, sw-service-impl-policy=STANDARD
      return type Return: implementation-data-type=Std_ReturnType
      sw service arg ConfigPtr: category=DATA_REFERENCE, sw-pointer-target-props={target-category=TYPE_REFERENCE, implementation-data-type=Gpt_ConfigType}
    Gpt_DeInit: service-id=2, is-reentrant=false, call-type=REGULAR, execution-context=TASK, sw-service-impl-policy=STANDARD
    Gpt_GetTimeElapsed: service-id=3, is-reentrant=true, call-type=REGULAR, execution-context=TASK, sw-service-impl-policy=STANDARD
      return type Return: implementation-data-type=Gpt_ValueType
      sw service arg Channel: implementation-data-type=Gpt_ChannelType
    Gpt_StartTimer: service-id=5, is-reentrant=true, call-type=REGULAR, execution-context=TASK, sw-service-impl-policy=STANDARD
      sw service arg Channel: implementation-data-type=Gpt_ChannelType
      sw service arg Value: implementation-data-type=Gpt_ValueType
    Gpt_StopTimer: service-id=6, is-reentrant=true, call-type=REGULAR, execution-context=TASK, sw-service-impl-policy=STANDARD
      sw service arg Channel: implementation-data-type=Gpt_ChannelType
    Gpt_EnableNotification: service-id=7, is-reentrant=true, call-type=REGULAR, execution-context=TASK, sw-service-impl-policy=STANDARD
      sw service arg Channel: implementation-data-type=Gpt_ChannelType
    Gpt_DisableNotification: service-id=8, is-reentrant=true, call-type=REGULAR, execution-context=TASK, sw-service-impl-policy=STANDARD
      sw service arg Channel: implementation-data-type=Gpt_ChannelType
    Gpt_SetMode: service-id=9, is-reentrant=false, call-type=REGULAR, execution-context=TASK, sw-service-impl-policy=STANDARD
      sw service arg Mode: implementation-data-type=Gpt_ModeType
    Gpt_DisableWakeup: service-id=10, is-reentrant=true, call-type=REGULAR, execution-context=TASK, sw-service-impl-policy=STANDARD
      sw service arg Channel: implementation-data-type=Gpt_ChannelType
    Gpt_EnableWakeup: service-id=11, is-reentrant=true, call-type=REGULAR, execution-context=TASK, sw-service-impl-policy=STANDARD
      sw service arg Channel: implementation-data-type=Gpt_ChannelType
    Gpt_GetVersionInfo: service-id=0, is-reentrant=true, call-type=REGULAR, execution-context=TASK, sw-service-impl-policy=MACRO
      sw service arg VersionInfoPtr: category=DATA_REFERENCE, sw-pointer-target-props={target-category=TYPE_REFERENCE, implementation-data-type=Std_VersionInfoType}
    Gpt_Isr: is-reentrant=true, call-type=INTERRUPT, execution-context=INTERRUPT-CAT-1, sw-service-impl-policy=STANDARD
      sw service arg LogicalChId: implementation-data-type=Gpt_ChannelType
      sw service arg StatusFlags: implementation-data-type=uint32
package /AUTOSAR_Gpt/Implementations
  bsw implementation Gpt: programming-language=C, sw-version=20.20.0, vendor-id=17, ar-release-version=4.2.2, behavior=GptBehavior, vendor-specific-module-def=Gpt
    code-descriptors:
      code Files
        artifact-descriptors:
          short-label=ssc::src::Gpt.c, category=SWSRC
          short-label=ssc::inc::Gpt.h, category=SWHDR
          short-label=ssc::inc::Gpt_Cbk.h, category=SWHDR
    generated-artifacts:
      5 x dependency on artifact:
        Gpt_PBcfg_c: artifact-descriptor={short-label=generate::template::src::Gpt_PBcfg.c, category=SWTEMPLATE}, usages=EXECUTE
        Gpt_Cfg_h: artifact-descriptor={short-label=generate::template::inc::Gpt_Cfg.h, category=SWTEMPLATE}, usages=COMPILE
        Gpt_PBcfg_h: artifact-descriptor={short-label=generate::template::inc::Gpt_PBcfg.h, category=SWTEMPLATE}, usages=EXECUTE
        Gpt_xdm: artifact-descriptor={short-label=config::Gpt.xdm, category=SWTOOL}, usages=CODEGENERATION
        Gpt_bmd: artifact-descriptor={short-label=autosar::TC37x::TC377x::Gpt.bmd, category=SWTOOL}, usages=CODEGENERATION
    resource consumption ResourceConsumption
      11 x memory section:
        VAR_CLEARED_ASIL_B_CORE0_32: alignment=32, sw-addrmethod=VAR_CLEARED
        VAR_INIT_ASIL_B_CORE0_UNSPECIFIED: alignment=UNSPECIFIED, sw-addrmethod=VAR_INIT
        CONST_ASIL_B_CORE0_8: alignment=8, sw-addrmethod=CONST
        CONFIG_DATA_ASIL_B_CORE0_UNSPECIFIED: alignment=UNSPECIFIED, sw-addrmethod=CONFIG_DATA
        CONST_ASIL_B_GLOBAL_UNSPECIFIED: alignment=UNSPECIFIED, sw-addrmethod=CONST
        CONST_ASIL_B_GLOBAL_32: alignment=32, sw-addrmethod=CONST
        VAR_INIT_ASIL_B_GLOBAL_32: alignment=32, sw-addrmethod=VAR_INIT
        VAR_CLEARED_ASIL_B_GLOBAL_32: alignment=32, sw-addrmethod=VAR_CLEARED
        CONFIG_DATA_ASIL_B_GLOBAL_UNSPECIFIED: alignment=UNSPECIFIED, sw-addrmethod=CONFIG_DATA
        CODE_ASIL_B_GLOBAL: alignment=UNSPECIFIED, sw-addrmethod=CODE
        CODE_FAST_ASIL_B_GLOBAL: alignment=UNSPECIFIED, sw-addrmethod=CODE_FAST
      section name prefix GPT
package /AUTOSAR_Gpt/ImplementationDataTypes
  9 x impl type, all with type-emitter=BSW:
    Gpt_ChannelType: implementation-data-type=uint8
    Gpt_ModeType: compu {0=GPT_MODE_NORMAL, 1=GPT_MODE_SLEEP}, implementation-data-type=sint32, additional-native-type-qualifier=enum
    Gpt_NotificationPtrType: category=FUNCTION_REFERENCE, sw-pointer-target-props=IoHwAb_GptNotification
    Gpt_ConfigType: category=STRUCTURE
      element Gpt_Config_CorePtr: category=DATA_REFERENCE, sw-pointer-target-props={target-category=TYPE_REFERENCE, implementation-data-type=Gpt_CoreConfigType}
    Gpt_ValueType: implementation-data-type=uint32
    Gpt_ChannelModeType: implementation-data-type=uint8
    Gpt_EnableWakeupType: implementation-data-type=boolean
    Gpt_ChannelConfigType: category=STRUCTURE
      5 x element:
        GptNotificationPtr: category=DATA_REFERENCE, sw-pointer-target-props={target-category=TYPE_REFERENCE, implementation-data-type=Gpt_NotificationPtrType}
        GptChannelWakeupInfo: implementation-data-type=EcuM_WakeupSourceType
        GptEnableWakeupState: implementation-data-type=Gpt_EnableWakeupType
        GptChannelMode: implementation-data-type=Gpt_ChannelModeType
        GptGtmTimerInfo: implementation-data-type=Mcu_17_Gtm_TomAtomChConfigType
    Gpt_CoreConfigType: category=STRUCTURE
      element Gpt_ChannelIndexPtr: category=DATA_REFERENCE, sw-pointer-target-props={target-category=TYPE_REFERENCE, implementation-data-type=uint8}
      element ChannelConfigPtr: category=DATA_REFERENCE, sw-pointer-target-props={target-category=TYPE_REFERENCE, implementation-data-type=Gpt_ChannelConfigType}
      element Gpt_MaxNormalChannels: implementation-data-type=uint8

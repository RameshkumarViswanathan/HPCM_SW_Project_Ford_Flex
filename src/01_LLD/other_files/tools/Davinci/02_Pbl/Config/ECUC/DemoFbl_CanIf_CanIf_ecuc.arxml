AUTOSAR XML (schema 00050)
package /ActiveEcuC
  module config CanIf: implementation-config-variant=VARIANT-PRE-COMPILE, module-description=CanIf_Impl
    CanIfCtrlDrvCfg_7d254554 (CanIfCtrlDrvCfg): CanIfCtrlDrvTxCancellation=false, CanIfCtrlDrvInitHohConfigRef=CanIfInitHohCfg, CanIfCtrlDrvNameRef=CanGeneral
      3 x CanIfCtrlCfg, all with CanIfCtrlWakeupSupport=false, CanIfCtrlJ1939DynAddrSupport=DISABLED:
        CT_DemoFBL_Ford_CANFD_b8e23c38: CanIfCtrlId=0, CanIfCtrlCanCtrlRef=CT_DemoFBL_Ford_CANFD_b8e23c38
        CT_DemoFBL_Ford_CANFD_b8e23c38_MCAN0: CanIfCtrlId=1, CanIfCtrlCanCtrlRef=CT_DemoFBL_Ford_CANFD_b8e23c38_MCAN0
        CT_DemoFBL_Ford_CANFD_b8e23c38_MCAN1: CanIfCtrlId=2, CanIfCtrlCanCtrlRef=CT_DemoFBL_Ford_CANFD_b8e23c38_MCAN01
    CanIfDispatchCfg:
      CanIfDispatchUserCtrlBusOffName = FblCw_ControllerBusOff
      CanIfDispatchUserCtrlBusOffUL = CDD
      CanIfDispatchUserCtrlModeIndicationName = FblCw_ControllerModeIndication
      CanIfDispatchUserCtrlModeIndicationUL = CDD
    CanIfInitCfg
      CHNL_b66b048e (CanIfBufferCfg):
        CanIfBufferSize = 2
        CanIfTxBufferHandlingType = PRIO_BY_CANID
        CanIfTxBufferMappedTxPdus = 2
        CanIfTxBufferMaxPduLength = 64
        CanIfBufferHthRef = CN_DemoFBL_Ford_CANFD_0f313723_Tx
      Diag_Demo_Request_Message_Tp_oDemoFBL_Ford_CANFD_20_7929cbd3_Rx (CanIfRxPduCfg):
        CanIfRxPduCanId = 2022
        CanIfRxPduCanIdType = STANDARD_NO_FD_CAN
        CanIfRxPduDlc = 8
        CanIfRxPduUserRxIndicationName = CanTp_RxIndication
        CanIfRxPduUserRxIndicationType = PDUID_PDUINFOPTR
        CanIfRxPduUserRxIndicationUL = CAN_TP
        CanIfRxPduId = 1
        CanIfRxPduReadData = false
        CanIfRxPduReadNotifyStatus = false
        CanIfRxPduDlcCheck = false
        CanIfRxPduHrhIdRef = CN_DemoFBL_Ford_CANFD_3332f69a_Rx
        CanIfRxPduRef = Diag_Demo_Request_Message_Tp_oDemoFBL_Ford_CANFD_20_03eb2b50_Rx
      Diag_Functional_Request_Message_Tp_oDemoFBL_Ford_CANFD_49afb74d_Rx (CanIfRxPduCfg):
        CanIfRxPduCanId = 2015
        CanIfRxPduCanIdType = STANDARD_FD_CAN
        CanIfRxPduDlc = 64
        CanIfRxPduUserRxIndicationName = CanTp_RxIndication
        CanIfRxPduUserRxIndicationType = PDUID_PDUINFOPTR
        CanIfRxPduUserRxIndicationUL = CAN_TP
        CanIfRxPduId = 2
        CanIfRxPduReadData = false
        CanIfRxPduReadNotifyStatus = false
        CanIfRxPduDlcCheck = false
        CanIfRxPduHrhIdRef = CN_DemoFBL_Ford_CANFD_3332f69a_Rx
        CanIfRxPduRef = Diag_Functional_Request_Message_Tp_oDemoFBL_Ford_CANFD_b5d38b6f_Rx
      Diag_Demo_Response_Message_Tp_oDemoFBL_Ford_CANFD_c05af67e_Tx (CanIfTxPduCfg):
        CanIfTxPduCanId = 2030
        CanIfTxPduCanIdType = STANDARD_FD_CAN
        CanIfTxPduDlc = 64
        CanIfTxPduUserTxConfirmationName = CanTp_TxConfirmation
        CanIfTxPduUserTxConfirmationUL = CAN_TP
        CanIfTxPduId = 0
        CanIfTxPduReadNotifyStatus = false
        CanIfTxPduType = STATIC
        CanIfTxPduTruncation = true
        CanIfTxPduBufferRef = CHNL_b66b048e
        CanIfTxPduRef = Diag_Demo_Response_Message_Tp_oDemoFBL_Ford_CANFD_9a3b189a_Tx
      Diag_Demo_Response_Message_Tp_oDemoFBL_Ford_CANFD_20_eb76a012_Tx (CanIfTxPduCfg):
        CanIfTxPduCanId = 2030
        CanIfTxPduCanIdType = STANDARD_CAN
        CanIfTxPduDlc = 8
        CanIfTxPduUserTxConfirmationName = CanTp_TxConfirmation
        CanIfTxPduUserTxConfirmationUL = CAN_TP
        CanIfTxPduId = 1
        CanIfTxPduReadNotifyStatus = false
        CanIfTxPduType = STATIC
        CanIfTxPduTruncation = true
        CanIfTxPduBufferRef = CHNL_b66b048e
        CanIfTxPduRef = Diag_Demo_Response_Message_Tp_oDemoFBL_Ford_CANFD_20_4c055dbd_Tx
      Diag_Demo_Request_Message_Tp_oDemoFBL_Ford_CANFD_46777e5a_Rx (CanIfRxPduCfg):
        CanIfRxPduCanId = 2022
        CanIfRxPduCanIdType = STANDARD_FD_CAN
        CanIfRxPduDlc = 64
        CanIfRxPduUserRxIndicationName = CanTp_RxIndication
        CanIfRxPduUserRxIndicationType = PDUID_PDUINFOPTR
        CanIfRxPduUserRxIndicationUL = CAN_TP
        CanIfRxPduId = 0
        CanIfRxPduReadData = false
        CanIfRxPduReadNotifyStatus = false
        CanIfRxPduDlcCheck = false
        CanIfRxPduHrhIdRef = CN_DemoFBL_Ford_CANFD_3332f69a_Rx
        CanIfRxPduRef = Diag_Demo_Request_Message_Tp_oDemoFBL_Ford_CANFD_7e308f1e_Rx
      CanIfInitHohCfg: CanIfInitRefCfgSet=CanConfigSet
        CN_DemoFBL_Ford_CANFD_3332f69a_Rx (CanIfHrhCfg): CanIfHrhSoftwareFilter=true, CanIfHrhCanCtrlIdRef=CT_DemoFBL_Ford_CANFD_b8e23c38, CanIfHrhIdSymRef=CN_DemoFBL_Ford_CANFD_3332f69a_Rx
        CN_DemoFBL_Ford_CANFD_0f313723_Tx (CanIfHthCfg): CanIfHthCanCtrlIdRef=CT_DemoFBL_Ford_CANFD_b8e23c38, CanIfHthIdSymRef=CN_DemoFBL_Ford_CANFD_0f313723_Tx
        CN_DemoFBL_Ford_CANFD_3332f69a_Rx_MCAN0 (CanIfHrhCfg): CanIfHrhSoftwareFilter=true, CanIfHrhCanCtrlIdRef=CT_DemoFBL_Ford_CANFD_b8e23c38_MCAN0, CanIfHrhIdSymRef=CN_DemoFBL_Ford_CANFD_3332f69a_Rx_MCAN0
        CN_DemoFBL_Ford_CANFD_0f313723_Tx_MCAN0 (CanIfHthCfg): CanIfHthCanCtrlIdRef=CT_DemoFBL_Ford_CANFD_b8e23c38_MCAN0, CanIfHthIdSymRef=CN_DemoFBL_Ford_CANFD_0f313723_Tx_MCAN0
        CN_DemoFBL_Ford_CANFD_3332f69a_Rx_MCAN01 (CanIfHrhCfg):
          CanIfHrhSoftwareFilter = true
          CanIfHrhCanCtrlIdRef = CT_DemoFBL_Ford_CANFD_b8e23c38_MCAN1
          CanIfHrhIdSymRef = CN_DemoFBL_Ford_CANFD_3332f69a_Rx_MCAN01
        CN_DemoFBL_Ford_CANFD_0f313723_Tx_MCAN01 (CanIfHthCfg): CanIfHthCanCtrlIdRef=CT_DemoFBL_Ford_CANFD_b8e23c38_MCAN1, CanIfHthIdSymRef=CN_DemoFBL_Ford_CANFD_0f313723_Tx_MCAN01
      5 x CanIfRxPduCfg, all with CanIfRxPduUserRxIndicationName=CanTp_RxIndication, CanIfRxPduUserRxIndicationType=PDUID_PDUINFOPTR, CanIfRxPduUserRxIndicationUL=CAN_TP, CanIfRxPduReadData=false, CanIfRxPduReadNotifyStatus=false, CanIfRxPduDlcCheck=false:
        Diag_Functional_Request_Message_Tp_oDemoFBL_Ford_CANFD_20_36095d77_Rx: CanIfRxPduCanId=2015, CanIfRxPduCanIdType=STANDARD_NO_FD_CAN, CanIfRxPduDlc=8, CanIfRxPduId=3, CanIfRxPduHrhIdRef=CN_DemoFBL_Ford_CANFD_3332f69a_Rx, CanIfRxPduRef=Diag_Functional_Request_Message_Tp_oDemoFBL_Ford_CANFD_20_0bb75f3a_Rx
        Diag_Demo_Request_Message_Tp_oDemoFBL_Ford_CANFD_20_7929cbd3_Rx_CAN0: CanIfRxPduCanId=2023, CanIfRxPduCanIdType=STANDARD_NO_FD_CAN, CanIfRxPduDlc=8, CanIfRxPduId=5, CanIfRxPduHrhIdRef=CN_DemoFBL_Ford_CANFD_3332f69a_Rx_MCAN0, CanIfRxPduRef=Diag_Demo_Request_Message_Tp_oDemoFBL_Ford_CANFD_20_03eb2b50_Rx
        Diag_Demo_Request_Message_Tp_oDemoFBL_Ford_CANFD_46777e5a_Rx_CAN0: CanIfRxPduCanId=2023, CanIfRxPduCanIdType=STANDARD_FD_CAN, CanIfRxPduDlc=64, CanIfRxPduId=4, CanIfRxPduHrhIdRef=CN_DemoFBL_Ford_CANFD_3332f69a_Rx_MCAN0, CanIfRxPduRef=Diag_Demo_Request_Message_Tp_oDemoFBL_Ford_CANFD_7e308f1e_Rx
        Diag_Demo_Request_Message_Tp_oDemoFBL_Ford_CANFD_20_7929cbd3_Rx_CAN01: CanIfRxPduCanId=2024, CanIfRxPduCanIdType=STANDARD_NO_FD_CAN, CanIfRxPduDlc=8, CanIfRxPduId=7, CanIfRxPduHrhIdRef=CN_DemoFBL_Ford_CANFD_3332f69a_Rx_MCAN01, CanIfRxPduRef=Diag_Demo_Request_Message_Tp_oDemoFBL_Ford_CANFD_20_03eb2b50_Rx
        Diag_Demo_Request_Message_Tp_oDemoFBL_Ford_CANFD_46777e5a_Rx_CAN01: CanIfRxPduCanId=2024, CanIfRxPduCanIdType=STANDARD_FD_CAN, CanIfRxPduDlc=64, CanIfRxPduId=6, CanIfRxPduHrhIdRef=CN_DemoFBL_Ford_CANFD_3332f69a_Rx_MCAN01, CanIfRxPduRef=Diag_Demo_Request_Message_Tp_oDemoFBL_Ford_CANFD_7e308f1e_Rx
    CanIfPrivateCfg:
      CanIfPrivateSoftwareFilterType = LINEAR
      CanIfPrivateDlcCheck = false
      CanIfSupportTTCAN = false
      CanIfTransceiverMapping = false
      CanIfTransceiverHandling = false
      CanIfSupportExtendedIds = false
      CanIfSupportNmOsek = false
      CanIfTxBufferType = BYTE_QUEUE
      CanIfWakeupSupport = false
      CanIfStaticFdTxBufferSupport = true
      CanIfRxSearchConsiderMsgType = true
      CanIfTxBufferFifoSupport = false
      CanIfSetPduReceptionModeSupport = false
      CanIfCheckWakeupCanRetType = false
      CanIfDataChecksumRxSupport = false
      CanIfDataChecksumTxSupport = false
    CanIfPublicCfg:
      CanIfPublicPnSupport = false
      CanIfPublicCddHeaderFile = CanIf_Cdd.h
      CanIfPublicVersionInfoApi = false
      CanIfPublicCancelTransmitSupport = false
      CanIfPublicDevErrorDetect = true
      CanIfPublicHandleTypeEnum = UINT8
      CanIfPublicMultipleDrvSupport = false
      CanIfPublicNumberOfCanHwUnits = 1
      CanIfPublicReadRxPduDataApi = false
      CanIfPublicReadRxPduNotifyStatusApi = false
      CanIfPublicReadTxPduNotifyStatusApi = false
      CanIfPublicSetDynamicTxIdApi = false
      CanIfPublicTxBuffering = true
      CanIfPublicTxConfirmPollingSupport = true
      CanIfPublicWakeupCheckValidSupport = false
      CanIfPnWakeupTxPduFilterSupport = false
      CanIfPnTrcvHandlingSupport = false
      CanIfJ1939DynAddrSupport = DISABLED
      CanIfSafeBswChecks = false
      CanIfBusMirroringSupport = false
      CanIfEnableSecurityEventReporting = false
      CanIfSupportCanDrvAsr440 = false
      CanIfSupportMultipartition = false
      CanIfPublicChangeBaudrateSupport = false
      CanIfSetBaudrateApi = false

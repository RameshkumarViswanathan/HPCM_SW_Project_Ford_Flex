AUTOSAR XML (schema 00050)
package /ActiveEcuC
  module config Csm: implementation-config-variant=VARIANT-PRE-COMPILE, module-description=Csm_Impl
    CsmJobs
      3 x CsmJob, all with CsmJobPriority=0, CsmJobUsePort=false, CsmJobInterfaceUsePort=CRYPTO_USE_FNC, CsmProcessingMode=CRYPTO_PROCESSING_SYNC, CsmJobQueueRef=CsmQueue_Standard:
        CsmJob_RandomGenerate: CsmJobId=1, CsmJobPrimitiveRef=Csm/CsmPrimitives_RandomGenerate, CsmJobKeyRef=CsmKey_Smh_Nist_800_90A
        CsmJob_SigAsymVer_RsaPssSha256: CsmJobId=2, CsmJobPrimitiveRef=Csm/CsmPrimitives_SigAsymVer_RsaPssSha256, CsmJobKeyRef=CsmKey_SmhKeyRSA
        CsmJob_HashSha256: CsmJobId=0, CsmJobKeyRef=CsmKey_Smh_HashSha256, CsmJobPrimitiveRef=Csm/CsmPrimitives_HashSha256
    CsmQueues
      CsmQueue_Standard (CsmQueue): CsmQueueSize=1, CsmTriggerAsynchJobsInCallback=false, CsmJobSharing=true, CsmChannelRef=CryIfChannel
    CsmKeys
      3 x CsmKey, all with CsmKeyUsePort=false:
        CsmKey_Smh_HashSha256: CsmKeyId=1, CsmKeyRef=CryIfKeyDummy
        CsmKey_SmhKeyRSA: CsmKeyId=0, CsmKeyRef=CryIfKey_SmhKeyRSA
        CsmKey_Smh_Nist_800_90A: CsmKeyId=2, CsmKeyRef=CryIfKey_Smh_Nist_800_90A
    CsmPrimitives_RandomGenerate (CsmPrimitives)
      CsmRandomGenerate
        CsmPrimitives_RandomGenerate (CsmRandomGenerateConfig):
          CsmRandomGenerateAlgorithmFamiliy = CRYPTO_ALGOFAM_CUSTOM
          CsmRandomGenerateAlgorithmMode = CRYPTO_ALGOMODE_NOT_SET
          CsmRandomGenerateAlgorithmSecondaryFamily = CRYPTO_ALGOFAM_CUSTOM
          CsmRandomGenerateProcessing = CSM_SYNCHRONOUS
          CsmRandomGenerateAlgorithmFamily = CRYPTO_ALGOFAM_CUSTOM
          CsmRandomGenerateResultLength = 16
          CsmRandomGenerateAlgorithmFamilyCustom = CRYPTO_ALGOFAM_CUSTOM_DRBG
          CsmRandomGenerateAlgorithmSecondaryFamilyCustom = CRYPTO_ALGOFAM_AES
    CsmPrimitives_SigAsymVer_RsaPssSha256 (CsmPrimitives)
      CsmSignatureVerify
        CsmPrimitives_SigAsymVer_RsaPssSha256 (CsmSignatureVerifyConfig):
          CsmSignatureVerifyAlgorithmFamily = CRYPTO_ALGOFAM_RSA
          CsmSignatureVerifyAlgorithmMode = CRYPTO_ALGOMODE_RSASSA_PSS
          CsmSignatureVerifyAlgorithmSecondaryFamily = CRYPTO_ALGOFAM_SHA2_256
          CsmSignatureVerifyProcessing = CSM_SYNCHRONOUS
          CsmSignatureVerifyCompareLength = 1
          CsmSignatureVerifyAlgorithmFamiliy = CRYPTO_ALGOFAM_RSA
          CsmSignatureVerifyKeyLength = 32
    CsmGeneral:
      CsmAsymPrivateKeyMaxLength = 32
      CsmAsymPublicKeyMaxLength = 1024
      CsmDevErrorDetect = true
      CsmMainFunctionPeriod = 0.01
      CsmSymKeyMaxLength = 16
      CsmUseDeprecated = false
      CsmVersionInfoApi = false
      CsmCallbackStartNotification = false
      CsmCustomIncludeFiles = Crypto_30_LibCv_Custom.h
      CsmCancelationDuringProcessing = false
      CsmSafeBswChecks = false
      CsmJobTypeLayout:
        CsmJobTypeLayoutVarMembers = true
        CsmJobTypeLayoutAsr430Compatibility = true
        CsmJobTypeLayoutInput64 = false
        CsmJobTypeLayoutOutput64Ptr = false
        CsmJobTypeLayoutRedirectionInfoRef = true
    CsmPrimitives_HashSha256 (CsmPrimitives)
      CsmHash
        CsmPrimitives_HashSha256 (CsmHashConfig):
          CsmHashAlgorithmFamiliy = CRYPTO_ALGOFAM_SHA2_256
          CsmHashAlgorithmFamily = CRYPTO_ALGOFAM_SHA2_256
          CsmHashAlgorithmMode = CRYPTO_ALGOMODE_NOT_SET
          CsmHashAlgorithmSecondaryFamily = CRYPTO_ALGOFAM_NOT_SET
          CsmHashProcessing = CSM_SYNCHRONOUS
          CsmHashResultLength = 32

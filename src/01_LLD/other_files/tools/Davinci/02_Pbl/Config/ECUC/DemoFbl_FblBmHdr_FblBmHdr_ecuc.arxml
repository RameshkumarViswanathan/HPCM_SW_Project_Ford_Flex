AUTOSAR XML (schema 00050)
package /ActiveEcuC
  module config FblBmHdr: implementation-config-variant=VARIANT-PRE-COMPILE, module-description=FblBmHdr_Impl
    FblBmHdrGeneral: FblBmHdrMaxVerificationEntries=1, FblBmHdrSbVerificationList=false
    Appl (FblBmHdrTarget): FblBmHdrTargetId=2
    Data (FblBmHdrTarget): FblBmHdrTargetId=3
    FblBmHdrHeader:
      FblBmHdrEntryAddressInclude = BrsMain.h
      FblBmHdrEntryAddress = Brs_ApplicationEntry
      FblBmHdrBlockStartAddress = 2153381888
      FblBmHdrBlockLength = 327679
      FblBmHdrTargetRef = Fbl
      FblBmHdrVariant
        FblBmHdrAuthenticationHeader: FblBmHdrAuthenticationHeaderAddress=2153381920
    Fbl (FblBmHdrTarget): FblBmHdrTargetId=0
    FblUpdater (FblBmHdrTarget): FblBmHdrTargetId=1

AUTOSAR XML (schema 00050)
package /ActiveEcuC
  module config Can: implementation-config-variant=VARIANT-PRE-COMPILE, module-description=Can_Impl
    CanGeneral:
      CanIndex = 0
      CanVersionInfoApi = false
      CanUseNestedCANInterrupts = false
      CanSetBaudrateApi = false
      CanChangeBaudrateApi = false
      CanDevErrorDetection = true
      CanHardwareCancellation = false
      CanIdenticalIdCancellation = false
      CanMainFunctionBusoffPeriod = 0.01
      CanMainFunctionModePeriod = 0.01
      CanMainFunctionWakeupPeriod = 0.01
      CanMultiplexedTransmission = false
      CanTimeoutDuration = 0.01
      CanGenericPrecopy = true
      CanHardwareLoopCheck = true
      CanSecureTempBuffer = false
      CanRxFullCANSupport = false
      CanTxFullCANSupport = false
      CanRxBasicCANSupport = true
      CanHardwareCancelByAppl = true
      CanIndividualProcessing = false
      CanGenericConfirmation = false
      CanGenericConfirmationAPI2 = false
      CanRxQueue = false
      CanSupportMixedID = false
      CanRxQueueSize = 10
      CanMultipleBasicCANObjects = false
      CanMultipleBasicCANTxObjects = false
      CanHardwareHandleType = UINT8
      CanOptimizeOneController = false
      CanInterruptCategory = VOIDFUNCVOID
      CanGetStatus = false
      CanInterruptLock = DRIVER
      CanWakeupSupport = false
      CanRamCheck = None
      CanOverrunNotification = DET
      CanReinitStart = false
      CanGenericPreTransmit = false
      CanFdSupport = FULL
      CanRuntimeMeasurementSupport = false
      CanMaxRxDataLen = 64
      CanMaxTxDataLen = 64
      CanUsePeripheralAccessApi = false
      CanMirrorModeSupport = false
      CanUseOsInterruptControl = false
      CanSafeBswChecks = false
      CanSilentModeSupport = false
      CanHwTxFifoSupport = false
      CanMcanRevision = M_CAN_REV_315
      CanCheckWakeupCanRetType = false
      CanFdHardwareBufferOptimization = true
      CanEccInit = true
      CanUseVirtualAddressing = false
      CanEnableSecurityEventReporting = false
      CanCounterRef = OsCounter
      CanMainFunctionRWPeriods: CanMainFunctionReadPeriod=0.001, CanMainFunctionWritePeriod=0.001
    CanConfigSet
      CN_DemoFBL_Ford_CANFD_0f313723_Tx (CanHardwareObject):
        CanHandleType = BASIC
        CanIdValue = 0
        CanObjectType = TRANSMIT
        CanIdType = STANDARD
        CanObjectId = 0
        CanHwProcessing = true
        CanObjectHwSize = 1
        CanObjectHwHandle = 0
        CanMaxDataLen = 64
        CanFdPaddingValue = 0
        CanObjectMultiplexedTransmission = false
        CanObjectHwFifo = false
        CanControllerRef = CT_DemoFBL_Ford_CANFD_b8e23c38
        CanMainFunctionRWPeriodRef = CanMainFunctionRWPeriods
      CN_DemoFBL_Ford_CANFD_3332f69a_Rx (CanHardwareObject):
        CanHandleType = BASIC
        CanIdType = STANDARD
        CanIdValue = 0
        CanObjectType = RECEIVE
        CanObjectId = 1
        CanHwProcessing = true
        CanObjectHwSize = 16
        CanObjectHwHandle = 0
        CanMaxDataLen = 64
        CanFdPaddingValue = 0
        CanObjectMultiplexedTransmission = false
        CanObjectHwFifo = false
        CanControllerRef = CT_DemoFBL_Ford_CANFD_b8e23c38
        CanFilterMaskRef = CT_DemoFBL_Ford_CANFD_b8e23c38/CanFilterMask
        CanMainFunctionRWPeriodRef = CanMainFunctionRWPeriods
      CT_DemoFBL_Ford_CANFD_b8e23c38 (CanController):
        CanControllerActivation = true
        CanBusoffProcessing = POLLING
        CanRxProcessing = POLLING
        CanTxProcessing = POLLING
        CanWakeupProcessing = POLLING
        CanControllerBaseAddress = 4028727552
        CanControllerId = 0
        CanWakeupSupport = false
        CanWakeupSourceId = 0
        CanBasisAddressEnum = M_CAN4
        CanTxBufferElementSize = ES_64
        CanRxBufferElementSize = ES_8
        CanRxFifo0ElementSize = ES_64
        CanRxFifo1ElementSize = ES_8
        CanMaxNrOfRxFifo0Elements = 64
        CanMaxNrOfRxFifo1Elements = 64
        CanMaxNrOfRxBuffers = 64
        CanMaxNrOfTxBuffers = 32
        CanIsTTCAN = false
        CanTxEfBufferElementSize = ES_8
        CanIOPort = b_010
        CanCommonCAN = false
        CanControllerDefaultBaudrate = CT_DemoFBL_Ford_CANFD_b8e23c38/CanControllerBaudrateConfig
        CanControllerSystemRef = CT_DemoFBL_Ford_CANFD
        CanWakeupSourceRef = CN_DemoFBL_Ford_CANFD_0f313723
        CanCpuClockRef = McuClockReferencePoint_Can
        CanControllerBaudrateConfig:
          CanControllerBaudRate = 1000
          CanControllerBaudRateConfigID = 0
          CanControllerPropSeg = 9
          CanControllerSeg1 = 54
          CanControllerSeg2 = 16
          CanControllerSyncJumpWidth = 5
          CanBaudrateClock = 80000
          CanBaudratePrescaler = 1
          CanControllerFdBaudrateConfig:
            CanControllerFdBaudRate = 2000
            CanControllerPropSeg = 8
            CanControllerSeg1 = 23
            CanControllerSeg2 = 8
            CanControllerSyncJumpWidth = 3
            CanControllerTxBitRateSwitch = true
            CanBaudratePrescaler = 1
        CanFilterMask: CanFilterMaskValue=0, CanFilterCodeValue=0, IsLocked=false
      CT_DemoFBL_Ford_CANFD_b8e23c38_MCAN0 (CanController):
        CanControllerActivation = true
        CanBusoffProcessing = POLLING
        CanRxProcessing = POLLING
        CanTxProcessing = POLLING
        CanWakeupProcessing = POLLING
        CanControllerBaseAddress = 4028662016
        CanControllerId = 1
        CanWakeupSupport = false
        CanWakeupSourceId = 0
        CanBasisAddressEnum = M_CAN0
        CanTxBufferElementSize = ES_8
        CanRxBufferElementSize = ES_8
        CanRxFifo0ElementSize = ES_64
        CanRxFifo1ElementSize = ES_8
        CanMaxNrOfRxFifo0Elements = 64
        CanMaxNrOfRxFifo1Elements = 64
        CanMaxNrOfRxBuffers = 64
        CanMaxNrOfTxBuffers = 32
        CanIsTTCAN = true
        CanTxEfBufferElementSize = ES_8
        CanIOPort = b_001
        CanCommonCAN = false
        CanControllerDefaultBaudrate = CT_DemoFBL_Ford_CANFD_b8e23c38/CanControllerBaudrateConfig
        CanControllerSystemRef = CT_DemoFBL_Ford_CANFD
        CanWakeupSourceRef = CN_DemoFBL_Ford_CANFD_0f313723
        CanCpuClockRef = McuClockReferencePoint_Can
        CanControllerBaudrateConfig:
          CanControllerBaudRate = 1000
          CanControllerBaudRateConfigID = 0
          CanControllerPropSeg = 9
          CanControllerSeg1 = 54
          CanControllerSeg2 = 16
          CanControllerSyncJumpWidth = 5
          CanBaudrateClock = 80000
          CanBaudratePrescaler = 1
          CanControllerFdBaudrateConfig:
            CanControllerFdBaudRate = 2000
            CanControllerPropSeg = 8
            CanControllerSeg1 = 23
            CanControllerSeg2 = 8
            CanControllerSyncJumpWidth = 3
            CanControllerTxBitRateSwitch = true
            CanBaudratePrescaler = 1
        CanFilterMask: CanFilterMaskValue=0, CanFilterCodeValue=0, IsLocked=false
      CN_DemoFBL_Ford_CANFD_0f313723_Tx_MCAN0 (CanHardwareObject):
        CanHandleType = BASIC
        CanIdValue = 0
        CanObjectType = TRANSMIT
        CanIdType = STANDARD
        CanObjectId = 2
        CanHwProcessing = true
        CanObjectHwSize = 1
        CanObjectHwHandle = 0
        CanMaxDataLen = 8
        CanFdPaddingValue = 0
        CanObjectMultiplexedTransmission = false
        CanObjectHwFifo = false
        CanControllerRef = CT_DemoFBL_Ford_CANFD_b8e23c38_MCAN0
        CanMainFunctionRWPeriodRef = CanMainFunctionRWPeriods
      CN_DemoFBL_Ford_CANFD_3332f69a_Rx_MCAN0 (CanHardwareObject):
        CanHandleType = BASIC
        CanIdType = STANDARD
        CanIdValue = 0
        CanObjectType = RECEIVE
        CanObjectId = 3
        CanHwProcessing = true
        CanObjectHwSize = 16
        CanObjectHwHandle = 0
        CanMaxDataLen = 64
        CanFdPaddingValue = 0
        CanObjectMultiplexedTransmission = false
        CanObjectHwFifo = false
        CanControllerRef = CT_DemoFBL_Ford_CANFD_b8e23c38_MCAN0
        CanMainFunctionRWPeriodRef = CanMainFunctionRWPeriods
        CanFilterMaskRef = CT_DemoFBL_Ford_CANFD_b8e23c38_MCAN0/CanFilterMask
      CT_DemoFBL_Ford_CANFD_b8e23c38_MCAN01 (CanController):
        CanControllerActivation = true
        CanBusoffProcessing = POLLING
        CanRxProcessing = POLLING
        CanTxProcessing = POLLING
        CanWakeupProcessing = POLLING
        CanControllerBaseAddress = 4028663040
        CanControllerId = 2
        CanWakeupSupport = false
        CanWakeupSourceId = 0
        CanBasisAddressEnum = M_CAN1
        CanTxBufferElementSize = ES_8
        CanRxBufferElementSize = ES_8
        CanRxFifo0ElementSize = ES_64
        CanRxFifo1ElementSize = ES_8
        CanMaxNrOfRxFifo0Elements = 64
        CanMaxNrOfRxFifo1Elements = 64
        CanMaxNrOfRxBuffers = 64
        CanMaxNrOfTxBuffers = 32
        CanIsTTCAN = false
        CanTxEfBufferElementSize = ES_8
        CanIOPort = b_001
        CanCommonCAN = false
        CanControllerDefaultBaudrate = CT_DemoFBL_Ford_CANFD_b8e23c38/CanControllerBaudrateConfig
        CanControllerSystemRef = CT_DemoFBL_Ford_CANFD
        CanWakeupSourceRef = CN_DemoFBL_Ford_CANFD_0f313723
        CanCpuClockRef = McuClockReferencePoint_Can
        CanControllerBaudrateConfig:
          CanControllerBaudRate = 1000
          CanControllerBaudRateConfigID = 0
          CanControllerPropSeg = 9
          CanControllerSeg1 = 54
          CanControllerSeg2 = 16
          CanControllerSyncJumpWidth = 5
          CanBaudrateClock = 80000
          CanBaudratePrescaler = 1
          CanControllerFdBaudrateConfig:
            CanControllerFdBaudRate = 2000
            CanControllerPropSeg = 8
            CanControllerSeg1 = 23
            CanControllerSeg2 = 8
            CanControllerSyncJumpWidth = 3
            CanControllerTxBitRateSwitch = true
            CanBaudratePrescaler = 1
        CanFilterMask: CanFilterMaskValue=0, CanFilterCodeValue=0, IsLocked=false
      CN_DemoFBL_Ford_CANFD_0f313723_Tx_MCAN01 (CanHardwareObject):
        CanHandleType = BASIC
        CanIdValue = 0
        CanObjectType = TRANSMIT
        CanIdType = STANDARD
        CanObjectId = 4
        CanHwProcessing = true
        CanObjectHwSize = 1
        CanObjectHwHandle = 0
        CanMaxDataLen = 8
        CanFdPaddingValue = 0
        CanObjectMultiplexedTransmission = false
        CanObjectHwFifo = false
        CanControllerRef = CT_DemoFBL_Ford_CANFD_b8e23c38_MCAN01
        CanMainFunctionRWPeriodRef = CanMainFunctionRWPeriods
      CN_DemoFBL_Ford_CANFD_3332f69a_Rx_MCAN01 (CanHardwareObject):
        CanHandleType = BASIC
        CanIdType = STANDARD
        CanIdValue = 0
        CanObjectType = RECEIVE
        CanObjectId = 5
        CanHwProcessing = true
        CanObjectHwSize = 16
        CanObjectHwHandle = 0
        CanMaxDataLen = 64
        CanFdPaddingValue = 0
        CanObjectMultiplexedTransmission = false
        CanObjectHwFifo = false
        CanControllerRef = CT_DemoFBL_Ford_CANFD_b8e23c38_MCAN01
        CanMainFunctionRWPeriodRef = CanMainFunctionRWPeriods
        CanFilterMaskRef = CT_DemoFBL_Ford_CANFD_b8e23c38_MCAN01/CanFilterMask

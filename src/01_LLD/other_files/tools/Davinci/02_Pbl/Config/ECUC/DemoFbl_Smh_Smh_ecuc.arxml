AUTOSAR XML (schema 00050)
package /ActiveEcuC
  module config Smh: implementation-config-variant=VARIANT-LINK-TIME, module-description=Smh_Impl
    SmhVerification
      SmhMonolithicVerification:
        SmhCRCWrittenGet = true
        SmhCRCTotal = false
        SmhCRCWritten = true
        SmhExportVerificationWrapper = false
        SmhOperationCountOfWrapper = 4
        SmhCheckAddressRangeOverflow = false
        SmhAssertReadCount = false
        SmhMemoryAccessMode = ADDRESS
        SmhReadBufferSize = 64
        SmhDefaultMonolithicVerificationConfig = SmhSecurityClassCCCConfig_RSA2048
        SmhSecurityClassCCC: SmhDefaultSecurityClassCCCConfig=SmhSecurityClassCCCConfig_RSA2048
          SmhSecurityClassCCCConfig_RSA2048 (SmhSecurityClassCCCConfig):
            SmhCRCOffset = 0
            SmhFunctionName = SecM_VerificationClassCCC_Rsa2048PssSha256
            SmhIncludeAddressAndLengthInSignature = true
            SmhSignatureOffset = 0
            SmhStreamVerificationConfig = SmhSecurityClassCCCConfig
        SmhSecurityClassDDD: SmhDefaultSecurityClassDDDConfig=SmhSecurityClassDDD/SmhSecurityClassDDDConfig
          SmhSecurityClassDDDConfig:
            SmhCRCOffset = 32
            SmhSignatureOffset = 0
            SmhFunctionName = SecM_VerificationClassDDD_Sha256
            SmhIncludeAddressAndLengthInSignature = false
            SmhStreamVerificationConfig = SmhSecurityClassDDD/SmhSecurityClassDDDConfig
      SmhStreamVerification: SmhDefaultStreamVerificationConfig=SmhSecurityClassCCCConfig
        SmhSecurityClassCCC: SmhDefaultSecurityClassCCCConfig=SmhSecurityClassCCCConfig
          SmhSecurityClassCCCConfig:
            SmhFunctionName = SecM_VerifyClassCCC_Rsa2048PssSha256
            SmhUpdateLengthOfHashedData = false
            SmhContextBufferSize = 0
            SmhJobRef = SmhJob_SignatureVerify_Rsa2048PssSha256/SmhJob_SignatureVerify_Rsa2048PssSha256
          SmhSecurityClassCCCConfig_Token (SmhSecurityClassCCCConfig):
            SmhFunctionName = FblDiagVerifyTokenSignature
            SmhUpdateLengthOfHashedData = false
            SmhContextBufferSize = 0
            SmhJobRef = SmhJob_SignatureVerify_Rsa2048PssSha256_Token/SmhJob_SignatureVerify_Rsa2048PssSha256_Token
        SmhSecurityClassDDD: SmhDefaultSecurityClassDDDConfig=SmhSecurityClassDDD/SmhSecurityClassDDDConfig
          SmhSecurityClassDDDConfig: SmhFunctionName=SecM_VerifySha256, SmhComputationOnly=true, SmhUpdateLengthOfHashedData=false
            SmhSecurityClassDDDType
              SmhHash: SmhJobRef=SmhJob_HashSha256/SmhJob_HashSha256
    SmhSeedKey: SmhKeyTimeout=100, SmhCallCycle=10
      SmhSeedConfig: SmhSeedType=BYTE_ARRAY, SmhSeedLength=16
        SmhSeedGeneration
          SmhCsm: SmhJobRef=SmhJob_RandomGenerate/SmhJob_RandomGenerate
        SmhEntropy: SmhEntropySize=32, SmhEntropyUsage=EXPLICIT, SmhJobRef=SmhJob_RandomSeed/SmhJob_RandomSeed
      SmhKeyConfig: SmhExtendedApi=true, SmhKeyConstant=0, SmhKeyType=BYTE_ARRAY, SmhKeyLength=18, SmhExternalComparison=false, SmhSecretKeyLength=12, SmhAsymmetric=false
    SmhGeneral:
      SmhWatchdogCycleCount = 32
      SmhCryptographicKeysLocatedInRAM = false
      SmhOperationMode = PRODUCTION
      SmhProvidevSecPrimRandomFunction = true
      SmhUserConfigFile = $(DpaProjectFolder)\Config\smh_usr.cfg
      SmhSaveRestoreContext = false
      SmhCustomPrimitiveIds:
        SmhCustomFamilyIdMd5 = 191
        SmhCustomFamilyIdEccAnsi = 129
        SmhCustomFamilyIdEccSec = 130
        SmhCustomModeP224R1 = 148
        SmhCustomModeP256R1 = 128
        SmhCustomModeP384R1 = 131
    SmhCryptographicKeys: SmhElementIdRSAPublicExponent=161, SmhElementIdRSAModulus=160, SmhElementIdRSAPrivateExponent=162
      SecM_RsaDevelopment (SmhKey): SmhDescription=Public part of RSAKey01_2048, SmhKeyValueRef=SecM_RsaModDevelopment, SmhKeyValueRef=SecM_RsaExpDevelopment
      6 x SmhKeyValue:
        SecM_RsaExpDevelopment: SmhValue=00010001, SmhDescription=Software Signature Development Public Key Exponent, SmhSuffix=Exp, SmhCryptoKeyElementRef=Smh_Crypto_30_LibCv_Rsa_Pub_Exponent
        SecM_RsaModDevelopment: SmhSuffix=Mod, SmhValue=BAB76EFFD1B5F83C8E07136727C34D5D8FE6BBA8E0D2079C424713FD1AB17AED48AE617151D4D5DB052DDCDD271E8B361FF8616D9A5E77FE72748BD7BF733F922176571C200A4AAC5068947576C4650241DAC94F623CB74375AC19B474A66B3AB84DEF8093D3D17BEEFCC350C30D1FAD6691DBC3F3FD63A11525B83E7B5350FCDDEB4E9EDF821AAA515665AFDE66372A0A70E271D723A5FABF5860DF9BFC02DC10D2CE10388D75E4FD98F82A4BE030F42015D80131B22635EB544960D3566EB5E8B7AC6D388F3EE4E4CBDE72D797291E54C4695976B80A26CBC7798EB003B7F28FA47089AC4D3208A8A3D8D8C0895697C5DE3A47E04DD9A3C91E8F08934882C7, SmhDescription=Software Signature Development Public Key Modulus, SmhCryptoKeyElementRef=Smh_Crypto_30_LibCv_Rsa2048_Modulus
        SecM_RsaExpTokenFunction: SmhSuffix=Exp, SmhValue=00010001, SmhDescription=Token Function Public Key Exponent, SmhCryptoKeyElementRef=Smh_Crypto_30_LibCv_Rsa_Pub_Exponent
        SecM_RsaModTokenFunction: SmhSuffix=Mod, SmhValue=c1716f96ec8716d453ed584a1e02332546fbb2ff801a1c258a45d9540e067c547b1047c3fa05562f6ba9b4e8f70364cb2e3a349ebfd3e37d38f09778c083b1b98d91fe4b868047f2167b27a0dd33f3d9cc2822cc771e574b5c87133f60cb552e6b5909ba235775fd6fe95b5ca8af4a07c34980e1fb157bb807a17fadbe0094e6e3737b1c0885be0b47b3eb052d21985b63db31704fe1a6ca00528335e8a4f8e1b12dae611c302e5838b887ab9fc4136524608c4df9e462964f69bf6f9591ea6bca4fb74ba59205bacd6634197502be15e9aa9de78d4791c3f02e0e47a800c3c267c53213f2125fd36c013fafaca53469be9219d5034e4a784d7cab9c0739ce67, SmhDescription=Token Function Public Key Modulus, SmhCryptoKeyElementRef=Smh_Crypto_30_LibCv_Rsa2048_Modulus
        SecM_RsaExpKeyChange: SmhSuffix=Exp, SmhValue=00010001, SmhDescription=Key Change Public Key Exponent, SmhCryptoKeyElementRef=Smh_Crypto_30_LibCv_Rsa_Pub_Exponent
        SecM_RsaModKeyChange: SmhSuffix=Mod, SmhValue=afd9946a537fccaa714b6f03ff721a3e658ec969c1349f9023381eed07a52ce1f12ae65aa53cb8cb3a005372f9913e2371b2028ae35b4f6db1250f5e5cfa76b44ca277289c423bdbd67375e756ad530d253fabd15fe61cd35b6f32eab8fe7841ce7eceea302c09e784c888dc6282214e3701e404e84ae2b198b724f433428cc3deec7ebde454932bc14dc1a4bf550c68c59f338f8b17187786fdb4366d32d0bf4dd6f8648673199179a7595850c78166b109dbbd9709bc2cbf6019f48078cab4857e637476f46b89924468a62bf44a25595b1e6da81aa82b1d7d333c696e359c8a982c6543f3f42b326f36d7d7a0a71d201f7c006d8520ebc0e1fc6d18026295, SmhDescription=Key Change Public Key Modulus, SmhCryptoKeyElementRef=Smh_Crypto_30_LibCv_Rsa2048_Modulus
      SecM_RsaTokenFunction (SmhKey): SmhDescription=Token Function key, SmhKeyValueRef=SecM_RsaExpTokenFunction, SmhKeyValueRef=SecM_RsaModTokenFunction
      SecM_RsaKeyChange (SmhKey): SmhDescription=SecM_RsaKeyChange, SmhKeyValueRef=SecM_RsaExpKeyChange, SmhKeyValueRef=SecM_RsaModKeyChange
      SmhKeyOperations: SmhAccessKeyElementApis=false, SmhCopyKeyElementApi=false, SmhCopyKeyApi=false
    5 x SmhJob:
      SmhJob_RandomSeed
        SmhJob_RandomSeed (SmhRandomSeed): SmhCsmKeyRef=CsmKey_Smh_Nist_800_90A
      SmhJob_RandomGenerate
        SmhJob_RandomGenerate (SmhRandomGenerate): SmhCsmJobRef=CsmJob_RandomGenerate
      SmhJob_SignatureVerify_Rsa2048PssSha256
        SmhJob_SignatureVerify_Rsa2048PssSha256 (SmhSignatureVerify): SmhCsmJobRef=CsmJob_SigAsymVer_RsaPssSha256, SmhCryptographicKeyRef=SecM_RsaDevelopment
      SmhJob_HashSha256
        SmhJob_HashSha256 (SmhHash): SmhCsmJobRef=CsmJob_HashSha256
      SmhJob_SignatureVerify_Rsa2048PssSha256_Token
        SmhJob_SignatureVerify_Rsa2048PssSha256_Token (SmhSignatureVerify): SmhCsmJobRef=CsmJob_SigAsymVer_RsaPssSha256, SmhCryptographicKeyRef=SecM_RsaTokenFunction
    SmhCrc: SmhCRCType=CRC_16_CCITT
      SmhCrc16: SmhOptimization=SPEED, SmhInitialValue=65535, SmhPolynomial=4129, SmhMode=NON_REFLECTED, SmhComplementValue=0
    SmhEncryption

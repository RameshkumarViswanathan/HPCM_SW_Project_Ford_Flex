AUTOSAR XML (schema 00050)
package /ActiveEcuC
  module config PduR: implementation-config-variant=VARIANT-PRE-COMPILE, module-description=PduR_Impl
    PduRGeneral:
      PduRVersionInfoApi = false
      PduRDevErrorDetect = true
      PduRMetaDataSupport = false
      PduRPduCallback = false
      PduRSwitching = false
      PduRSafeBswChecks = false
      PduREnableDeferredTransmission = false
      PduREnableDeferredReception = false
      PduRSupportMulticore = false
      PduRRoutingTypeGateway = false
      PduRSpinlockRetryCounter = 4294967295
      PduRExtendedErrorChecks = false
      PduRGeneration:
        PduROutOfBoundsWriteProtectionStrategy = NONE
        PduROutOfBoundsWriteSanitizer = false
        PduROutOfBoundsReadSanitizer = false
        PduRNumericalDataTypeMinimizationStrategy = WITH_CAST
        PduRReduceConstantData2Define = false
        PduRBoolDataInArrayOfStructStrategy = BITMASKING
        PduRDeduplicateIndirectedData = true
        PduRDataDeduplicationStrategy = WITH_CAST
        PduRReduceBoolDataByNegationThreshold = 2
        PduRReduceBoolDataByNumericalComparisonThreshold = 2
        PduRReduceBoolDataByNumericalRelationThreshold = 2
        PduRReduceBoolDataByNumericalOperandStrategy = WITH_ANY_VALUE
        PduRReduceNumericalDataByOffsetThreshold = 2
        PduRReduceNumericalDataByArraySubtractionThreshold = 2
        PduRReduceDataByStreaming = false
        PduRShortSymbols = false
        PduRInterfacesForDeactivatedData = false
        PduRReferringKeysInComments = false
    PduRRoutingTables: PduRConfigurationId=0
      PduRRoutingTable
        6 x PduRRoutingPath, all with PduRRoutingPathCommunicationType=TRANSPORT_PROTOCOL, PduRMulticoreRoutingPath=false, PduRLockRef=PduRLock_PduRExclusiveArea:
          Diag_Demo_Request_Message_oDemoFBL_Ford_CANFD_645d95ca_Rx
            Diag_Demo_Request_Message_oDemoFBL_Ford_CANFD_645d95ca_Rx_94824d04_Rx (PduRDestPdu):
              PduRDestPduHandleId = 1
              PduRDestPduDirection = RECEIVE
              PduRDestPduRoutingType = API_FORWARDING
              PduRDestPduDataProcessing = IMMEDIATE
              PduRPduLengthHandlingStrategy = UNUSED
              PduRDestPduCrossPartitionDestination = false
              PduRDestPduRef = Diag_Demo_Request_Message_oDemoFBL_Ford_CANFD_937daa12_Rx
              PduRDestPduPduRBswModulesRef = Dcm
            PduRSrcPdu_94824d04 (PduRSrcPdu):
              PduRSourcePduHandleId = 1
              PduRSrcPduDirection = RECEIVE
              PduRSrcPduRef = Diag_Demo_Request_Message_oDemoFBL_Ford_CANFD_645d95ca_Rx
              PduRSrcPduPduRBswModulesRef = CanTp
          Diag_Demo_Response_Message_oDemoFBL_Ford_CANFD_075f1067_Tx
            PduRSrcPdu_85698b31 (PduRSrcPdu):
              PduRSourcePduHandleId = 1
              PduRSrcPduDirection = TRANSMIT
              PduRSrcPduRef = Diag_Demo_Response_Message_oDemoFBL_Ford_CANFD_075f1067_Tx
              PduRSrcPduPduRBswModulesRef = Dcm
            Diag_Demo_Response_Message_oDemoFBL_Ford_CANFD_d48e43f7_Tx (PduRDestPdu):
              PduRDestPduHandleId = 1
              PduRDestPduDirection = TRANSMIT
              PduRDestPduRoutingType = API_FORWARDING
              PduRDestPduDataProcessing = IMMEDIATE
              PduRPduLengthHandlingStrategy = UNUSED
              PduRDestPduCrossPartitionDestination = false
              PduRDestPduRef = Diag_Demo_Response_Message_oDemoFBL_Ford_CANFD_d48e43f7_Tx
              PduRDestPduPduRBswModulesRef = CanTp
          Diag_Demo_Request_Message_oDemoFBL_Ford_CANFD_20_0a455198_Rx
            Diag_Demo_Request_Message_oDemoFBL_Ford_CANFD_20_0a455198_Rx_62ee5758_Rx (PduRDestPdu):
              PduRDestPduHandleId = 0
              PduRDestPduDirection = RECEIVE
              PduRDestPduRoutingType = API_FORWARDING
              PduRDestPduDataProcessing = IMMEDIATE
              PduRPduLengthHandlingStrategy = UNUSED
              PduRDestPduCrossPartitionDestination = false
              PduRDestPduRef = Diag_Demo_Request_Message_oDemoFBL_Ford_CANFD_20_36f6fa2d_Rx
              PduRDestPduPduRBswModulesRef = Dcm
            PduRSrcPdu_62ee5758 (PduRSrcPdu):
              PduRSourcePduHandleId = 0
              PduRSrcPduDirection = RECEIVE
              PduRSrcPduRef = Diag_Demo_Request_Message_oDemoFBL_Ford_CANFD_20_0a455198_Rx
              PduRSrcPduPduRBswModulesRef = CanTp
          Diag_Functional_Request_Message_oDemoFBL_Ford_CANFD_20_c1a655e9_Rx
            Diag_Functional_Request_Message_oDemoFBL_Ford_CANFD_20_c1a655e9_Rx_86978413_Rx (PduRDestPdu):
              PduRDestPduHandleId = 2
              PduRDestPduDirection = RECEIVE
              PduRDestPduRoutingType = API_FORWARDING
              PduRDestPduDataProcessing = IMMEDIATE
              PduRPduLengthHandlingStrategy = UNUSED
              PduRDestPduCrossPartitionDestination = false
              PduRDestPduRef = Diag_Functional_Request_Message_oDemoFBL_Ford_CANFD_20_b3c5bf5e_Rx
              PduRDestPduPduRBswModulesRef = Dcm
            PduRSrcPdu_86978413 (PduRSrcPdu):
              PduRSourcePduHandleId = 2
              PduRSrcPduDirection = RECEIVE
              PduRSrcPduRef = Diag_Functional_Request_Message_oDemoFBL_Ford_CANFD_20_c1a655e9_Rx
              PduRSrcPduPduRBswModulesRef = CanTp
          Diag_Demo_Response_Message_oDemoFBL_Ford_CANFD_20_af8657d4_Tx
            Diag_Demo_Response_Message_oDemoFBL_Ford_CANFD_20_ee4ec61c_Tx (PduRDestPdu):
              PduRDestPduHandleId = 0
              PduRDestPduDirection = TRANSMIT
              PduRDestPduRoutingType = API_FORWARDING
              PduRDestPduDataProcessing = IMMEDIATE
              PduRPduLengthHandlingStrategy = UNUSED
              PduRDestPduCrossPartitionDestination = false
              PduRDestPduRef = Diag_Demo_Response_Message_oDemoFBL_Ford_CANFD_20_ee4ec61c_Tx
              PduRDestPduPduRBswModulesRef = CanTp
            PduRSrcPdu_459069b4 (PduRSrcPdu):
              PduRSourcePduHandleId = 0
              PduRSrcPduDirection = TRANSMIT
              PduRSrcPduRef = Diag_Demo_Response_Message_oDemoFBL_Ford_CANFD_20_af8657d4_Tx
              PduRSrcPduPduRBswModulesRef = Dcm
          Diag_Functional_Request_Message_oDemoFBL_Ford_CANFD_bd4dd5f9_Rx
            Diag_Functional_Request_Message_oDemoFBL_Ford_CANFD_bd4dd5f9_Rx_82f15fa2_Rx (PduRDestPdu):
              PduRDestPduHandleId = 3
              PduRDestPduDirection = RECEIVE
              PduRDestPduRoutingType = API_FORWARDING
              PduRDestPduDataProcessing = IMMEDIATE
              PduRPduLengthHandlingStrategy = UNUSED
              PduRDestPduCrossPartitionDestination = false
              PduRDestPduRef = Diag_Functional_Request_Message_oDemoFBL_Ford_CANFD_f0d52d28_Rx
              PduRDestPduPduRBswModulesRef = Dcm
            PduRSrcPdu_82f15fa2 (PduRSrcPdu):
              PduRSourcePduHandleId = 3
              PduRSrcPduDirection = RECEIVE
              PduRSrcPduRef = Diag_Functional_Request_Message_oDemoFBL_Ford_CANFD_bd4dd5f9_Rx
              PduRSrcPduPduRBswModulesRef = CanTp
      PduRLock_PduRExclusiveArea (PduRLock)
        PduRExclusiveArea: PduRExclusiveAreaId=0
    CanTp (PduRBswModules):
      PduRChangeParameterRequestApi = true
      PduRCancelReceive = false
      PduRCancelTransmit = false
      PduRCommunicationInterface = false
      PduRLowerModule = true
      PduRTransportProtocol = true
      PduRTriggertransmit = false
      PduRTxConfirmation = false
      PduRUpperModule = false
      PduRUseTag = false
      PduRBswModuleRef = CanTp
    Dcm (PduRBswModules):
      PduRChangeParameterRequestApi = true
      PduRCancelReceive = false
      PduRCancelTransmit = false
      PduRCommunicationInterface = false
      PduRLowerModule = false
      PduRTransportProtocol = true
      PduRTriggertransmit = false
      PduRTxConfirmation = false
      PduRUpperModule = true
      PduRUseTag = true
      PduRBswModuleRef = Dcm

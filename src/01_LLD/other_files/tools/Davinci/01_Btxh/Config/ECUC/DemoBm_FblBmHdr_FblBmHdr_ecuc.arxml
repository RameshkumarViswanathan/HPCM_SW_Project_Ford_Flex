AUTOSAR XML (schema 00050)
package /ActiveEcuC
  module config FblBmHdr: implementation-config-variant=VARIANT-PRE-COMPILE, module-description=FblBmHdr_Impl
    FblBmHdrGeneral: FblBmHdrMaxVerificationEntries=1, FblBmHdrSbVerificationList=false
    Appl (FblBmHdrTarget): FblBmHdrTargetId=2
    Data (FblBmHdrTarget): FblBmHdrTargetId=3
    FblBmHdrHeader:
      FblBmHdrEntryAddressInclude = fbl_main.h
      FblBmHdrEntryAddress = FblMainInternal
      FblBmHdrBlockStartAddress = 0
      FblBmHdrBlockLength = 1
      FblBmHdrTargetRef = Fbl
      FblBmHdrVariant
        FblBmHdrAuthenticationHeader: FblBmHdrAuthenticationHeaderAddress=0
    Fbl (FblBmHdrTarget): FblBmHdrTargetId=0
    FblUpdater (FblBmHdrTarget): FblBmHdrTargetId=1

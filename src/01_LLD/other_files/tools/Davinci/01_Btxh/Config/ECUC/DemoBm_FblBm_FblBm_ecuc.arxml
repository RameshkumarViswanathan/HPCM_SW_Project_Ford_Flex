AUTOSAR XML (schema 00050)
package /ActiveEcuC
  module config FblBm: implementation-config-variant=VARIANT-PRE-COMPILE, module-description=FblBm_Impl
    FblBmBootOrder
      FblBmBootTarget_APPL (FblBmBootTarget): FblBmBootOrderId=0, FblBmBootTargetRef=Appl
      FblBmBootTarget_UPD (FblBmBootTarget): FblBmBootOrderId=1, FblBmBootTargetRef=FblUpdater
    FblBmGeneral:
      FblBmFailsafeUpdater = false
      FblBmIncludeHardwareConfiguration = false
      FblBmIncludeOemConfiguration = false
      FblBmInitializeKeys = false
      FblBmInitializeMacOfBootloader = false
      FblBmSecureBoot = false
      FblBmHeaderAddress = 2147516384
      FblBmStandaloneMode = true
      FblBmExecutionInstance = BootManager

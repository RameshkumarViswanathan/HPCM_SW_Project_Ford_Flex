AUTOSAR XML (schema 00050)
package /ActiveEcuC
  ecuc value collection ActiveEcuC: ecuc-values=[vLinkGen, MemMap, EcuC, FblBmHdr, FblBm, FblHal, Fbl, vBRS, vBaseEnv, vLinkGen, vSet]

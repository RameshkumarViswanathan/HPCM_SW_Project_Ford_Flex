AUTOSAR XML (schema 00050)
package /ActiveEcuC
  module config vLinkGen: implementation-config-variant=VARIANT-PRE-COMPILE, module-description=vLinkGen_Impl
    vLinkGenMemLayout
      24 x vLinkGenMemoryRegion, all with vLinkGenMemoryRegionAvailable=true:
        RamDsprCpu1_FordAppl_IStack: vLinkGenMemoryRegionAddrOffset=154624, vLinkGenMemoryRegionSize=29696, vLinkGenMemoryRegionAddress=1610767360, vLinkGenMemoryRegionHwRegion=DSPR1
          RamDsprCpu1_FordAppl_IStack (vLinkGenMemoryRegionBlock):
            vLinkGenMemoryRegionBlockPosition = 0
            vLinkGenMemoryRegionBlockSize = 29696
            vLinkGenMemoryRegionBlockAddress = 1610767360
            vLinkGenMemoryRegionBlockBoundary = LOWER
            vLinkGenMemoryRegionBlockInitStage = NONE
        RamDsprCpu2_FordAppl_IStack: vLinkGenMemoryRegionAddrOffset=39936, vLinkGenMemoryRegionSize=13312, vLinkGenMemoryRegionAddress=1342217216, vLinkGenMemoryRegionHwRegion=DSPR2
          RamDsprCpu2_FordAppl_IStack (vLinkGenMemoryRegionBlock):
            vLinkGenMemoryRegionBlockPosition = 0
            vLinkGenMemoryRegionBlockSize = 13312
            vLinkGenMemoryRegionBlockAddress = 1342217216
            vLinkGenMemoryRegionBlockBoundary = LOWER
            vLinkGenMemoryRegionBlockInitStage = NONE
        RamDsprCpu2_FordAppl_Stack: vLinkGenMemoryRegionAddrOffset=26624, vLinkGenMemoryRegionSize=13312, vLinkGenMemoryRegionAddress=1342203904, vLinkGenMemoryRegionHwRegion=DSPR2
          RamDsprCpu2_FordAppl_Stack (vLinkGenMemoryRegionBlock):
            vLinkGenMemoryRegionBlockPosition = 0
            vLinkGenMemoryRegionBlockSize = 12288
            vLinkGenMemoryRegionBlockAddress = 1342203904
            vLinkGenMemoryRegionBlockBoundary = LOWER
            vLinkGenMemoryRegionBlockInitStage = NONE
        RamDsprCpu2_FordAppl_Bss_Data: vLinkGenMemoryRegionAddrOffset=12288, vLinkGenMemoryRegionSize=14336, vLinkGenMemoryRegionAddress=1342189568, vLinkGenMemoryRegionHwRegion=DSPR2
          RamDsprCpu2_FordAppl_Bss_Data (vLinkGenMemoryRegionBlock):
            vLinkGenMemoryRegionBlockPosition = 0
            vLinkGenMemoryRegionBlockSize = 14336
            vLinkGenMemoryRegionBlockAddress = 1342189568
            vLinkGenMemoryRegionBlockBoundary = LOWER
            vLinkGenMemoryRegionBlockInitStage = NONE
        RamDsprCpu2_FordAppl_Csa: vLinkGenMemoryRegionAddrOffset=53248, vLinkGenMemoryRegionSize=45056, vLinkGenMemoryRegionAddress=1342230528, vLinkGenMemoryRegionHwRegion=DSPR2
          RamDsprCpu2_FordAppl_Csa (vLinkGenMemoryRegionBlock):
            vLinkGenMemoryRegionBlockPosition = 0
            vLinkGenMemoryRegionBlockSize = 45056
            vLinkGenMemoryRegionBlockAddress = 1342230528
            vLinkGenMemoryRegionBlockBoundary = LOWER
            vLinkGenMemoryRegionBlockInitStage = NONE
        RamDsprCpu2_FordAppl_Sdata: vLinkGenMemoryRegionAddrOffset=0, vLinkGenMemoryRegionSize=12288, vLinkGenMemoryRegionAddress=1342177280, vLinkGenMemoryRegionHwRegion=DSPR2
          RamDsprCpu2_FordAppl_Sdata (vLinkGenMemoryRegionBlock):
            vLinkGenMemoryRegionBlockPosition = 0
            vLinkGenMemoryRegionBlockSize = 12288
            vLinkGenMemoryRegionBlockAddress = 1342177280
            vLinkGenMemoryRegionBlockBoundary = LOWER
            vLinkGenMemoryRegionBlockInitStage = NONE
        RamDsprCpu1_FordAppl_Sdata: vLinkGenMemoryRegionAddrOffset=0, vLinkGenMemoryRegionSize=61440, vLinkGenMemoryRegionAddress=1610612736, vLinkGenMemoryRegionHwRegion=DSPR1
          RamDsprCpu1_FordAppl_Sdata (vLinkGenMemoryRegionBlock):
            vLinkGenMemoryRegionBlockPosition = 0
            vLinkGenMemoryRegionBlockSize = 61440
            vLinkGenMemoryRegionBlockAddress = 1610612736
            vLinkGenMemoryRegionBlockBoundary = LOWER
            vLinkGenMemoryRegionBlockInitStage = NONE
        RamDsprCpu1_FordAppl_Bss_Data: vLinkGenMemoryRegionAddrOffset=61440, vLinkGenMemoryRegionSize=63488, vLinkGenMemoryRegionAddress=1610674176, vLinkGenMemoryRegionHwRegion=DSPR1
          RamDsprCpu1_FordAppl_Bss_data (vLinkGenMemoryRegionBlock):
            vLinkGenMemoryRegionBlockPosition = 0
            vLinkGenMemoryRegionBlockSize = 63488
            vLinkGenMemoryRegionBlockAddress = 1610674176
            vLinkGenMemoryRegionBlockBoundary = LOWER
            vLinkGenMemoryRegionBlockInitStage = NONE
        RamDsprCpu1_FordAppl_Stack: vLinkGenMemoryRegionAddrOffset=124928, vLinkGenMemoryRegionSize=29696, vLinkGenMemoryRegionAddress=1610737664, vLinkGenMemoryRegionHwRegion=DSPR1
          RamDsprCpu1_FordAppl_Stack (vLinkGenMemoryRegionBlock):
            vLinkGenMemoryRegionBlockPosition = 0
            vLinkGenMemoryRegionBlockSize = 29696
            vLinkGenMemoryRegionBlockAddress = 1610737664
            vLinkGenMemoryRegionBlockBoundary = LOWER
            vLinkGenMemoryRegionBlockInitStage = NONE
        RamDsprCpu1_FordAppl_Csa: vLinkGenMemoryRegionAddrOffset=184320, vLinkGenMemoryRegionSize=61440, vLinkGenMemoryRegionAddress=1610797056, vLinkGenMemoryRegionHwRegion=DSPR1
          RamDsprCpu1_FordAppl_Csa (vLinkGenMemoryRegionBlock):
            vLinkGenMemoryRegionBlockPosition = 0
            vLinkGenMemoryRegionBlockSize = 61440
            vLinkGenMemoryRegionBlockAddress = 1610797056
            vLinkGenMemoryRegionBlockBoundary = LOWER
            vLinkGenMemoryRegionBlockInitStage = NONE
        RamDsprCpu0_LLDAppl_RAMCODE: vLinkGenMemoryRegionAddrOffset=233720, vLinkGenMemoryRegionSize=2048, vLinkGenMemoryRegionAddress=1879281912, vLinkGenMemoryRegionHwRegion=DSPR0
          RamDsprCpu0_LLDAppl_RAMCODE (vLinkGenMemoryRegionBlock):
            vLinkGenMemoryRegionBlockPosition = 0
            vLinkGenMemoryRegionBlockSize = 2048
            vLinkGenMemoryRegionBlockAddress = 1879281912
            vLinkGenMemoryRegionBlockBoundary = LOWER
            vLinkGenMemoryRegionBlockInitStage = NONE
        RamDsprCpu0_LLDAppl_RamConstSection: vLinkGenMemoryRegionAddrOffset=192504, vLinkGenMemoryRegionSize=2048, vLinkGenMemoryRegionAddress=1879240696, vLinkGenMemoryRegionHwRegion=DSPR0
          RamDsprCpu0_LLDAppl_RamConstSection (vLinkGenMemoryRegionBlock):
            vLinkGenMemoryRegionBlockPosition = 0
            vLinkGenMemoryRegionBlockSize = 2048
            vLinkGenMemoryRegionBlockAddress = 1879240696
            vLinkGenMemoryRegionBlockBoundary = LOWER
            vLinkGenMemoryRegionBlockInitStage = NONE
        RamDsprCpu0_LLDAppl_Csa: vLinkGenMemoryRegionAddrOffset=235768, vLinkGenMemoryRegionSize=2048, vLinkGenMemoryRegionAddress=1879283960, vLinkGenMemoryRegionHwRegion=DSPR0
          RamDsprCpu0_LLDAppl_Csa (vLinkGenMemoryRegionBlock):
            vLinkGenMemoryRegionBlockPosition = 0
            vLinkGenMemoryRegionBlockSize = 2048
            vLinkGenMemoryRegionBlockAddress = 1879283960
            vLinkGenMemoryRegionBlockBoundary = LOWER
            vLinkGenMemoryRegionBlockInitStage = NONE
        RamDsprCpu0_IPC_ResetSafe: vLinkGenMemoryRegionAddrOffset=9208, vLinkGenMemoryRegionSize=8192, vLinkGenMemoryRegionAddress=1879057400, vLinkGenMemoryRegionHwRegion=DSPR0
          RamDsprCpu0_IPC_ResetSafe (vLinkGenMemoryRegionBlock):
            vLinkGenMemoryRegionBlockPosition = 0
            vLinkGenMemoryRegionBlockSize = 8192
            vLinkGenMemoryRegionBlockAddress = 1879057400
            vLinkGenMemoryRegionBlockBoundary = LOWER
            vLinkGenMemoryRegionBlockInitStage = NONE
        RamDsprCpu0_IPC: vLinkGenMemoryRegionAddrOffset=8184, vLinkGenMemoryRegionSize=1024, vLinkGenMemoryRegionAddress=1879056376, vLinkGenMemoryRegionHwRegion=DSPR0
          RamDsprCpu0_IPC (vLinkGenMemoryRegionBlock):
            vLinkGenMemoryRegionBlockPosition = 0
            vLinkGenMemoryRegionBlockSize = 1024
            vLinkGenMemoryRegionBlockAddress = 1879056376
            vLinkGenMemoryRegionBlockBoundary = LOWER
            vLinkGenMemoryRegionBlockInitStage = NONE
        RamDsprCpu0_KernelErLog_MR: vLinkGenMemoryRegionAddrOffset=1088, vLinkGenMemoryRegionSize=952, vLinkGenMemoryRegionAddress=1879049280, vLinkGenMemoryRegionHwRegion=DSPR0
          RamDsprCpu0_KernelErLog_MR (vLinkGenMemoryRegionBlock):
            vLinkGenMemoryRegionBlockPosition = 0
            vLinkGenMemoryRegionBlockSize = 952
            vLinkGenMemoryRegionBlockAddress = 1879049280
            vLinkGenMemoryRegionBlockBoundary = LOWER
            vLinkGenMemoryRegionBlockInitStage = NONE
        RamDsprCpu0_FDAppl_DataShadow: vLinkGenMemoryRegionAddrOffset=6136, vLinkGenMemoryRegionSize=1024, vLinkGenMemoryRegionAddress=1879054328, vLinkGenMemoryRegionHwRegion=DSPR0
          RamDsprCpu0_FDAppl_DataShadow (vLinkGenMemoryRegionBlock):
            vLinkGenMemoryRegionBlockPosition = 0
            vLinkGenMemoryRegionBlockSize = 1024
            vLinkGenMemoryRegionBlockAddress = 1879054328
            vLinkGenMemoryRegionBlockBoundary = LOWER
            vLinkGenMemoryRegionBlockInitStage = NONE
        RamDsprCpu0_CalibShadow_Tbl: vLinkGenMemoryRegionAddrOffset=2040, vLinkGenMemoryRegionSize=4096, vLinkGenMemoryRegionAddress=1879050232, vLinkGenMemoryRegionHwRegion=DSPR0
          RamDsprCpu0_CalibShadow_Tbl (vLinkGenMemoryRegionBlock):
            vLinkGenMemoryRegionBlockPosition = 0
            vLinkGenMemoryRegionBlockSize = 4096
            vLinkGenMemoryRegionBlockAddress = 1879050232
            vLinkGenMemoryRegionBlockBoundary = LOWER
            vLinkGenMemoryRegionBlockInitStage = NONE
        RamDsprCpu0_LLDAppl_IStack: vLinkGenMemoryRegionAddrOffset=233464, vLinkGenMemoryRegionSize=256, vLinkGenMemoryRegionAddress=1879281656, vLinkGenMemoryRegionHwRegion=DSPR0
          RamDsprCpu0_LLDAppl_IStack (vLinkGenMemoryRegionBlock):
            vLinkGenMemoryRegionBlockPosition = 0
            vLinkGenMemoryRegionBlockSize = 256
            vLinkGenMemoryRegionBlockAddress = 1879281656
            vLinkGenMemoryRegionBlockBoundary = LOWER
            vLinkGenMemoryRegionBlockInitStage = NONE
        RamDsprCpu0_NVRamSdata_Sbss: vLinkGenMemoryRegionAddrOffset=7160, vLinkGenMemoryRegionSize=1024, vLinkGenMemoryRegionAddress=1879055352, vLinkGenMemoryRegionHwRegion=DSPR0
          RamDsprCpu0_NVRamSdata_Sbss (vLinkGenMemoryRegionBlock):
            vLinkGenMemoryRegionBlockPosition = 0
            vLinkGenMemoryRegionBlockSize = 1024
            vLinkGenMemoryRegionBlockAddress = 1879055352
            vLinkGenMemoryRegionBlockBoundary = LOWER
            vLinkGenMemoryRegionBlockInitStage = NONE
        RamDsprCpu0_Sys_KAM: vLinkGenMemoryRegionAddrOffset=1024, vLinkGenMemoryRegionSize=64, vLinkGenMemoryRegionAddress=1879049216, vLinkGenMemoryRegionHwRegion=DSPR0
          RamDsprCpu0_Sys_KAM (vLinkGenMemoryRegionBlock):
            vLinkGenMemoryRegionBlockPosition = 0
            vLinkGenMemoryRegionBlockSize = 64
            vLinkGenMemoryRegionBlockAddress = 1879049216
            vLinkGenMemoryRegionBlockBoundary = LOWER
            vLinkGenMemoryRegionBlockInitStage = NONE
        RamDsprCpu0_XH_Buffer: vLinkGenMemoryRegionAddrOffset=0, vLinkGenMemoryRegionSize=1024, vLinkGenMemoryRegionAddress=1879048192, vLinkGenMemoryRegionHwRegion=DSPR0
          RamDsprCpu0_XH_Buffer (vLinkGenMemoryRegionBlock):
            vLinkGenMemoryRegionBlockPosition = 0
            vLinkGenMemoryRegionBlockSize = 1024
            vLinkGenMemoryRegionBlockAddress = 1879048192
            vLinkGenMemoryRegionBlockBoundary = LOWER
            vLinkGenMemoryRegionBlockInitStage = NONE
        Pspr_Cpu2: vLinkGenMemoryRegionAddrOffset=0, vLinkGenMemoryRegionSize=65536, vLinkGenMemoryRegionAddress=1343225856, vLinkGenMemoryRegionHwRegion=PSPR2
          Pspr_Cpu2 (vLinkGenMemoryRegionBlock):
            vLinkGenMemoryRegionBlockPosition = 0
            vLinkGenMemoryRegionBlockSize = 65536
            vLinkGenMemoryRegionBlockAddress = 1343225856
            vLinkGenMemoryRegionBlockBoundary = LOWER
            vLinkGenMemoryRegionBlockInitStage = NONE
        Pspr_Cpu1: vLinkGenMemoryRegionAddrOffset=0, vLinkGenMemoryRegionSize=65536, vLinkGenMemoryRegionAddress=1611661312, vLinkGenMemoryRegionHwRegion=PSPR1
          Pspr_Cpu1 (vLinkGenMemoryRegionBlock):
            vLinkGenMemoryRegionBlockPosition = 0
            vLinkGenMemoryRegionBlockSize = 65536
            vLinkGenMemoryRegionBlockAddress = 1611661312
            vLinkGenMemoryRegionBlockBoundary = LOWER
            vLinkGenMemoryRegionBlockInitStage = NONE
      19 x vLinkGenLogicalConstGroup:
        FblRamCode: vLinkGenConstGroupPosition=1, vLinkGenConstGroupInitCore=0, vLinkGenConstGroupVariant=vLinkGenVariantHandling/DemoFbl, vLinkGenConstGroupVariant=DemoBm, vLinkGenConstGroupContentType=RAM_CODE, vLinkGenConstGroupRegion=BmRomArea, vLinkGenConstGroupRamRegion=RamDsprCpu0_LLDAppl_Data_Bss/RamDsprCpu0_LLDAppl_Data_Bss, vLinkGenConstGroupVariant=vLinkGenVariantHandling/DemoAppl
          RamCodeSection (vLinkGenConstSectionGroup):
            vLinkGenConstSectionGroupPosition = 0
            vLinkGenConstSectionGroupInit = COPY_TO_RAM
            vLinkGenConstSectionGroupInitStage = ONE
            vLinkGenConstSectionGroupAlignment = 4
            vLinkGenConstSectionGroupEndAlignment = 4
            vLinkGenConstSectionGroupRef = RamCodeCoreSection
          vLinkGenConstGroupVariantHandling
            DemoFbl (vLinkGenConstGroupVariantSpecifics): vLinkGenConstGroupSpecificRegion=FblRomArea, vLinkGenConstGroupSpecificVariant=vLinkGenVariantHandling/DemoFbl
            DemoAppl (vLinkGenConstGroupVariantSpecifics): vLinkGenConstGroupSpecificRegion=ApplRomArea, vLinkGenConstGroupSpecificVariant=vLinkGenVariantHandling/DemoAppl
        FblRamConst: vLinkGenConstGroupPosition=0, vLinkGenConstGroupInitCore=0, vLinkGenConstGroupVariant=vLinkGenVariantHandling/DemoFbl, vLinkGenConstGroupVariant=DemoBm, vLinkGenConstGroupContentType=RAM_CONST, vLinkGenConstGroupRegion=BmRomArea, vLinkGenConstGroupRamRegion=RamDsprCpu0_LLDAppl_Data_Bss/RamDsprCpu0_LLDAppl_Data_Bss, vLinkGenConstGroupVariant=vLinkGenVariantHandling/DemoAppl
          RamConstSection (vLinkGenConstSectionGroup):
            vLinkGenConstSectionGroupPosition = 0
            vLinkGenConstSectionGroupInit = COPY_TO_RAM
            vLinkGenConstSectionGroupInitStage = ONE
            vLinkGenConstSectionGroupAlignment = 4
            vLinkGenConstSectionGroupEndAlignment = 4
            vLinkGenConstSectionGroupRef = vLinkGenLinkerSections/RamConstSection
          vLinkGenConstGroupVariantHandling
            DemoFbl (vLinkGenConstGroupVariantSpecifics): vLinkGenConstGroupSpecificRegion=FblRomArea, vLinkGenConstGroupSpecificVariant=vLinkGenVariantHandling/DemoFbl
            DemoAppl (vLinkGenConstGroupVariantSpecifics): vLinkGenConstGroupSpecificRegion=ApplRomArea, vLinkGenConstGroupSpecificVariant=vLinkGenVariantHandling/DemoAppl
        MSR_CODE: vLinkGenConstGroupPosition=50, vLinkGenConstGroupContentType=GLOBAL_CODE, vLinkGenConstGroupVariant=vLinkGenVariantHandling/DemoFbl, vLinkGenConstGroupVariant=DemoBm, vLinkGenConstGroupVariant=vLinkGenVariantHandling/DemoAppl, vLinkGenConstGroupRegion=BmRomArea
          MSR_CODE (vLinkGenConstSectionGroup):
            vLinkGenConstSectionGroupPosition = 0
            vLinkGenConstSectionGroupInit = NONE
            vLinkGenConstSectionGroupInitStage = ONE
            vLinkGenConstSectionGroupRef = vLinkGenLinkerSections/MSR_CODE
          vLinkGenConstGroupVariantHandling
            DemoFbl (vLinkGenConstGroupVariantSpecifics): vLinkGenConstGroupSpecificRegion=FblRomArea, vLinkGenConstGroupSpecificVariant=vLinkGenVariantHandling/DemoFbl
            DemoAppl (vLinkGenConstGroupVariantSpecifics): vLinkGenConstGroupSpecificRegion=ApplRomArea, vLinkGenConstGroupSpecificVariant=vLinkGenVariantHandling/DemoAppl
        MSR_CONST: vLinkGenConstGroupPosition=50, vLinkGenConstGroupContentType=GLOBAL_CONST, vLinkGenConstGroupVariant=vLinkGenVariantHandling/DemoFbl, vLinkGenConstGroupVariant=DemoBm, vLinkGenConstGroupVariant=vLinkGenVariantHandling/DemoAppl, vLinkGenConstGroupRegion=BmRomArea
          MSR_CONST (vLinkGenConstSectionGroup):
            vLinkGenConstSectionGroupPosition = 0
            vLinkGenConstSectionGroupInit = NONE
            vLinkGenConstSectionGroupInitStage = ONE
            vLinkGenConstSectionGroupRef = vLinkGenLinkerSections/MSR_CONST
            vLinkGenConstSectionGroupRef = MSR_CONST_FAST
          vLinkGenConstGroupVariantHandling
            DemoFbl (vLinkGenConstGroupVariantSpecifics): vLinkGenConstGroupSpecificRegion=FblRomArea, vLinkGenConstGroupSpecificVariant=vLinkGenVariantHandling/DemoFbl
            DemoAppl (vLinkGenConstGroupVariantSpecifics): vLinkGenConstGroupSpecificRegion=ApplRomArea, vLinkGenConstGroupSpecificVariant=vLinkGenVariantHandling/DemoAppl
        MSR_PBCFG_CONST: vLinkGenConstGroupPosition=50, vLinkGenConstGroupContentType=GLOBAL_CONST, vLinkGenConstGroupVariant=vLinkGenVariantHandling/DemoFbl, vLinkGenConstGroupVariant=DemoBm, vLinkGenConstGroupVariant=vLinkGenVariantHandling/DemoAppl, vLinkGenConstGroupRegion=BmRomArea
          MSR_PBCFG_CONST (vLinkGenConstSectionGroup):
            vLinkGenConstSectionGroupPosition = 0
            vLinkGenConstSectionGroupInit = NONE
            vLinkGenConstSectionGroupInitStage = ONE
            vLinkGenConstSectionGroupRef = vLinkGenLinkerSections/MSR_PBCFG_CONST
            vLinkGenConstSectionGroupRef = MSR_PBCFG_CONST_FAST
          vLinkGenConstGroupVariantHandling
            DemoFbl (vLinkGenConstGroupVariantSpecifics): vLinkGenConstGroupSpecificRegion=FblRomArea, vLinkGenConstGroupSpecificVariant=vLinkGenVariantHandling/DemoFbl
            DemoAppl (vLinkGenConstGroupVariantSpecifics): vLinkGenConstGroupSpecificRegion=ApplRomArea, vLinkGenConstGroupSpecificVariant=vLinkGenVariantHandling/DemoAppl
        Brs_ExcVectRam: vLinkGenConstGroupInitCore=0, vLinkGenConstGroupPosition=5, vLinkGenConstGroupContentType=RAM_CONST, vLinkGenConstGroupRegion=BmRomArea, vLinkGenConstGroupRamRegion=RamDsprCpu0_LLDAppl_Data_Bss/RamDsprCpu0_LLDAppl_Data_Bss, vLinkGenConstGroupVariant=vLinkGenVariantHandling/DemoFbl, vLinkGenConstGroupVariant=vLinkGenVariantHandling/DemoAppl, vLinkGenConstGroupVariant=DemoBm
          Brs_ExcVectRam (vLinkGenConstSectionGroup):
            vLinkGenConstSectionGroupAlignment = 256
            vLinkGenConstSectionGroupEndAlignment = 8
            vLinkGenConstSectionGroupGapSize = 16
            vLinkGenConstSectionGroupInit = COPY_TO_RAM
            vLinkGenConstSectionGroupInitStage = ONE
            vLinkGenConstSectionGroupPosition = 0
            vLinkGenConstSectionGroupRef = brsExcVectRam
          vLinkGenConstGroupVariantHandling
            DemoFbl (vLinkGenConstGroupVariantSpecifics): vLinkGenConstGroupSpecificRegion=FblRomArea, vLinkGenConstGroupSpecificVariant=vLinkGenVariantHandling/DemoFbl
            DemoAppl (vLinkGenConstGroupVariantSpecifics): vLinkGenConstGroupSpecificRegion=ApplRomArea, vLinkGenConstGroupSpecificVariant=vLinkGenVariantHandling/DemoAppl
        Brs_ExcVect: vLinkGenConstGroupPosition=2, vLinkGenConstGroupContentType=GLOBAL_EXCVEC_CONST, vLinkGenConstGroupVariant=DemoBm, vLinkGenConstGroupRegion=BmRom_Startup
          Brs_ExcVect (vLinkGenConstSectionGroup):
            vLinkGenConstSectionGroupAlignment = 256
            vLinkGenConstSectionGroupEndAlignment = 8
            vLinkGenConstSectionGroupGapSize = 16
            vLinkGenConstSectionGroupPosition = 0
            vLinkGenConstSectionGroupInit = NONE
            vLinkGenConstSectionGroupInitStage = ONE
            vLinkGenConstSectionGroupRef = brsExcVect
            vLinkGenConstSectionGroupRef = brsExcVectConst
        Brs_Startup_Code: vLinkGenConstGroupPosition=1, vLinkGenConstGroupContentType=STARTUP_CODE, vLinkGenConstGroupVariant=DemoBm, vLinkGenConstGroupRegion=BmRom_Startup, vLinkGenConstGroupVariant=vLinkGenVariantHandling/DemoFbl, vLinkGenConstGroupVariant=vLinkGenVariantHandling/DemoAppl
          Brs_Startup_Code (vLinkGenConstSectionGroup):
            vLinkGenConstSectionGroupPosition = 0
            vLinkGenConstSectionGroupInit = NONE
            vLinkGenConstSectionGroupInitStage = ONE
            vLinkGenConstSectionGroupRef = brsStartup
          BrsMain_Startup_Code (vLinkGenConstSectionGroup):
            vLinkGenConstSectionGroupPosition = 0
            vLinkGenConstSectionGroupInit = NONE
            vLinkGenConstSectionGroupInitStage = ONE
            vLinkGenConstSectionGroupRef = brsMainStartup
          vLinkGenConstGroupVariantHandling
            fss_lld (vLinkGenConstGroupVariantSpecifics): vLinkGenConstGroupSpecificRegion=ApplRom_Startup, vLinkGenConstGroupSpecificVariant=vLinkGenVariantHandling/DemoAppl
            DemoFbl (vLinkGenConstGroupVariantSpecifics): vLinkGenConstGroupSpecificVariant=vLinkGenVariantHandling/DemoFbl, vLinkGenConstGroupSpecificRegion=FblRomStartup
        Brs_Shared_Const: vLinkGenConstGroupPosition=5, vLinkGenConstGroupContentType=GLOBAL_CONST, vLinkGenConstGroupVariant=DemoBm, vLinkGenConstGroupVariant=vLinkGenVariantHandling/DemoFbl, vLinkGenConstGroupVariant=vLinkGenVariantHandling/DemoAppl, vLinkGenConstGroupRegion=BmRomArea
          Brs_Shared_Const (vLinkGenConstSectionGroup):
            vLinkGenConstSectionGroupPosition = 0
            vLinkGenConstSectionGroupInit = NONE
            vLinkGenConstSectionGroupInitStage = ONE
            vLinkGenConstSectionGroupRef = brsSharedConst
          vLinkGenConstGroupVariantHandling
            DemoAppl (vLinkGenConstGroupVariantSpecifics): vLinkGenConstGroupSpecificVariant=vLinkGenVariantHandling/DemoAppl, vLinkGenConstGroupSpecificRegion=ApplRomArea
        Const_Default: vLinkGenConstGroupPosition=1000, vLinkGenConstGroupRegion=BmRomArea, vLinkGenConstGroupVariant=vLinkGenVariantHandling/DemoFbl, vLinkGenConstGroupVariant=DemoBm, vLinkGenConstGroupVariant=vLinkGenVariantHandling/DemoAppl, vLinkGenConstGroupContentType=GLOBAL_CONST
          vLinkGenConstGroupVariantHandling
            DemoFbl (vLinkGenConstGroupVariantSpecifics): vLinkGenConstGroupSpecificRegion=FblRomArea, vLinkGenConstGroupSpecificVariant=vLinkGenVariantHandling/DemoFbl
            DemoAppl (vLinkGenConstGroupVariantSpecifics): vLinkGenConstGroupSpecificRegion=ApplRomArea, vLinkGenConstGroupSpecificVariant=vLinkGenVariantHandling/DemoAppl
          6 x vLinkGenConstSectionGroup, all with vLinkGenConstSectionGroupPosition=0, vLinkGenConstSectionGroupInit=NONE, vLinkGenConstSectionGroupInitStage=ONE:
            text: vLinkGenConstSectionGroupFlag=vLinkGenConstGroupFlags/EXECUTE, vLinkGenConstSectionGroupRef=vLinkGenLinkerSections/text, vLinkGenConstSectionGroupRef=text_all
            text_vle: vLinkGenConstSectionGroupFlag=vLinkGenConstGroupFlags/EXECUTE, vLinkGenConstSectionGroupFlag=VLE_CODE, vLinkGenConstSectionGroupRef=vLinkGenLinkerSections/text_vle, vLinkGenConstSectionGroupRef=text_vle_all
            rodata: vLinkGenConstSectionGroupFlag=vLinkGenConstGroupFlags/READ, vLinkGenConstSectionGroupRef=vLinkGenLinkerSections/rodata, vLinkGenConstSectionGroupRef=rodata_all
            srodata: vLinkGenConstSectionGroupFlag=vLinkGenConstGroupFlags/READ, vLinkGenConstSectionGroupFlag=vLinkGenConstGroupFlags/SMALL_ADDRESSING, vLinkGenConstSectionGroupRef=vLinkGenLinkerSections/srodata, vLinkGenConstSectionGroupRef=srodata_all
            zrodata: vLinkGenConstSectionGroupFlag=vLinkGenConstGroupFlags/READ, vLinkGenConstSectionGroupFlag=vLinkGenConstGroupFlags/ABSOLUTE_ADDRESSING, vLinkGenConstSectionGroupRef=vLinkGenLinkerSections/zrodata, vLinkGenConstSectionGroupRef=zrodata_all
            sdata2: vLinkGenConstSectionGroupFlag=vLinkGenConstGroupFlags/READ, vLinkGenConstSectionGroupFlag=vLinkGenConstGroupFlags/SMALL_ADDRESSING, vLinkGenConstSectionGroupRef=vLinkGenLinkerSections/sdata2, vLinkGenConstSectionGroupRef=sdata2_all
        Fbl_FblHeader: vLinkGenConstGroupPosition=0, vLinkGenConstGroupRegion=FblBmHdrHeader, vLinkGenConstGroupVariant=vLinkGenVariantHandling/DemoFbl
          FblHeaderSectionGroup (vLinkGenConstSectionGroup):
            vLinkGenConstSectionGroupPosition = 0
            vLinkGenConstSectionGroupInit = NONE
            vLinkGenConstSectionGroupInitStage = ONE
            vLinkGenConstSectionGroupRef = FblHeaderSection
        FblAppl_BmHdrHeader: vLinkGenConstGroupPosition=0, vLinkGenConstGroupRegion=FblHeader, vLinkGenConstGroupVariant=vLinkGenVariantHandling/DemoFbl, vLinkGenConstGroupVariant=vLinkGenVariantHandling/DemoAppl
          FblBmHdrHeaderGroup (vLinkGenConstSectionGroup):
            vLinkGenConstSectionGroupPosition = 0
            vLinkGenConstSectionGroupInit = NONE
            vLinkGenConstSectionGroupInitStage = ONE
            vLinkGenConstSectionGroupRef = BmHdrHeaderSection
          vLinkGenConstGroupVariantHandling
            DemoFbl (vLinkGenConstGroupVariantSpecifics): vLinkGenConstGroupSpecificRegion=FblHeader, vLinkGenConstGroupSpecificVariant=vLinkGenVariantHandling/DemoFbl
            DemoAppl (vLinkGenConstGroupVariantSpecifics): vLinkGenConstGroupSpecificRegion=ApplBmHdrHeader, vLinkGenConstGroupSpecificVariant=vLinkGenVariantHandling/DemoAppl
        Fbl_PresencePattern: vLinkGenConstGroupPosition=0, vLinkGenConstGroupRegion=FblBlockValPresencePattern, vLinkGenConstGroupVariant=vLinkGenVariantHandling/DemoFbl
          Fbl_PP (vLinkGenConstSectionGroup):
            vLinkGenConstSectionGroupPosition = 0
            vLinkGenConstSectionGroupInit = NONE
            vLinkGenConstSectionGroupInitStage = ONE
            vLinkGenConstSectionGroupRef = FblPresencePatternSection
        Appl_ApplVect: vLinkGenConstGroupPosition=5, vLinkGenConstGroupRegion=ApplRom_ApplVect, vLinkGenConstGroupVariant=vLinkGenVariantHandling/DemoFbl, vLinkGenConstGroupVariant=vLinkGenVariantHandling/DemoAppl
          APPLVECT (vLinkGenConstSectionGroup):
            vLinkGenConstSectionGroupSize = 8
            vLinkGenConstSectionGroupAlignment = 4
            vLinkGenConstSectionGroupPosition = 0
            vLinkGenConstSectionGroupInit = NONE
            vLinkGenConstSectionGroupInitStage = ONE
            vLinkGenConstSectionGroupRef = ApplVectSection
        Bm_BmHeader: vLinkGenConstGroupPosition=0, vLinkGenConstGroupRegion=BmHeader, vLinkGenConstGroupVariant=DemoBm
          BmHeaderSectionGroup (vLinkGenConstSectionGroup):
            vLinkGenConstSectionGroupPosition = 0
            vLinkGenConstSectionGroupInit = NONE
            vLinkGenConstSectionGroupInitStage = ONE
            vLinkGenConstSectionGroupRef = BmHeaderSection
        FlashDrv_Header: vLinkGenConstGroupPosition=0, vLinkGenConstGroupVariant=FlashDrv, vLinkGenConstGroupRegion=RamDsprCpu0_FlashDrvArea/RamDsprCpu0_FlashDrvArea
          FlashDrvHeaderSectionGroup (vLinkGenConstSectionGroup):
            vLinkGenConstSectionGroupPosition = 0
            vLinkGenConstSectionGroupInit = NONE
            vLinkGenConstSectionGroupInitStage = ONE
            vLinkGenConstSectionGroupRef = FlashDrvHeaderSection
        FlashDrv_Code: vLinkGenConstGroupPosition=500, vLinkGenConstGroupRegion=RamDsprCpu0_FlashDrvArea/RamDsprCpu0_FlashDrvArea, vLinkGenConstGroupVariant=FlashDrv
          FlashDrv_CodeGroup (vLinkGenConstSectionGroup):
            vLinkGenConstSectionGroupPosition = 0
            vLinkGenConstSectionGroupInit = NONE
            vLinkGenConstSectionGroupInitStage = ONE
            vLinkGenConstSectionGroupRef = vLinkGenLinkerSections/text
            vLinkGenConstSectionGroupRef = text_all
            vLinkGenConstSectionGroupRef = vLinkGenLinkerSections/text_vle
            vLinkGenConstSectionGroupRef = text_vle_all
            vLinkGenConstSectionGroupFlag = vLinkGenConstGroupFlags/EXECUTE
        FlashDrv_Const: vLinkGenConstGroupPosition=500, vLinkGenConstGroupRegion=RamDsprCpu0_FlashDrvArea/RamDsprCpu0_FlashDrvArea, vLinkGenConstGroupVariant=FlashDrv
          FlashDrv_ConstGroup (vLinkGenConstSectionGroup):
            vLinkGenConstSectionGroupPosition = 0
            vLinkGenConstSectionGroupInit = NONE
            vLinkGenConstSectionGroupInitStage = ONE
            vLinkGenConstSectionGroupRef = vLinkGenLinkerSections/rodata
            vLinkGenConstSectionGroupRef = rodata_all
            vLinkGenConstSectionGroupRef = vLinkGenLinkerSections/srodata
            vLinkGenConstSectionGroupRef = srodata_all
            vLinkGenConstSectionGroupRef = vLinkGenLinkerSections/zrodata
            vLinkGenConstSectionGroupRef = zrodata_all
            vLinkGenConstSectionGroupRef = vLinkGenLinkerSections/sdata2
            vLinkGenConstSectionGroupRef = sdata2_all
        FlashDrv_SpecialCode: vLinkGenConstGroupPosition=500, vLinkGenConstGroupRegion=RamDsprCpu0_FlashDrvArea/RamDsprCpu0_FlashDrvArea, vLinkGenConstGroupVariant=FlashDrv
          FlashDrv_SpecialCodeGroup (vLinkGenConstSectionGroup):
            vLinkGenConstSectionGroupPosition = 0
            vLinkGenConstSectionGroupInit = NONE
            vLinkGenConstSectionGroupInitStage = ONE
            vLinkGenConstSectionGroupFlag = vLinkGenConstGroupFlags/EXECUTE
            vLinkGenConstSectionGroupRef = traptab
      vLinkGenLinkerSections
        10 x vLinkGenLinkerVarSection:
          vHsmGlobalRamBuffer: vLinkGenLinkerVarSectionName=vHsmGlobalRamBuffer, vLinkGenLinkerVarSectionFast=false
          vHsmIpcMemory: vLinkGenLinkerVarSectionName=vHsmIpcMemory, vLinkGenLinkerVarSectionFast=false
          svHsmGlobalRamBuffer: vLinkGenLinkerVarSectionName=svHsmGlobalRamBuffer, vLinkGenLinkerVarSectionFast=false
          svHsmIpcMemory: vLinkGenLinkerVarSectionName=svHsmIpcMemory, vLinkGenLinkerVarSectionFast=false
          vHsmGlobalRamBuffer_INIT: vLinkGenLinkerVarSectionName=vHsmGlobalRamBuffer_INIT, vLinkGenLinkerVarSectionFast=false
          vHsmGlobalRamBuffer_INIT_FAST: vLinkGenLinkerVarSectionName=vHsmGlobalRamBuffer_INIT_FAST, vLinkGenLinkerVarSectionFast=true
          vHsmGlobalRamBuffer_NO_INIT_FAST: vLinkGenLinkerVarSectionName=vHsmGlobalRamBuffer_NO_INIT_FAST, vLinkGenLinkerVarSectionFast=true
          vHsmIpcMemory_INIT: vLinkGenLinkerVarSectionName=vHsmIpcMemory_INIT, vLinkGenLinkerVarSectionFast=false
          vHsmIpcMemory_INIT_FAST: vLinkGenLinkerVarSectionName=vHsmIpcMemory_INIT_FAST, vLinkGenLinkerVarSectionFast=true
          vHsmIpcMemory_NO_INIT_FAST: vLinkGenLinkerVarSectionName=vHsmIpcMemory_NO_INIT_FAST, vLinkGenLinkerVarSectionFast=true
        MSR_CODE (vLinkGenLinkerCodeSection): vLinkGenLinkerCodeSectionName=MSR_CODE, vLinkGenLinkerCodeSectionFast=false
        MSR_CONST (vLinkGenLinkerConstSection): vLinkGenLinkerConstSectionName=MSR_CONST, vLinkGenLinkerConstSectionFast=false
        MSR_PBCFG_CONST (vLinkGenLinkerConstSection): vLinkGenLinkerConstSectionName=MSR_PBCFG_CONST, vLinkGenLinkerConstSectionFast=false
        4 x vLinkGenLinkerVarSection, all with vLinkGenLinkerVarSectionFast=false:
          MSR_PBCFG_VAR: vLinkGenLinkerVarSectionName=MSR_PBCFG_VAR
          MSR_VAR_CLEARED: vLinkGenLinkerVarSectionName=MSR_VAR_CLEARED
          MSR_VAR_INIT: vLinkGenLinkerVarSectionName=MSR_VAR_INIT
          MSR_VAR_NO_INIT: vLinkGenLinkerVarSectionName=MSR_VAR_NO_INIT
        MSR_CONST_FAST (vLinkGenLinkerConstSection): vLinkGenLinkerConstSectionFast=true, vLinkGenLinkerConstSectionName=MSR_CONST_FAST
        3 x vLinkGenLinkerVarSection, all with vLinkGenLinkerVarSectionFast=true:
          MSR_VAR_FAST_CLEARED: vLinkGenLinkerVarSectionName=MSR_VAR_FAST_CLEARED
          MSR_VAR_FAST_INIT: vLinkGenLinkerVarSectionName=MSR_VAR_FAST_INIT
          MSR_VAR_FAST_NO_INIT: vLinkGenLinkerVarSectionName=MSR_VAR_FAST_NO_INIT
        MSR_PBCFG_CONST_FAST (vLinkGenLinkerConstSection): vLinkGenLinkerConstSectionFast=true, vLinkGenLinkerConstSectionName=MSR_PBCFG_CONST_FAST
        7 x vLinkGenLinkerVarSection:
          MSR_PBCFG_VAR_FAST: vLinkGenLinkerVarSectionFast=true, vLinkGenLinkerVarSectionName=MSR_PBCFG_VAR_FAST
          MSR_PBCFG_VAR_FAST_NO_INIT: vLinkGenLinkerVarSectionFast=true, vLinkGenLinkerVarSectionName=MSR_PBCFG_VAR_FAST_NO_INIT
          MSR_PBCFG_VAR_NO_INIT: vLinkGenLinkerVarSectionName=MSR_PBCFG_VAR_NO_INIT, vLinkGenLinkerVarSectionFast=false
          MSR_VAR_SAVED_ZONE_INIT: vLinkGenLinkerVarSectionName=MSR_VAR_SAVED_ZONE_INIT, vLinkGenLinkerVarSectionFast=false
          MSR_VAR_SAVED_ZONE_NO_INIT: vLinkGenLinkerVarSectionName=MSR_VAR_SAVED_ZONE_NO_INIT, vLinkGenLinkerVarSectionFast=false
          MSR_VAR_SAVED_ZONE_FAST_INIT: vLinkGenLinkerVarSectionFast=true, vLinkGenLinkerVarSectionName=MSR_VAR_SAVED_ZONE_FAST_INIT
          MSR_VAR_SAVED_ZONE_FAST_NO_INIT: vLinkGenLinkerVarSectionFast=true, vLinkGenLinkerVarSectionName=MSR_VAR_SAVED_ZONE_FAST_NO_INIT
        BMHD0 (vLinkGenLinkerConstSection):
          vLinkGenLinkerConstSectionName = BMHD0
          vLinkGenLinkerConstSectionAlignment = 32
          vLinkGenLinkerConstSectionFast = false
          vLinkGenLinkerConstSectionFlag = vLinkGenConstSectionFlags/KEEP
        3 x vLinkGenLinkerCodeSection, all with vLinkGenLinkerCodeSectionFast=false, vLinkGenLinkerCodeSectionFlag=vLinkGenConstSectionFlags/KEEP:
          brsStartup: vLinkGenLinkerCodeSectionName=brsStartup, vLinkGenLinkerCodeSectionAlignment=8
          brsExcVect: vLinkGenLinkerCodeSectionName=brsExcVect
          brsSharedConst: vLinkGenLinkerCodeSectionName=brsSharedConst
        brsExcVectConst (vLinkGenLinkerConstSection):
          vLinkGenLinkerConstSectionName = brsExcVectConst
          vLinkGenLinkerConstSectionFast = false
          vLinkGenLinkerConstSectionFlag = vLinkGenConstSectionFlags/KEEP
        brsExcVectRam (vLinkGenLinkerCodeSection): vLinkGenLinkerCodeSectionName=brsExcVectRam, vLinkGenLinkerCodeSectionFast=false, vLinkGenLinkerCodeSectionFlag=vLinkGenConstSectionFlags/KEEP
        brsMainStartup (vLinkGenLinkerCodeSection): vLinkGenLinkerCodeSectionName=brsMainStartup, vLinkGenLinkerCodeSectionFast=false
        brsSharedVar (vLinkGenLinkerVarSection): vLinkGenLinkerVarSectionName=brsSharedVar, vLinkGenLinkerVarSectionFast=false
        RamCodeCoreSection (vLinkGenLinkerCodeSection): vLinkGenLinkerCodeSectionName=RamCodeCoreSection, vLinkGenLinkerCodeSectionFast=false, vLinkGenLinkerCodeSectionAlignment=0
        EepDummySection (vLinkGenLinkerVarSection): vLinkGenLinkerVarSectionName=EepDummySection, vLinkGenLinkerVarSectionFast=false, vLinkGenLinkerVarSectionAlignment=0
        4 x vLinkGenLinkerConstSection, all with vLinkGenLinkerConstSectionFast=false, vLinkGenLinkerConstSectionAlignment=0:
          BmHeaderSection: vLinkGenLinkerConstSectionName=BmHeaderSection
          RamConstSection: vLinkGenLinkerConstSectionName=RamConstSection
          FblHeaderSection: vLinkGenLinkerConstSectionName=FblHeaderSection
          BmHdrHeaderSection: vLinkGenLinkerConstSectionName=BmHdrHeaderSection, vLinkGenLinkerConstSectionFlag=vLinkGenConstSectionFlags/KEEP
        MagicFlagSection (vLinkGenLinkerVarSection): vLinkGenLinkerVarSectionName=MagicFlagSection, vLinkGenLinkerVarSectionFast=false, vLinkGenLinkerVarSectionAlignment=0
        3 x vLinkGenLinkerConstSection, all with vLinkGenLinkerConstSectionFast=false:
          FblPresencePatternSection: vLinkGenLinkerConstSectionName=FblPresencePatternSection
          ApplVectSection: vLinkGenLinkerConstSectionName=ApplVectSection, vLinkGenLinkerConstSectionFlag=vLinkGenConstSectionFlags/KEEP
          FblManualConstSection: vLinkGenLinkerConstSectionName=rodata, vLinkGenLinkerConstSectionFiles=fbl_diag_oem
        FblFlashDrvSection (vLinkGenLinkerVarSection): vLinkGenLinkerVarSectionName=FblFlashDrvSection, vLinkGenLinkerVarSectionFast=false, vLinkGenLinkerVarSectionAlignment=0
        FlashDrvHeaderSection (vLinkGenLinkerConstSection): vLinkGenLinkerConstSectionName=FlashDrvHeaderSection, vLinkGenLinkerConstSectionFast=false
        text (vLinkGenLinkerCodeSection): vLinkGenLinkerCodeSectionName=text, vLinkGenLinkerCodeSectionFast=false
        text_all (vLinkGenLinkerSpecSection): vLinkGenLinkerSpecSectionValue=.text.*, vLinkGenLinkerSpecSectionPad=0
        text_vle (vLinkGenLinkerCodeSection): vLinkGenLinkerCodeSectionName=text_vle, vLinkGenLinkerCodeSectionFast=false
        text_vle_all (vLinkGenLinkerSpecSection): vLinkGenLinkerSpecSectionValue=.text_vle.*, vLinkGenLinkerSpecSectionPad=0
        rodata (vLinkGenLinkerConstSection): vLinkGenLinkerConstSectionName=rodata, vLinkGenLinkerConstSectionFast=false
        rodata_all (vLinkGenLinkerSpecSection): vLinkGenLinkerSpecSectionValue=.rodata.*, vLinkGenLinkerSpecSectionPad=0
        srodata (vLinkGenLinkerConstSection): vLinkGenLinkerConstSectionName=srodata, vLinkGenLinkerConstSectionFast=true
        srodata_all (vLinkGenLinkerSpecSection): vLinkGenLinkerSpecSectionValue=.srodata.*, vLinkGenLinkerSpecSectionPad=0
        zrodata (vLinkGenLinkerConstSection): vLinkGenLinkerConstSectionName=zrodata, vLinkGenLinkerConstSectionFast=true
        zrodata_all (vLinkGenLinkerSpecSection): vLinkGenLinkerSpecSectionValue=.zrodata.*, vLinkGenLinkerSpecSectionPad=0
        sdata2 (vLinkGenLinkerConstSection): vLinkGenLinkerConstSectionName=sdata2, vLinkGenLinkerConstSectionFast=true
        sdata2_all (vLinkGenLinkerSpecSection): vLinkGenLinkerSpecSectionValue=.sdata2.*, vLinkGenLinkerSpecSectionPad=0
        data (vLinkGenLinkerVarSection): vLinkGenLinkerVarSectionName=data, vLinkGenLinkerVarSectionFast=false
        data_all (vLinkGenLinkerSpecSection): vLinkGenLinkerSpecSectionValue=.data.*, vLinkGenLinkerSpecSectionPad=0
        zdata (vLinkGenLinkerVarSection): vLinkGenLinkerVarSectionName=zdata, vLinkGenLinkerVarSectionFast=true
        zdata_all (vLinkGenLinkerSpecSection): vLinkGenLinkerSpecSectionValue=.zdata.*, vLinkGenLinkerSpecSectionPad=0
        sdata (vLinkGenLinkerVarSection): vLinkGenLinkerVarSectionName=sdata, vLinkGenLinkerVarSectionFast=true
        sdata_all (vLinkGenLinkerSpecSection): vLinkGenLinkerSpecSectionValue=.sdata.*, vLinkGenLinkerSpecSectionPad=0
        bss (vLinkGenLinkerVarSection): vLinkGenLinkerVarSectionName=bss, vLinkGenLinkerVarSectionFast=false
        bss_all (vLinkGenLinkerSpecSection): vLinkGenLinkerSpecSectionValue=.bss.*, vLinkGenLinkerSpecSectionPad=0
        sbss (vLinkGenLinkerVarSection): vLinkGenLinkerVarSectionName=sbss, vLinkGenLinkerVarSectionFast=true
        sbss_all (vLinkGenLinkerSpecSection): vLinkGenLinkerSpecSectionValue=.sbss.*, vLinkGenLinkerSpecSectionPad=0
        zbss (vLinkGenLinkerVarSection): vLinkGenLinkerVarSectionName=zbss, vLinkGenLinkerVarSectionFast=true
        zbss_all (vLinkGenLinkerSpecSection): vLinkGenLinkerSpecSectionValue=.zbss.*, vLinkGenLinkerSpecSectionPad=0
        COMMON (vLinkGenLinkerSpecSection): vLinkGenLinkerSpecSectionValue=COMMON, vLinkGenLinkerSpecSectionPad=0
        traptab (vLinkGenLinkerConstSection): vLinkGenLinkerConstSectionName=traptab, vLinkGenLinkerConstSectionFast=false
        brsResetLabel (vLinkGenLinkerCodeSection): vLinkGenLinkerCodeSectionName=brsResetLabel, vLinkGenLinkerCodeSectionFast=false, vLinkGenLinkerCodeSectionAlignment=0
        3 x vLinkGenLinkerConstSection, all with vLinkGenLinkerConstSectionFast=false:
          SlpHeaderSection: vLinkGenLinkerConstSectionName=SlpHeaderSection
          SlpConstSection: vLinkGenLinkerConstSectionName=SlpConstSection
          PseudoFlashDrvSection: vLinkGenLinkerConstSectionName=PseudoFlashDrvSection
      8 x vLinkGenMemoryRegion, all with vLinkGenMemoryRegionAvailable=true:
        RamDsprCpu0_LLDAppl_Data_Bss: vLinkGenMemoryRegionAddrOffset=17400, vLinkGenMemoryRegionSize=175104, vLinkGenMemoryRegionAddress=1879065592, vLinkGenMemoryRegionHwRegion=DSPR0
          RamDsprCpu0_LLDAppl_Data_Bss (vLinkGenMemoryRegionBlock):
            vLinkGenMemoryRegionBlockCore = 0
            vLinkGenMemoryRegionBlockPosition = 0
            vLinkGenMemoryRegionBlockSize = 175104
            vLinkGenMemoryRegionBlockAddress = 1879065592
            vLinkGenMemoryRegionBlockBoundary = LOWER
            vLinkGenMemoryRegionBlockInitStage = NONE
            vLinkGenMemoryRegionBlockContentType = GLOBAL_DATA
            vLinkGenMemoryRegionBlockContentType = LOCAL_DATA
            vLinkGenMemoryRegionBlockContentType = RAM_CODE_COPY
            vLinkGenMemoryRegionBlockContentType = RAM_CONST_COPY
            vLinkGenMemoryRegionBlockContentType = RETENTION_DATA
            vLinkGenMemoryRegionBlockContentType = STACKS
        Rom_BmMemoryArea: vLinkGenMemoryRegionAddrOffset=0, vLinkGenMemoryRegionSize=32768, vLinkGenMemoryRegionAddress=2147483648, vLinkGenMemoryRegionHwRegion=PFlash0_Cached
          3 x vLinkGenMemoryRegionBlock, all with vLinkGenMemoryRegionBlockInitStage=NONE:
            BmRom_Startup: vLinkGenMemoryRegionBlockSize=768, vLinkGenMemoryRegionBlockPosition=0, vLinkGenMemoryRegionBlockAddress=2147483648, vLinkGenMemoryRegionBlockBoundary=LOWER, vLinkGenMemoryRegionBlockContentType=STARTUP_CODE
            BmRomArea: vLinkGenMemoryRegionBlockPosition=1, vLinkGenMemoryRegionBlockSize=31966, vLinkGenMemoryRegionBlockAddress=2147484416, vLinkGenMemoryRegionBlockBoundary=LOWER, vLinkGenMemoryRegionBlockContentType=LOCAL_EXCVEC_CODE, vLinkGenMemoryRegionBlockContentType=LOCAL_EXCVEC_CONST, vLinkGenMemoryRegionBlockContentType=LOCAL_INTVEC_CODE, vLinkGenMemoryRegionBlockContentType=LOCAL_INTVEC_CONST, vLinkGenMemoryRegionBlockContentType=GLOBAL_INTVEC_CODE, vLinkGenMemoryRegionBlockContentType=GLOBAL_INTVEC_CONST, vLinkGenMemoryRegionBlockContentType=GLOBAL_CODE, vLinkGenMemoryRegionBlockContentType=GLOBAL_CONST, vLinkGenMemoryRegionBlockContentType=LOCAL_CODE, vLinkGenMemoryRegionBlockContentType=LOCAL_CONST, vLinkGenMemoryRegionBlockContentType=RAM_CODE, vLinkGenMemoryRegionBlockContentType=RAM_CONST
            BmHeader: vLinkGenMemoryRegionBlockPosition=0, vLinkGenMemoryRegionBlockSize=32, vLinkGenMemoryRegionBlockAddress=2147516384, vLinkGenMemoryRegionBlockBoundary=UPPER
        RamDsprCpu0_Var_Eep_DummyArea: vLinkGenMemoryRegionSize=1784, vLinkGenMemoryRegionAddrOffset=237816, vLinkGenMemoryRegionAddress=1879286008, vLinkGenMemoryRegionHwRegion=DSPR0
          RamDsprCpu0_Var_Eep_DummyArea (vLinkGenMemoryRegionBlock):
            vLinkGenMemoryRegionBlockPosition = 0
            vLinkGenMemoryRegionBlockSize = 1784
            vLinkGenMemoryRegionBlockBoundary = LOWER
            vLinkGenMemoryRegionBlockInitStage = NONE
            vLinkGenMemoryRegionBlockAddress = 1879286008
        RamDsprCpu0_MagicFlagArea: vLinkGenMemoryRegionSize=16, vLinkGenMemoryRegionAddrOffset=239600, vLinkGenMemoryRegionAddress=1879287792, vLinkGenMemoryRegionHwRegion=DSPR0
          RamDsprCpu0_MagicFlagArea (vLinkGenMemoryRegionBlock):
            vLinkGenMemoryRegionBlockSize = 16
            vLinkGenMemoryRegionBlockBoundary = LOWER
            vLinkGenMemoryRegionBlockInitStage = NONE
            vLinkGenMemoryRegionBlockPosition = 0
            vLinkGenMemoryRegionBlockAddress = 1879287792
        Rom_FblMemoryArea: vLinkGenMemoryRegionAddrOffset=2752512, vLinkGenMemoryRegionSize=327680, vLinkGenMemoryRegionAddress=2153381888, vLinkGenMemoryRegionHwRegion=PFlash1_Cached
          6 x vLinkGenMemoryRegionBlock, all with vLinkGenMemoryRegionBlockInitStage=NONE:
            FblBmHdrHeader: vLinkGenMemoryRegionBlockPosition=1, vLinkGenMemoryRegionBlockSize=32, vLinkGenMemoryRegionBlockBoundary=LOWER, vLinkGenMemoryRegionBlockAddress=2153381920
            FblHeader: vLinkGenMemoryRegionBlockBoundary=LOWER, vLinkGenMemoryRegionBlockPosition=0, vLinkGenMemoryRegionBlockSize=32, vLinkGenMemoryRegionBlockAddress=2153381888
            FblRomArea: vLinkGenMemoryRegionBlockPosition=2, vLinkGenMemoryRegionBlockBoundary=LOWER, vLinkGenMemoryRegionBlockSize=322432, vLinkGenMemoryRegionBlockAddress=2153381952
            FblReserved: vLinkGenMemoryRegionBlockPosition=0, vLinkGenMemoryRegionBlockBoundary=UPPER, vLinkGenMemoryRegionBlockSize=4032, vLinkGenMemoryRegionBlockAddress=2153705408
            FblBlockValPresencePattern: vLinkGenMemoryRegionBlockPosition=1, vLinkGenMemoryRegionBlockBoundary=UPPER, vLinkGenMemoryRegionBlockSize=128, vLinkGenMemoryRegionBlockAddress=2153709440
            FblRomStartup: vLinkGenMemoryRegionBlockPosition=3, vLinkGenMemoryRegionBlockSize=1024, vLinkGenMemoryRegionBlockAddress=2153704384, vLinkGenMemoryRegionBlockBoundary=LOWER
        Rom_ApplMemoryArea: vLinkGenMemoryRegionAddrOffset=2768896, vLinkGenMemoryRegionSize=376832, vLinkGenMemoryRegionAddress=2150252544, vLinkGenMemoryRegionHwRegion=PFlash0_Cached
          10 x vLinkGenMemoryRegionBlock, all with vLinkGenMemoryRegionBlockBoundary=LOWER, vLinkGenMemoryRegionBlockInitStage=NONE:
            RegionBlock_BMHD0: vLinkGenMemoryRegionBlockPosition=9, vLinkGenMemoryRegionBlockSize=512, vLinkGenMemoryRegionBlockAddress=2150584320
            ApplRom_ApplVect: vLinkGenMemoryRegionBlockPosition=0, vLinkGenMemoryRegionBlockSize=32, vLinkGenMemoryRegionBlockAddress=2150252544
            ApplRom_Startup: vLinkGenMemoryRegionBlockPosition=1, vLinkGenMemoryRegionBlockSize=2272, vLinkGenMemoryRegionBlockAddress=2150252576
            ApplRomArea: vLinkGenMemoryRegionBlockPosition=2, vLinkGenMemoryRegionBlockSize=262144, vLinkGenMemoryRegionBlockAddress=2150254848
            ApplSlpSpecificArea: vLinkGenMemoryRegionBlockPosition=3, vLinkGenMemoryRegionBlockSize=256, vLinkGenMemoryRegionBlockAddress=2150516992
            ApplRomBlock_ASW_INFO: vLinkGenMemoryRegionBlockPosition=4, vLinkGenMemoryRegionBlockSize=256, vLinkGenMemoryRegionBlockAddress=2150517248
            ApplBmHdrHeader: vLinkGenMemoryRegionBlockPosition=5, vLinkGenMemoryRegionBlockSize=256, vLinkGenMemoryRegionBlockAddress=2150517504
            Os_IntVect: vLinkGenMemoryRegionBlockPosition=6, vLinkGenMemoryRegionBlockSize=65536, vLinkGenMemoryRegionBlockAddress=2150517760
            Region_etk_pageswitch_mbox: vLinkGenMemoryRegionBlockPosition=7, vLinkGenMemoryRegionBlockSize=512, vLinkGenMemoryRegionBlockAddress=2150583296
            Region_etkDisTab_MemClass: vLinkGenMemoryRegionBlockPosition=8, vLinkGenMemoryRegionBlockSize=512, vLinkGenMemoryRegionBlockAddress=2150583808
        RamDsprCpu0_FlashDrvArea: vLinkGenMemoryRegionAddrOffset=239616, vLinkGenMemoryRegionSize=3072, vLinkGenMemoryRegionAddress=1879287808, vLinkGenMemoryRegionHwRegion=DSPR0
          RamDsprCpu0_FlashDrvArea (vLinkGenMemoryRegionBlock):
            vLinkGenMemoryRegionBlockPosition = 0
            vLinkGenMemoryRegionBlockInitCore = 0
            vLinkGenMemoryRegionBlockBoundary = LOWER
            vLinkGenMemoryRegionBlockInitStage = ONE
            vLinkGenMemoryRegionBlockSize = 3072
            vLinkGenMemoryRegionBlockAddress = 1879287808
        RamDsprCpu0_LLDAppl_Stack: vLinkGenMemoryRegionAddrOffset=194552, vLinkGenMemoryRegionSize=38912, vLinkGenMemoryRegionAddress=1879242744, vLinkGenMemoryRegionHwRegion=DSPR0
          RamDsprCpu0_LLDAppl_Stack (vLinkGenMemoryRegionBlock):
            vLinkGenMemoryRegionBlockCore = 0
            vLinkGenMemoryRegionBlockPosition = 0
            vLinkGenMemoryRegionBlockSize = 38912
            vLinkGenMemoryRegionBlockAddress = 1879242744
            vLinkGenMemoryRegionBlockBoundary = LOWER
            vLinkGenMemoryRegionBlockInitStage = NONE
            vLinkGenMemoryRegionBlockContentType = STACKS
      7 x vLinkGenLogicalVarGroup:
        Brs_Shared_Var: vLinkGenVarGroupPosition=5, vLinkGenVarGroupInitCore=0, vLinkGenVarGroupContentType=SHARED_DATA, vLinkGenVarGroupRegion=RamDsprCpu0_LLDAppl_Data_Bss/RamDsprCpu0_LLDAppl_Data_Bss
          Brs_Shared_Var (vLinkGenVarSectionGroup):
            vLinkGenVarSectionGroupPosition = 0
            vLinkGenVarSectionGroupInit = NONE
            vLinkGenVarSectionGroupInitStage = ONE
            vLinkGenVarSectionGroupAlignment = 16
            vLinkGenVarSectionGroupRef = brsSharedVar
        Data_Default: vLinkGenVarGroupPosition=1000, vLinkGenVarGroupInitCore=0, vLinkGenVarGroupVariant=vLinkGenVariantHandling/DemoFbl, vLinkGenVarGroupVariant=DemoBm, vLinkGenVarGroupVariant=vLinkGenVariantHandling/DemoAppl, vLinkGenVarGroupContentType=GLOBAL_DATA, vLinkGenVarGroupRomRegion=BmRomArea, vLinkGenVarGroupRegion=RamDsprCpu0_LLDAppl_Data_Bss/RamDsprCpu0_LLDAppl_Data_Bss
          vLinkGenVarGroupVariantHandling
            DemoFbl (vLinkGenVarGroupVariantSpecifics): vLinkGenVarGroupSpecificRomRegion=FblRomArea, vLinkGenVarGroupSpecificVariant=vLinkGenVariantHandling/DemoFbl
            DemoAppl (vLinkGenVarGroupVariantSpecifics): vLinkGenVarGroupSpecificRomRegion=ApplRomArea, vLinkGenVarGroupSpecificVariant=vLinkGenVariantHandling/DemoAppl
          6 x vLinkGenVarSectionGroup, all with vLinkGenVarSectionGroupPosition=0, vLinkGenVarSectionGroupInitStage=ONE, vLinkGenVarSectionGroupAlignment=16, vLinkGenVarSectionGroupEndAlignment=4, vLinkGenVarSectionGroupFlag=vLinkGenVarGroupFlags/WRITE:
            data: vLinkGenVarSectionGroupInit=INIT, vLinkGenVarSectionGroupFlag=LOADABLE, vLinkGenVarSectionGroupRef=vLinkGenLinkerSections/data, vLinkGenVarSectionGroupRef=data_all
            sdata: vLinkGenVarSectionGroupInit=INIT, vLinkGenVarSectionGroupFlag=vLinkGenVarGroupFlags/SMALL_ADDRESSING, vLinkGenVarSectionGroupFlag=LOADABLE, vLinkGenVarSectionGroupRef=vLinkGenLinkerSections/sdata, vLinkGenVarSectionGroupRef=sdata_all
            zdata: vLinkGenVarSectionGroupInit=INIT, vLinkGenVarSectionGroupFlag=vLinkGenVarGroupFlags/ABSOLUTE_ADDRESSING, vLinkGenVarSectionGroupFlag=LOADABLE, vLinkGenVarSectionGroupRef=vLinkGenLinkerSections/zdata, vLinkGenVarSectionGroupRef=zdata_all
            bss: vLinkGenVarSectionGroupInit=ZERO_INIT, vLinkGenVarSectionGroupRef=vLinkGenLinkerSections/bss, vLinkGenVarSectionGroupRef=bss_all, vLinkGenVarSectionGroupRef=COMMON
            sbss: vLinkGenVarSectionGroupInit=ZERO_INIT, vLinkGenVarSectionGroupFlag=vLinkGenVarGroupFlags/SMALL_ADDRESSING, vLinkGenVarSectionGroupRef=vLinkGenLinkerSections/sbss, vLinkGenVarSectionGroupRef=sbss_all
            zbss: vLinkGenVarSectionGroupInit=ZERO_INIT, vLinkGenVarSectionGroupFlag=vLinkGenVarGroupFlags/ABSOLUTE_ADDRESSING, vLinkGenVarSectionGroupRef=vLinkGenLinkerSections/zbss, vLinkGenVarSectionGroupRef=zbss_all
        FlashDrvGroup: vLinkGenVarGroupPosition=250, vLinkGenVarGroupRegion=RamDsprCpu0_FlashDrvArea/RamDsprCpu0_FlashDrvArea, vLinkGenVarGroupVariant=FlashDrv
          FlashDrv_DataGroup (vLinkGenVarSectionGroup):
            vLinkGenVarSectionGroupPosition = 0
            vLinkGenVarSectionGroupInit = NONE
            vLinkGenVarSectionGroupInitStage = ONE
            vLinkGenVarSectionGroupAlignment = 16
            vLinkGenVarSectionGroupRef = vLinkGenLinkerSections/data
            vLinkGenVarSectionGroupRef = vLinkGenLinkerSections/sdata
            vLinkGenVarSectionGroupRef = sdata_all
            vLinkGenVarSectionGroupRef = vLinkGenLinkerSections/zbss
            vLinkGenVarSectionGroupRef = vLinkGenLinkerSections/zdata
            vLinkGenVarSectionGroupRef = zdata_all
            vLinkGenVarSectionGroupRef = data_all
            vLinkGenVarSectionGroupRef = COMMON
            vLinkGenVarSectionGroupRef = vLinkGenLinkerSections/bss
            vLinkGenVarSectionGroupRef = bss_all
        STACK_C0: vLinkGenVarGroupPosition=5, vLinkGenVarGroupCore=0, vLinkGenVarGroupRegion=RamDsprCpu0_LLDAppl_Stack/RamDsprCpu0_LLDAppl_Stack, vLinkGenVarGroupContentType=STARTUP_STACK, vLinkGenVarGroupModule=vBRS
          STACK_C0 (vLinkGenVarSectionGroup):
            vLinkGenVarSectionGroupPosition = 0
            vLinkGenVarSectionGroupInit = NONE
            vLinkGenVarSectionGroupInitStage = ONE
            vLinkGenVarSectionGroupAlignment = 64
            vLinkGenVarSectionGroupEndAlignment = 4
            vLinkGenVarSectionGroupSize = 36864
        MagicFlagGroup: vLinkGenVarGroupPosition=5, vLinkGenVarGroupInitCore=0, vLinkGenVarGroupRegion=RamDsprCpu0_MagicFlagArea/RamDsprCpu0_MagicFlagArea, vLinkGenVarGroupVariant=vLinkGenVariantHandling/DemoFbl, vLinkGenVarGroupVariant=DemoBm, vLinkGenVarGroupVariant=vLinkGenVariantHandling/DemoAppl
          MagicFlagGroup (vLinkGenVarSectionGroup):
            vLinkGenVarSectionGroupPosition = 0
            vLinkGenVarSectionGroupInit = ZERO_INIT
            vLinkGenVarSectionGroupInitStage = HARD_RESET_ONLY
            vLinkGenVarSectionGroupAlignment = 16
            vLinkGenVarSectionGroupEndAlignment = 4
            vLinkGenVarSectionGroupRef = MagicFlagSection
        FlashDrvSectionGroup: vLinkGenVarGroupPosition=5, vLinkGenVarGroupRegion=RamDsprCpu0_FlashDrvArea/RamDsprCpu0_FlashDrvArea, vLinkGenVarGroupVariant=vLinkGenVariantHandling/DemoFbl, vLinkGenVarGroupVariant=DemoBm, vLinkGenVarGroupVariant=vLinkGenVariantHandling/DemoAppl
          FlashDrvSectionGroup (vLinkGenVarSectionGroup):
            vLinkGenVarSectionGroupPosition = 0
            vLinkGenVarSectionGroupInit = NONE
            vLinkGenVarSectionGroupInitStage = ONE
            vLinkGenVarSectionGroupAlignment = 16
            vLinkGenVarSectionGroupRef = FblFlashDrvSection
        EepDummyVarGroup: vLinkGenVarGroupPosition=5, vLinkGenVarGroupInitCore=0, vLinkGenVarGroupRegion=RamDsprCpu0_Var_Eep_DummyArea/RamDsprCpu0_Var_Eep_DummyArea
          EepDummyVarGroup (vLinkGenVarSectionGroup):
            vLinkGenVarSectionGroupPosition = 0
            vLinkGenVarSectionGroupInit = ZERO_INIT
            vLinkGenVarSectionGroupInitStage = HARD_RESET_ONLY
            vLinkGenVarSectionGroupAlignment = 16
            vLinkGenVarSectionGroupEndAlignment = 4
            vLinkGenVarSectionGroupRef = EepDummySection
      5 x vLinkGenLogicalSymbolGroup:
        Startup_Labels: vLinkGenSymbolGroupPosition=5, vLinkGenSymbolGroupVariant=DemoBm, vLinkGenSymbolGroupVariant=vLinkGenVariantHandling/DemoFbl, vLinkGenSymbolGroupVariant=vLinkGenVariantHandling/DemoAppl
          7 x vLinkGenLinkerSymbol, all with vLinkGenLinkerSymbolValue=Brs_ApplicationEntry, vLinkGenLinkerSymbolPosition=0:
            Startup_Labels1: vLinkGenLinkerSymbolName=StartupEntry
            Startup_Labels2: vLinkGenLinkerSymbolName=_start_tc0
            Startup_Labels3: vLinkGenLinkerSymbolName=_start_tc1
            Startup_Labels4: vLinkGenLinkerSymbolName=_start_tc2
            Startup_Labels5: vLinkGenLinkerSymbolName=_start_tc3
            Startup_Labels6: vLinkGenLinkerSymbolName=_start_tc4
            Startup_Labels7: vLinkGenLinkerSymbolName=_start_tc5
        HEAPWORKAROUNDLABEL: vLinkGenSymbolGroupPosition=5
          HeapWorkaroundLabel (vLinkGenLinkerSymbol): vLinkGenLinkerSymbolName=__HEAP, vLinkGenLinkerSymbolValue=8, vLinkGenLinkerSymbolPosition=0
          HeapWorkaroundLabelEnd (vLinkGenLinkerSymbol): vLinkGenLinkerSymbolName=__HEAP_END, vLinkGenLinkerSymbolValue=8, vLinkGenLinkerSymbolPosition=0
        ApplVectSymbols: vLinkGenSymbolGroupPosition=5, vLinkGenSymbolGroupVariant=vLinkGenVariantHandling/DemoFbl, vLinkGenSymbolGroupVariant=vLinkGenVariantHandling/DemoAppl, vLinkGenSymbolGroupVariant=DemoBm, vLinkGenSymbolGroupVariant=vLinkGenVariantHandling/DemoAppl, vLinkGenSymbolGroupVariant=DemoBm
          RESETVECT (vLinkGenLinkerSymbol): vLinkGenLinkerSymbolName=RESETVECT, vLinkGenLinkerSymbolValue=Brs_ApplicationEntry, vLinkGenLinkerSymbolPosition=0
          RESETVECT_1 (vLinkGenLinkerSymbol): vLinkGenLinkerSymbolName=_start, vLinkGenLinkerSymbolValue=Brs_ApplicationEntry, vLinkGenLinkerSymbolPosition=0
        FlashDrvSymbols: vLinkGenSymbolGroupPosition=4096, vLinkGenSymbolGroupVariant=FlashDrv
          StartupEntry (vLinkGenLinkerSymbol): vLinkGenLinkerSymbolPosition=0, vLinkGenLinkerSymbolName=brsStartupEntry, vLinkGenLinkerSymbolValue=0
        TargetCompilerSpecificOptions_FlashDrv: vLinkGenSymbolGroupPosition=4096, vLinkGenSymbolGroupVariant=FlashDrv
          StartupEntry (vLinkGenLinkerSymbol): vLinkGenLinkerSymbolPosition=0, vLinkGenLinkerSymbolName=brsStartupEntry, vLinkGenLinkerSymbolValue=0
      Rom_BM_NC_BMHD0 (vLinkGenMemoryRegion):
        vLinkGenMemoryRegionAddrOffset = 0
        vLinkGenMemoryRegionSize = 512
        vLinkGenMemoryRegionAddress = 2940207104
        vLinkGenMemoryRegionAvailable = true
        vLinkGenMemoryRegionHwRegion = BMHD0
        Rom_BM_NC_BMHD0 (vLinkGenMemoryRegionBlock):
          vLinkGenMemoryRegionBlockPosition = 0
          vLinkGenMemoryRegionBlockSize = 512
          vLinkGenMemoryRegionBlockAddress = 2940207104
          vLinkGenMemoryRegionBlockBoundary = LOWER
          vLinkGenMemoryRegionBlockInitStage = NONE
      BMHD0 (vLinkGenLogicalConstGroup):
        vLinkGenConstGroupPosition = 5
        vLinkGenConstGroupRegion = Rom_BM_NC_BMHD0/Rom_BM_NC_BMHD0
        vLinkGenConstGroupVariant = DemoBm
        vLinkGenConstGroupVariant = vLinkGenVariantHandling/DemoFbl
        BMHD0 (vLinkGenConstSectionGroup):
          vLinkGenConstSectionGroupPosition = 0
          vLinkGenConstSectionGroupInit = NONE
          vLinkGenConstSectionGroupInitStage = ONE
          vLinkGenConstSectionGroupRef = vLinkGenLinkerSections/BMHD0
      Brs_ExcVect_START (vLinkGenLogicalSymbolGroup):
        vLinkGenSymbolGroupPosition = 5
        vLinkGenSymbolGroupVariant = DemoBm
        vLinkGenSymbolGroupVariant = vLinkGenVariantHandling/DemoFbl
        vLinkGenSymbolGroupVariant = vLinkGenVariantHandling/DemoAppl
        Brs_ExcVect_START (vLinkGenLinkerSymbol): vLinkGenLinkerSymbolPosition=0, vLinkGenLinkerSymbolName=_Brs_ExcVect_START, vLinkGenLinkerSymbolValue=_Brs_ExcVectRam_ROM_START
    vLinkGenContentTypes
      vHsmGlobalRamBuffer (vLinkGenVarContentType): vLinkGenVarContentTypeLocal=false, vLinkGenVarContentTypeCopyRef=GLOBAL_CONST
      vHsmIpcMemory (vLinkGenVarContentType): vLinkGenVarContentTypeLocal=false, vLinkGenVarContentTypeCopyRef=GLOBAL_CONST
      RAM_CODE (vLinkGenConstContentType): vLinkGenConstContentTypeLocal=false, vLinkGenConstContentTypeCopyRef=RAM_CODE_COPY
      RAM_CONST (vLinkGenConstContentType): vLinkGenConstContentTypeLocal=false, vLinkGenConstContentTypeCopyRef=RAM_CONST_COPY
      3 x vLinkGenVarContentType:
        GLOBAL_DATA: vLinkGenVarContentTypeLocal=false, vLinkGenVarContentTypeCopyRef=GLOBAL_CONST
        LOCAL_DATA: vLinkGenVarContentTypeLocal=true, vLinkGenVarContentTypeCopyRef=LOCAL_CONST
        RETENTION_DATA: vLinkGenVarContentTypeLocal=false, vLinkGenVarContentTypeCopyRef=GLOBAL_CONST
      13 x vLinkGenConstContentType:
        GLOBAL_CODE: vLinkGenConstContentTypeLocal=false
        LOCAL_CODE: vLinkGenConstContentTypeLocal=true
        GLOBAL_CONST: vLinkGenConstContentTypeLocal=false
        LOCAL_CONST: vLinkGenConstContentTypeLocal=true
        GLOBAL_EXCVEC_CODE: vLinkGenConstContentTypeLocal=false
        LOCAL_EXCVEC_CODE: vLinkGenConstContentTypeLocal=true
        GLOBAL_EXCVEC_CONST: vLinkGenConstContentTypeLocal=true
        LOCAL_EXCVEC_CONST: vLinkGenConstContentTypeLocal=true
        GLOBAL_INTVEC_CODE: vLinkGenConstContentTypeLocal=false
        LOCAL_INTVEC_CODE: vLinkGenConstContentTypeLocal=true
        GLOBAL_INTVEC_CONST: vLinkGenConstContentTypeLocal=false
        LOCAL_INTVEC_CONST: vLinkGenConstContentTypeLocal=true
        STARTUP_CODE: vLinkGenConstContentTypeLocal=false
      5 x vLinkGenVarContentType:
        STARTUP_STACK: vLinkGenVarContentTypeLocal=true
        STACKS: vLinkGenVarContentTypeLocal=true
        RAM_CODE_COPY: vLinkGenVarContentTypeLocal=false
        RAM_CONST_COPY: vLinkGenVarContentTypeLocal=false
        SHARED_DATA: vLinkGenVarContentTypeLocal=false
      APPLICATION_ENTRY (vLinkGenConstContentType): vLinkGenConstContentTypeLocal=false
    vLinkGenPublishedInformation: vLinkGenDefaultVarGroupAlignment=16, vLinkGenGeneration=2, vLinkGenDuplicatedLabels=false
      vLinkGenConstGroupFlags
        7 x vLinkGenConstGroupFlag:
          EXECUTE
          READ
          VLE_CODE
          PCP_CODE
          SMALL_ADDRESSING
          ABSOLUTE_ADDRESSING
          NOLOAD
      vLinkGenVarGroupFlags
        7 x vLinkGenVarGroupFlag:
          EXECUTE
          READ
          WRITE
          LOADABLE
          SMALL_ADDRESSING
          ABSOLUTE_ADDRESSING
          NOLOAD
      vLinkGenRegionBlockFlags
        6 x vLinkGenRegionBlockFlag:
          EXECUTE
          READ
          WRITE
          ALLOCATE
          INIT
          INVERT
      vLinkGenConstSectionFlags
        KEEP (vLinkGenConstSectionFlag)
      vLinkGenVarSectionFlags
        KEEP (vLinkGenVarSectionFlag)
    vLinkGenGeneral: vLinkGenFileGeneration=ONE_FILE_PER_VARIANT
    vLinkGenVariantHandling
      4 x vLinkGenVariant:
        DemoBm
        DemoFbl
        DemoAppl
        FlashDrv

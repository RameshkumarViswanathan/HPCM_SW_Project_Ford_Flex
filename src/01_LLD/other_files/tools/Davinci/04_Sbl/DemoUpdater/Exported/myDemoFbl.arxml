[part 2 of 2: package /ActiveEcuC]
AUTOSAR XML (schema 00050)
package /ActiveEcuC  (continued)
  module config vBaseEnv: implementation-config-variant=VARIANT-PRE-COMPILE, module-description=vBaseEnv_Impl
    vBaseEnvGeneral: vBaseEnvTestedDerivativeRef=TC377T
      vBaseEnvStartupStackSettings: vBaseEnvStackSize=36864, vBaseEnvStackAlignment=64
      35 x vBaseEnvDerivativeInformation, all with vBaseEnvCpuCore=TC162, vBaseEnvAvailableChannels_Hyperbus=0, vBaseEnvAvailableChannels_I2c=0, vBaseEnvAvailableChannels_Spi=0:
        TC322L: vBaseEnvCpuCoreAmount=1, vBaseEnvCpuMaxFrequency=160000000, vBaseEnvTestedDerivative=TC32x, vBaseEnvTestedDerivativeDescription=Infineon Aurix 2G TC32x Family, vBaseEnvAvailableChannels_Can=6, vBaseEnvAvailableChannels_Ethernet=0, vBaseEnvAvailableChannels_Flexray=0, vBaseEnvAvailableChannels_Lin=5
          vBaseEnvAdditionalParameters: vBaseEnvWatchdogGroup=B, vBaseEnvPllGroup=B, vBaseEnvPortGroup=B, vBaseEnvResetGroup=B, vBaseEnvDerivativeGroup=TC3xx
          16 x vBaseEnvMemLayoutHwRegion:
            DSPR0: vBaseEnvHwRegionStartAddress=1879048192, vBaseEnvHwRegionSize=196608, vBaseEnvHwRegionType=RAM
            PSPR0: vBaseEnvHwRegionStartAddress=1880096768, vBaseEnvHwRegionSize=8192, vBaseEnvHwRegionType=RAM
            PFlash0_Cached: vBaseEnvHwRegionStartAddress=2147483648, vBaseEnvHwRegionSize=1048576, vBaseEnvHwRegionType=ROM
            PFlash0_NonCached: vBaseEnvHwRegionStartAddress=2684354560, vBaseEnvHwRegionSize=1048576, vBaseEnvHwRegionType=ROM
            LMU0_Cached: vBaseEnvHwRegionStartAddress=2415919104, vBaseEnvHwRegionSize=8192, vBaseEnvHwRegionType=RAM
            LMU0_NonCached: vBaseEnvHwRegionStartAddress=2952790016, vBaseEnvHwRegionSize=8192, vBaseEnvHwRegionType=RAM
            BMHD0: vBaseEnvHwRegionStartAddress=2940207104, vBaseEnvHwRegionSize=512, vBaseEnvHwRegionType=ROM
            BMHD1: vBaseEnvHwRegionStartAddress=2940207616, vBaseEnvHwRegionSize=512, vBaseEnvHwRegionType=ROM
            BMHD2: vBaseEnvHwRegionStartAddress=2940208128, vBaseEnvHwRegionSize=512, vBaseEnvHwRegionType=ROM
            BMHD3: vBaseEnvHwRegionStartAddress=2940208640, vBaseEnvHwRegionSize=512, vBaseEnvHwRegionType=ROM
            OLDA_Cached: vBaseEnvHwRegionStartAddress=2413821952, vBaseEnvHwRegionSize=524288, vBaseEnvHwRegionType=RAM
            OLDA_NonCached: vBaseEnvHwRegionStartAddress=2950692864, vBaseEnvHwRegionSize=524288, vBaseEnvHwRegionType=RAM
            DLMU0_Cached: vBaseEnvHwRegionStartAddress=2415919104, vBaseEnvHwRegionSize=8192, vBaseEnvHwRegionType=RAM
            DLMU0_NonCached: vBaseEnvHwRegionStartAddress=2952790016, vBaseEnvHwRegionSize=8192, vBaseEnvHwRegionType=RAM
            DFlash0: vBaseEnvHwRegionStartAddress=2936012800, vBaseEnvHwRegionSize=1048576, vBaseEnvHwRegionType=ROM
            DFlash1: vBaseEnvHwRegionStartAddress=2948595712, vBaseEnvHwRegionSize=131072, vBaseEnvHwRegionType=ROM
        TC323L: vBaseEnvCpuCoreAmount=1, vBaseEnvCpuMaxFrequency=200000000, vBaseEnvTestedDerivative=TC32x, vBaseEnvTestedDerivativeDescription=Infineon Aurix 2G TC32x Family, vBaseEnvAvailableChannels_Can=6, vBaseEnvAvailableChannels_Ethernet=0, vBaseEnvAvailableChannels_Flexray=0, vBaseEnvAvailableChannels_Lin=5
          vBaseEnvAdditionalParameters: vBaseEnvWatchdogGroup=B, vBaseEnvPllGroup=B, vBaseEnvPortGroup=B, vBaseEnvResetGroup=B, vBaseEnvDerivativeGroup=TC3xx
          16 x vBaseEnvMemLayoutHwRegion:
            DSPR0: vBaseEnvHwRegionStartAddress=1879048192, vBaseEnvHwRegionSize=196608, vBaseEnvHwRegionType=RAM
            PSPR0: vBaseEnvHwRegionStartAddress=1880096768, vBaseEnvHwRegionSize=8192, vBaseEnvHwRegionType=RAM
            PFlash0_Cached: vBaseEnvHwRegionStartAddress=2147483648, vBaseEnvHwRegionSize=1572864, vBaseEnvHwRegionType=ROM
            PFlash0_NonCached: vBaseEnvHwRegionStartAddress=2684354560, vBaseEnvHwRegionSize=1572864, vBaseEnvHwRegionType=ROM
            LMU0_Cached: vBaseEnvHwRegionStartAddress=2415919104, vBaseEnvHwRegionSize=8192, vBaseEnvHwRegionType=RAM
            LMU0_NonCached: vBaseEnvHwRegionStartAddress=2952790016, vBaseEnvHwRegionSize=8192, vBaseEnvHwRegionType=RAM
            BMHD0: vBaseEnvHwRegionStartAddress=2940207104, vBaseEnvHwRegionSize=512, vBaseEnvHwRegionType=ROM
            BMHD1: vBaseEnvHwRegionStartAddress=2940207616, vBaseEnvHwRegionSize=512, vBaseEnvHwRegionType=ROM
            BMHD2: vBaseEnvHwRegionStartAddress=2940208128, vBaseEnvHwRegionSize=512, vBaseEnvHwRegionType=ROM
            BMHD3: vBaseEnvHwRegionStartAddress=2940208640, vBaseEnvHwRegionSize=512, vBaseEnvHwRegionType=ROM
            OLDA_Cached: vBaseEnvHwRegionStartAddress=2413821952, vBaseEnvHwRegionSize=524288, vBaseEnvHwRegionType=RAM
            OLDA_NonCached: vBaseEnvHwRegionStartAddress=2950692864, vBaseEnvHwRegionSize=524288, vBaseEnvHwRegionType=RAM
            DLMU0_Cached: vBaseEnvHwRegionStartAddress=2415919104, vBaseEnvHwRegionSize=8192, vBaseEnvHwRegionType=RAM
            DLMU0_NonCached: vBaseEnvHwRegionStartAddress=2952790016, vBaseEnvHwRegionSize=8192, vBaseEnvHwRegionType=RAM
            DFlash0: vBaseEnvHwRegionStartAddress=2936012800, vBaseEnvHwRegionSize=1048576, vBaseEnvHwRegionType=ROM
            DFlash1: vBaseEnvHwRegionStartAddress=2948595712, vBaseEnvHwRegionSize=131072, vBaseEnvHwRegionType=ROM
        TC324L: vBaseEnvCpuCoreAmount=1, vBaseEnvCpuMaxFrequency=200000000, vBaseEnvTestedDerivative=TC32x, vBaseEnvTestedDerivativeDescription=Infineon Aurix 2G TC32x Family, vBaseEnvAvailableChannels_Can=6, vBaseEnvAvailableChannels_Ethernet=0, vBaseEnvAvailableChannels_Flexray=0, vBaseEnvAvailableChannels_Lin=5
          vBaseEnvAdditionalParameters: vBaseEnvWatchdogGroup=B, vBaseEnvPllGroup=B, vBaseEnvPortGroup=B, vBaseEnvResetGroup=B, vBaseEnvDerivativeGroup=TC3xx
          16 x vBaseEnvMemLayoutHwRegion:
            DSPR0: vBaseEnvHwRegionStartAddress=1879048192, vBaseEnvHwRegionSize=196608, vBaseEnvHwRegionType=RAM
            PSPR0: vBaseEnvHwRegionStartAddress=1880096768, vBaseEnvHwRegionSize=8192, vBaseEnvHwRegionType=RAM
            PFlash0_Cached: vBaseEnvHwRegionStartAddress=2147483648, vBaseEnvHwRegionSize=1572864, vBaseEnvHwRegionType=ROM
            PFlash0_NonCached: vBaseEnvHwRegionStartAddress=2684354560, vBaseEnvHwRegionSize=1572864, vBaseEnvHwRegionType=ROM
            LMU0_Cached: vBaseEnvHwRegionStartAddress=2415919104, vBaseEnvHwRegionSize=8192, vBaseEnvHwRegionType=RAM
            LMU0_NonCached: vBaseEnvHwRegionStartAddress=2952790016, vBaseEnvHwRegionSize=8192, vBaseEnvHwRegionType=RAM
            BMHD0: vBaseEnvHwRegionStartAddress=2940207104, vBaseEnvHwRegionSize=512, vBaseEnvHwRegionType=ROM
            BMHD1: vBaseEnvHwRegionStartAddress=2940207616, vBaseEnvHwRegionSize=512, vBaseEnvHwRegionType=ROM
            BMHD2: vBaseEnvHwRegionStartAddress=2940208128, vBaseEnvHwRegionSize=512, vBaseEnvHwRegionType=ROM
            BMHD3: vBaseEnvHwRegionStartAddress=2940208640, vBaseEnvHwRegionSize=512, vBaseEnvHwRegionType=ROM
            OLDA_Cached: vBaseEnvHwRegionStartAddress=2413821952, vBaseEnvHwRegionSize=524288, vBaseEnvHwRegionType=RAM
            OLDA_NonCached: vBaseEnvHwRegionStartAddress=2950692864, vBaseEnvHwRegionSize=524288, vBaseEnvHwRegionType=RAM
            DLMU0_Cached: vBaseEnvHwRegionStartAddress=2415919104, vBaseEnvHwRegionSize=8192, vBaseEnvHwRegionType=RAM
            DLMU0_NonCached: vBaseEnvHwRegionStartAddress=2952790016, vBaseEnvHwRegionSize=8192, vBaseEnvHwRegionType=RAM
            DFlash0: vBaseEnvHwRegionStartAddress=2936012800, vBaseEnvHwRegionSize=1048576, vBaseEnvHwRegionType=ROM
            DFlash1: vBaseEnvHwRegionStartAddress=2948595712, vBaseEnvHwRegionSize=131072, vBaseEnvHwRegionType=ROM
        TC327L: vBaseEnvCpuCoreAmount=1, vBaseEnvCpuMaxFrequency=160000000, vBaseEnvTestedDerivative=TC32x, vBaseEnvTestedDerivativeDescription=Infineon Aurix 2G TC32x Family, vBaseEnvAvailableChannels_Can=6, vBaseEnvAvailableChannels_Ethernet=0, vBaseEnvAvailableChannels_Flexray=0, vBaseEnvAvailableChannels_Lin=6
          vBaseEnvAdditionalParameters: vBaseEnvWatchdogGroup=B, vBaseEnvPllGroup=B, vBaseEnvPortGroup=B, vBaseEnvResetGroup=B, vBaseEnvDerivativeGroup=TC3xx
          16 x vBaseEnvMemLayoutHwRegion:
            DSPR0: vBaseEnvHwRegionStartAddress=1879048192, vBaseEnvHwRegionSize=196608, vBaseEnvHwRegionType=RAM
            PSPR0: vBaseEnvHwRegionStartAddress=1880096768, vBaseEnvHwRegionSize=8192, vBaseEnvHwRegionType=RAM
            PFlash0_Cached: vBaseEnvHwRegionStartAddress=2147483648, vBaseEnvHwRegionSize=1048576, vBaseEnvHwRegionType=ROM
            PFlash0_NonCached: vBaseEnvHwRegionStartAddress=2684354560, vBaseEnvHwRegionSize=1048576, vBaseEnvHwRegionType=ROM
            LMU0_Cached: vBaseEnvHwRegionStartAddress=2415919104, vBaseEnvHwRegionSize=8192, vBaseEnvHwRegionType=RAM
            LMU0_NonCached: vBaseEnvHwRegionStartAddress=2952790016, vBaseEnvHwRegionSize=8192, vBaseEnvHwRegionType=RAM
            BMHD0: vBaseEnvHwRegionStartAddress=2940207104, vBaseEnvHwRegionSize=512, vBaseEnvHwRegionType=ROM
            BMHD1: vBaseEnvHwRegionStartAddress=2940207616, vBaseEnvHwRegionSize=512, vBaseEnvHwRegionType=ROM
            BMHD2: vBaseEnvHwRegionStartAddress=2940208128, vBaseEnvHwRegionSize=512, vBaseEnvHwRegionType=ROM
            BMHD3: vBaseEnvHwRegionStartAddress=2940208640, vBaseEnvHwRegionSize=512, vBaseEnvHwRegionType=ROM
            OLDA_Cached: vBaseEnvHwRegionStartAddress=2413821952, vBaseEnvHwRegionSize=524288, vBaseEnvHwRegionType=RAM
            OLDA_NonCached: vBaseEnvHwRegionStartAddress=2950692864, vBaseEnvHwRegionSize=524288, vBaseEnvHwRegionType=RAM
            DLMU0_Cached: vBaseEnvHwRegionStartAddress=2415919104, vBaseEnvHwRegionSize=8192, vBaseEnvHwRegionType=RAM
            DLMU0_NonCached: vBaseEnvHwRegionStartAddress=2952790016, vBaseEnvHwRegionSize=8192, vBaseEnvHwRegionType=RAM
            DFlash0: vBaseEnvHwRegionStartAddress=2936012800, vBaseEnvHwRegionSize=1048576, vBaseEnvHwRegionType=ROM
            DFlash1: vBaseEnvHwRegionStartAddress=2948595712, vBaseEnvHwRegionSize=131072, vBaseEnvHwRegionType=ROM
        TC332L: vBaseEnvCpuCoreAmount=1, vBaseEnvCpuMaxFrequency=300000000, vBaseEnvTestedDerivative=TC33x, vBaseEnvTestedDerivativeDescription=Infineon Aurix 2G TC33x Family, vBaseEnvAvailableChannels_Can=6, vBaseEnvAvailableChannels_Ethernet=0, vBaseEnvAvailableChannels_Flexray=2, vBaseEnvAvailableChannels_Lin=5
          vBaseEnvAdditionalParameters: vBaseEnvWatchdogGroup=B, vBaseEnvPllGroup=B, vBaseEnvPortGroup=B, vBaseEnvResetGroup=B, vBaseEnvDerivativeGroup=TC3xx
          16 x vBaseEnvMemLayoutHwRegion:
            DSPR0: vBaseEnvHwRegionStartAddress=1879048192, vBaseEnvHwRegionSize=196608, vBaseEnvHwRegionType=RAM
            PSPR0: vBaseEnvHwRegionStartAddress=1880096768, vBaseEnvHwRegionSize=8192, vBaseEnvHwRegionType=RAM
            PFlash0_Cached: vBaseEnvHwRegionStartAddress=2147483648, vBaseEnvHwRegionSize=2097152, vBaseEnvHwRegionType=ROM
            PFlash0_NonCached: vBaseEnvHwRegionStartAddress=2684354560, vBaseEnvHwRegionSize=2097152, vBaseEnvHwRegionType=ROM
            LMU0_Cached: vBaseEnvHwRegionStartAddress=2415919104, vBaseEnvHwRegionSize=8192, vBaseEnvHwRegionType=RAM
            LMU0_NonCached: vBaseEnvHwRegionStartAddress=2952790016, vBaseEnvHwRegionSize=8192, vBaseEnvHwRegionType=RAM
            BMHD0: vBaseEnvHwRegionStartAddress=2940207104, vBaseEnvHwRegionSize=512, vBaseEnvHwRegionType=ROM
            BMHD1: vBaseEnvHwRegionStartAddress=2940207616, vBaseEnvHwRegionSize=512, vBaseEnvHwRegionType=ROM
            BMHD2: vBaseEnvHwRegionStartAddress=2940208128, vBaseEnvHwRegionSize=512, vBaseEnvHwRegionType=ROM
            BMHD3: vBaseEnvHwRegionStartAddress=2940208640, vBaseEnvHwRegionSize=512, vBaseEnvHwRegionType=ROM
            OLDA_Cached: vBaseEnvHwRegionStartAddress=2413821952, vBaseEnvHwRegionSize=524288, vBaseEnvHwRegionType=RAM
            OLDA_NonCached: vBaseEnvHwRegionStartAddress=2950692864, vBaseEnvHwRegionSize=524288, vBaseEnvHwRegionType=RAM
            DLMU0_Cached: vBaseEnvHwRegionStartAddress=2415919104, vBaseEnvHwRegionSize=8192, vBaseEnvHwRegionType=RAM
            DLMU0_NonCached: vBaseEnvHwRegionStartAddress=2952790016, vBaseEnvHwRegionSize=8192, vBaseEnvHwRegionType=RAM
            DFlash0: vBaseEnvHwRegionStartAddress=2936012800, vBaseEnvHwRegionSize=1048576, vBaseEnvHwRegionType=ROM
            DFlash1: vBaseEnvHwRegionStartAddress=2948595712, vBaseEnvHwRegionSize=131072, vBaseEnvHwRegionType=ROM
        TC333L: vBaseEnvCpuCoreAmount=1, vBaseEnvCpuMaxFrequency=300000000, vBaseEnvTestedDerivative=TC33x, vBaseEnvTestedDerivativeDescription=Infineon Aurix 2G TC33x Family, vBaseEnvAvailableChannels_Can=8, vBaseEnvAvailableChannels_Ethernet=0, vBaseEnvAvailableChannels_Flexray=2, vBaseEnvAvailableChannels_Lin=5
          vBaseEnvAdditionalParameters: vBaseEnvWatchdogGroup=B, vBaseEnvPllGroup=B, vBaseEnvPortGroup=B, vBaseEnvResetGroup=B, vBaseEnvDerivativeGroup=TC3xx
          16 x vBaseEnvMemLayoutHwRegion:
            DSPR0: vBaseEnvHwRegionStartAddress=1879048192, vBaseEnvHwRegionSize=196608, vBaseEnvHwRegionType=RAM
            PSPR0: vBaseEnvHwRegionStartAddress=1880096768, vBaseEnvHwRegionSize=8192, vBaseEnvHwRegionType=RAM
            PFlash0_Cached: vBaseEnvHwRegionStartAddress=2147483648, vBaseEnvHwRegionSize=2097152, vBaseEnvHwRegionType=ROM
            PFlash0_NonCached: vBaseEnvHwRegionStartAddress=2684354560, vBaseEnvHwRegionSize=2097152, vBaseEnvHwRegionType=ROM
            LMU0_Cached: vBaseEnvHwRegionStartAddress=2415919104, vBaseEnvHwRegionSize=8192, vBaseEnvHwRegionType=RAM
            LMU0_NonCached: vBaseEnvHwRegionStartAddress=2952790016, vBaseEnvHwRegionSize=8192, vBaseEnvHwRegionType=RAM
            BMHD0: vBaseEnvHwRegionStartAddress=2940207104, vBaseEnvHwRegionSize=512, vBaseEnvHwRegionType=ROM
            BMHD1: vBaseEnvHwRegionStartAddress=2940207616, vBaseEnvHwRegionSize=512, vBaseEnvHwRegionType=ROM
            BMHD2: vBaseEnvHwRegionStartAddress=2940208128, vBaseEnvHwRegionSize=512, vBaseEnvHwRegionType=ROM
            BMHD3: vBaseEnvHwRegionStartAddress=2940208640, vBaseEnvHwRegionSize=512, vBaseEnvHwRegionType=ROM
            OLDA_Cached: vBaseEnvHwRegionStartAddress=2413821952, vBaseEnvHwRegionSize=524288, vBaseEnvHwRegionType=RAM
            OLDA_NonCached: vBaseEnvHwRegionStartAddress=2950692864, vBaseEnvHwRegionSize=524288, vBaseEnvHwRegionType=RAM
            DLMU0_Cached: vBaseEnvHwRegionStartAddress=2415919104, vBaseEnvHwRegionSize=8192, vBaseEnvHwRegionType=RAM
            DLMU0_NonCached: vBaseEnvHwRegionStartAddress=2952790016, vBaseEnvHwRegionSize=8192, vBaseEnvHwRegionType=RAM
            DFlash0: vBaseEnvHwRegionStartAddress=2936012800, vBaseEnvHwRegionSize=1048576, vBaseEnvHwRegionType=ROM
            DFlash1: vBaseEnvHwRegionStartAddress=2948595712, vBaseEnvHwRegionSize=131072, vBaseEnvHwRegionType=ROM
        TC334L: vBaseEnvCpuCoreAmount=1, vBaseEnvCpuMaxFrequency=300000000, vBaseEnvTestedDerivative=TC33x, vBaseEnvTestedDerivativeDescription=Infineon Aurix 2G TC33x Family, vBaseEnvAvailableChannels_Can=8, vBaseEnvAvailableChannels_Ethernet=0, vBaseEnvAvailableChannels_Flexray=2, vBaseEnvAvailableChannels_Lin=12
          vBaseEnvAdditionalParameters: vBaseEnvWatchdogGroup=B, vBaseEnvPllGroup=B, vBaseEnvPortGroup=B, vBaseEnvResetGroup=B, vBaseEnvDerivativeGroup=TC3xx
          16 x vBaseEnvMemLayoutHwRegion:
            DSPR0: vBaseEnvHwRegionStartAddress=1879048192, vBaseEnvHwRegionSize=196608, vBaseEnvHwRegionType=RAM
            PSPR0: vBaseEnvHwRegionStartAddress=1880096768, vBaseEnvHwRegionSize=8192, vBaseEnvHwRegionType=RAM
            PFlash0_Cached: vBaseEnvHwRegionStartAddress=2147483648, vBaseEnvHwRegionSize=2097152, vBaseEnvHwRegionType=ROM
            PFlash0_NonCached: vBaseEnvHwRegionStartAddress=2684354560, vBaseEnvHwRegionSize=2097152, vBaseEnvHwRegionType=ROM
            LMU0_Cached: vBaseEnvHwRegionStartAddress=2415919104, vBaseEnvHwRegionSize=8192, vBaseEnvHwRegionType=RAM
            LMU0_NonCached: vBaseEnvHwRegionStartAddress=2952790016, vBaseEnvHwRegionSize=8192, vBaseEnvHwRegionType=RAM
            BMHD0: vBaseEnvHwRegionStartAddress=2940207104, vBaseEnvHwRegionSize=512, vBaseEnvHwRegionType=ROM
            BMHD1: vBaseEnvHwRegionStartAddress=2940207616, vBaseEnvHwRegionSize=512, vBaseEnvHwRegionType=ROM
            BMHD2: vBaseEnvHwRegionStartAddress=2940208128, vBaseEnvHwRegionSize=512, vBaseEnvHwRegionType=ROM
            BMHD3: vBaseEnvHwRegionStartAddress=2940208640, vBaseEnvHwRegionSize=512, vBaseEnvHwRegionType=ROM
            OLDA_Cached: vBaseEnvHwRegionStartAddress=2413821952, vBaseEnvHwRegionSize=524288, vBaseEnvHwRegionType=RAM
            OLDA_NonCached: vBaseEnvHwRegionStartAddress=2950692864, vBaseEnvHwRegionSize=524288, vBaseEnvHwRegionType=RAM
            DLMU0_Cached: vBaseEnvHwRegionStartAddress=2415919104, vBaseEnvHwRegionSize=8192, vBaseEnvHwRegionType=RAM
            DLMU0_NonCached: vBaseEnvHwRegionStartAddress=2952790016, vBaseEnvHwRegionSize=8192, vBaseEnvHwRegionType=RAM
            DFlash0: vBaseEnvHwRegionStartAddress=2936012800, vBaseEnvHwRegionSize=1048576, vBaseEnvHwRegionType=ROM
            DFlash1: vBaseEnvHwRegionStartAddress=2948595712, vBaseEnvHwRegionSize=131072, vBaseEnvHwRegionType=ROM
        TC336L: vBaseEnvCpuCoreAmount=1, vBaseEnvCpuMaxFrequency=300000000, vBaseEnvTestedDerivative=TC33x, vBaseEnvTestedDerivativeDescription=Infineon Aurix 2G TC33x Family, vBaseEnvAvailableChannels_Can=8, vBaseEnvAvailableChannels_Ethernet=0, vBaseEnvAvailableChannels_Flexray=2, vBaseEnvAvailableChannels_Lin=12
          vBaseEnvAdditionalParameters: vBaseEnvWatchdogGroup=B, vBaseEnvPllGroup=B, vBaseEnvPortGroup=B, vBaseEnvResetGroup=B, vBaseEnvDerivativeGroup=TC3xx
          16 x vBaseEnvMemLayoutHwRegion:
            DSPR0: vBaseEnvHwRegionStartAddress=1879048192, vBaseEnvHwRegionSize=196608, vBaseEnvHwRegionType=RAM
            PSPR0: vBaseEnvHwRegionStartAddress=1880096768, vBaseEnvHwRegionSize=8192, vBaseEnvHwRegionType=RAM
            PFlash0_Cached: vBaseEnvHwRegionStartAddress=2147483648, vBaseEnvHwRegionSize=2097152, vBaseEnvHwRegionType=ROM
            PFlash0_NonCached: vBaseEnvHwRegionStartAddress=2684354560, vBaseEnvHwRegionSize=2097152, vBaseEnvHwRegionType=ROM
            LMU0_Cached: vBaseEnvHwRegionStartAddress=2415919104, vBaseEnvHwRegionSize=8192, vBaseEnvHwRegionType=RAM
            LMU0_NonCached: vBaseEnvHwRegionStartAddress=2952790016, vBaseEnvHwRegionSize=8192, vBaseEnvHwRegionType=RAM
            BMHD0: vBaseEnvHwRegionStartAddress=2940207104, vBaseEnvHwRegionSize=512, vBaseEnvHwRegionType=ROM
            BMHD1: vBaseEnvHwRegionStartAddress=2940207616, vBaseEnvHwRegionSize=512, vBaseEnvHwRegionType=ROM
            BMHD2: vBaseEnvHwRegionStartAddress=2940208128, vBaseEnvHwRegionSize=512, vBaseEnvHwRegionType=ROM
            BMHD3: vBaseEnvHwRegionStartAddress=2940208640, vBaseEnvHwRegionSize=512, vBaseEnvHwRegionType=ROM
            OLDA_Cached: vBaseEnvHwRegionStartAddress=2413821952, vBaseEnvHwRegionSize=524288, vBaseEnvHwRegionType=RAM
            OLDA_NonCached: vBaseEnvHwRegionStartAddress=2950692864, vBaseEnvHwRegionSize=524288, vBaseEnvHwRegionType=RAM
            DLMU0_Cached: vBaseEnvHwRegionStartAddress=2415919104, vBaseEnvHwRegionSize=8192, vBaseEnvHwRegionType=RAM
            DLMU0_NonCached: vBaseEnvHwRegionStartAddress=2952790016, vBaseEnvHwRegionSize=8192, vBaseEnvHwRegionType=RAM
            DFlash0: vBaseEnvHwRegionStartAddress=2936012800, vBaseEnvHwRegionSize=1048576, vBaseEnvHwRegionType=ROM
            DFlash1: vBaseEnvHwRegionStartAddress=2948595712, vBaseEnvHwRegionSize=131072, vBaseEnvHwRegionType=ROM
        TC336D: vBaseEnvCpuCoreAmount=2, vBaseEnvCpuMaxFrequency=300000000, vBaseEnvTestedDerivative=TC33x, vBaseEnvTestedDerivativeDescription=Infineon Aurix 2G TC33x Family, vBaseEnvAvailableChannels_Can=4, vBaseEnvAvailableChannels_Ethernet=1, vBaseEnvAvailableChannels_Flexray=0, vBaseEnvAvailableChannels_Lin=5
          vBaseEnvAdditionalParameters: vBaseEnvWatchdogGroup=B, vBaseEnvPllGroup=B, vBaseEnvPortGroup=B, vBaseEnvResetGroup=B, vBaseEnvDerivativeGroup=TC3xx
          24 x vBaseEnvMemLayoutHwRegion:
            DSPR0: vBaseEnvHwRegionStartAddress=1879048192, vBaseEnvHwRegionSize=196608, vBaseEnvHwRegionType=RAM
            PSPR0: vBaseEnvHwRegionStartAddress=1880096768, vBaseEnvHwRegionSize=32768, vBaseEnvHwRegionType=RAM
            DSPR1: vBaseEnvHwRegionStartAddress=1610612736, vBaseEnvHwRegionSize=98304, vBaseEnvHwRegionType=RAM
            PSPR1: vBaseEnvHwRegionStartAddress=1611661312, vBaseEnvHwRegionSize=65536, vBaseEnvHwRegionType=RAM
            PFlash0_Cached: vBaseEnvHwRegionStartAddress=2147483648, vBaseEnvHwRegionSize=2097152, vBaseEnvHwRegionType=ROM
            PFlash0_NonCached: vBaseEnvHwRegionStartAddress=2684354560, vBaseEnvHwRegionSize=2097152, vBaseEnvHwRegionType=ROM
            LMU0_Cached: vBaseEnvHwRegionStartAddress=2415919104, vBaseEnvHwRegionSize=8192, vBaseEnvHwRegionType=RAM
            LMU0_NonCached: vBaseEnvHwRegionStartAddress=2952790016, vBaseEnvHwRegionSize=8192, vBaseEnvHwRegionType=RAM
            LMU1_Cached: vBaseEnvHwRegionStartAddress=2415984640, vBaseEnvHwRegionSize=65536, vBaseEnvHwRegionType=RAM
            LMU1_NonCached: vBaseEnvHwRegionStartAddress=2952855552, vBaseEnvHwRegionSize=65536, vBaseEnvHwRegionType=RAM
            BMHD0: vBaseEnvHwRegionStartAddress=2940207104, vBaseEnvHwRegionSize=512, vBaseEnvHwRegionType=ROM
            BMHD1: vBaseEnvHwRegionStartAddress=2940207616, vBaseEnvHwRegionSize=512, vBaseEnvHwRegionType=ROM
            BMHD2: vBaseEnvHwRegionStartAddress=2940208128, vBaseEnvHwRegionSize=512, vBaseEnvHwRegionType=ROM
            BMHD3: vBaseEnvHwRegionStartAddress=2940208640, vBaseEnvHwRegionSize=512, vBaseEnvHwRegionType=ROM
            OLDA_Cached: vBaseEnvHwRegionStartAddress=2413821952, vBaseEnvHwRegionSize=524288, vBaseEnvHwRegionType=RAM
            OLDA_NonCached: vBaseEnvHwRegionStartAddress=2950692864, vBaseEnvHwRegionSize=524288, vBaseEnvHwRegionType=RAM
            DLMU0_Cached: vBaseEnvHwRegionStartAddress=2415919104, vBaseEnvHwRegionSize=8192, vBaseEnvHwRegionType=RAM
            DLMU0_NonCached: vBaseEnvHwRegionStartAddress=2952790016, vBaseEnvHwRegionSize=8192, vBaseEnvHwRegionType=RAM
            DLMU1_Cached: vBaseEnvHwRegionStartAddress=2415984640, vBaseEnvHwRegionSize=65536, vBaseEnvHwRegionType=RAM
            DLMU1_NonCached: vBaseEnvHwRegionStartAddress=2952855552, vBaseEnvHwRegionSize=65536, vBaseEnvHwRegionType=RAM
            DFlash0: vBaseEnvHwRegionStartAddress=2936012800, vBaseEnvHwRegionSize=1048576, vBaseEnvHwRegionType=ROM
            DFlash1: vBaseEnvHwRegionStartAddress=2948595712, vBaseEnvHwRegionSize=131072, vBaseEnvHwRegionType=ROM
            EMEM0_Cached: vBaseEnvHwRegionStartAddress=2566914048, vBaseEnvHwRegionSize=1048576, vBaseEnvHwRegionType=RAM
            EMEM1_NonCached: vBaseEnvHwRegionStartAddress=3103784960, vBaseEnvHwRegionSize=1048576, vBaseEnvHwRegionType=RAM
        TC337L: vBaseEnvCpuCoreAmount=1, vBaseEnvCpuMaxFrequency=300000000, vBaseEnvTestedDerivative=TC33x, vBaseEnvTestedDerivativeDescription=Infineon Aurix 2G TC33x Family, vBaseEnvAvailableChannels_Can=8, vBaseEnvAvailableChannels_Ethernet=0, vBaseEnvAvailableChannels_Flexray=2, vBaseEnvAvailableChannels_Lin=12
          vBaseEnvAdditionalParameters: vBaseEnvWatchdogGroup=B, vBaseEnvPllGroup=B, vBaseEnvPortGroup=B, vBaseEnvResetGroup=B, vBaseEnvDerivativeGroup=TC3xx
          16 x vBaseEnvMemLayoutHwRegion:
            DSPR0: vBaseEnvHwRegionStartAddress=1879048192, vBaseEnvHwRegionSize=196608, vBaseEnvHwRegionType=RAM
            PSPR0: vBaseEnvHwRegionStartAddress=1880096768, vBaseEnvHwRegionSize=8192, vBaseEnvHwRegionType=RAM
            PFlash0_Cached: vBaseEnvHwRegionStartAddress=2147483648, vBaseEnvHwRegionSize=2097152, vBaseEnvHwRegionType=ROM
            PFlash0_NonCached: vBaseEnvHwRegionStartAddress=2684354560, vBaseEnvHwRegionSize=2097152, vBaseEnvHwRegionType=ROM
            LMU0_Cached: vBaseEnvHwRegionStartAddress=2415919104, vBaseEnvHwRegionSize=8192, vBaseEnvHwRegionType=RAM
            LMU0_NonCached: vBaseEnvHwRegionStartAddress=2952790016, vBaseEnvHwRegionSize=8192, vBaseEnvHwRegionType=RAM
            BMHD0: vBaseEnvHwRegionStartAddress=2940207104, vBaseEnvHwRegionSize=512, vBaseEnvHwRegionType=ROM
            BMHD1: vBaseEnvHwRegionStartAddress=2940207616, vBaseEnvHwRegionSize=512, vBaseEnvHwRegionType=ROM
            BMHD2: vBaseEnvHwRegionStartAddress=2940208128, vBaseEnvHwRegionSize=512, vBaseEnvHwRegionType=ROM
            BMHD3: vBaseEnvHwRegionStartAddress=2940208640, vBaseEnvHwRegionSize=512, vBaseEnvHwRegionType=ROM
            OLDA_Cached: vBaseEnvHwRegionStartAddress=2413821952, vBaseEnvHwRegionSize=524288, vBaseEnvHwRegionType=RAM
            OLDA_NonCached: vBaseEnvHwRegionStartAddress=2950692864, vBaseEnvHwRegionSize=524288, vBaseEnvHwRegionType=RAM
            DLMU0_Cached: vBaseEnvHwRegionStartAddress=2415919104, vBaseEnvHwRegionSize=8192, vBaseEnvHwRegionType=RAM
            DLMU0_NonCached: vBaseEnvHwRegionStartAddress=2952790016, vBaseEnvHwRegionSize=8192, vBaseEnvHwRegionType=RAM
            DFlash0: vBaseEnvHwRegionStartAddress=2936012800, vBaseEnvHwRegionSize=1048576, vBaseEnvHwRegionType=ROM
            DFlash1: vBaseEnvHwRegionStartAddress=2948595712, vBaseEnvHwRegionSize=131072, vBaseEnvHwRegionType=ROM
        TC337D: vBaseEnvCpuCoreAmount=2, vBaseEnvCpuMaxFrequency=300000000, vBaseEnvTestedDerivative=TC33x, vBaseEnvTestedDerivativeDescription=Infineon Aurix 2G TC33x Family, vBaseEnvAvailableChannels_Can=4, vBaseEnvAvailableChannels_Ethernet=1, vBaseEnvAvailableChannels_Flexray=0, vBaseEnvAvailableChannels_Lin=6
          vBaseEnvAdditionalParameters: vBaseEnvWatchdogGroup=B, vBaseEnvPllGroup=B, vBaseEnvPortGroup=B, vBaseEnvResetGroup=B, vBaseEnvDerivativeGroup=TC3xx
          24 x vBaseEnvMemLayoutHwRegion:
            DSPR0: vBaseEnvHwRegionStartAddress=1879048192, vBaseEnvHwRegionSize=196608, vBaseEnvHwRegionType=RAM
            PSPR0: vBaseEnvHwRegionStartAddress=1880096768, vBaseEnvHwRegionSize=32768, vBaseEnvHwRegionType=RAM
            DSPR1: vBaseEnvHwRegionStartAddress=1610612736, vBaseEnvHwRegionSize=98304, vBaseEnvHwRegionType=RAM
            PSPR1: vBaseEnvHwRegionStartAddress=1611661312, vBaseEnvHwRegionSize=65536, vBaseEnvHwRegionType=RAM
            PFlash0_Cached: vBaseEnvHwRegionStartAddress=2147483648, vBaseEnvHwRegionSize=2097152, vBaseEnvHwRegionType=ROM
            PFlash0_NonCached: vBaseEnvHwRegionStartAddress=2684354560, vBaseEnvHwRegionSize=2097152, vBaseEnvHwRegionType=ROM
            LMU0_Cached: vBaseEnvHwRegionStartAddress=2415919104, vBaseEnvHwRegionSize=8192, vBaseEnvHwRegionType=RAM
            LMU0_NonCached: vBaseEnvHwRegionStartAddress=2952790016, vBaseEnvHwRegionSize=8192, vBaseEnvHwRegionType=RAM
            LMU1_Cached: vBaseEnvHwRegionStartAddress=2415984640, vBaseEnvHwRegionSize=65536, vBaseEnvHwRegionType=RAM
            LMU1_NonCached: vBaseEnvHwRegionStartAddress=2952855552, vBaseEnvHwRegionSize=65536, vBaseEnvHwRegionType=RAM
            BMHD0: vBaseEnvHwRegionStartAddress=2940207104, vBaseEnvHwRegionSize=512, vBaseEnvHwRegionType=ROM
            BMHD1: vBaseEnvHwRegionStartAddress=2940207616, vBaseEnvHwRegionSize=512, vBaseEnvHwRegionType=ROM
            BMHD2: vBaseEnvHwRegionStartAddress=2940208128, vBaseEnvHwRegionSize=512, vBaseEnvHwRegionType=ROM
            BMHD3: vBaseEnvHwRegionStartAddress=2940208640, vBaseEnvHwRegionSize=512, vBaseEnvHwRegionType=ROM
            OLDA_Cached: vBaseEnvHwRegionStartAddress=2413821952, vBaseEnvHwRegionSize=524288, vBaseEnvHwRegionType=RAM
            OLDA_NonCached: vBaseEnvHwRegionStartAddress=2950692864, vBaseEnvHwRegionSize=524288, vBaseEnvHwRegionType=RAM
            DLMU0_Cached: vBaseEnvHwRegionStartAddress=2415919104, vBaseEnvHwRegionSize=8192, vBaseEnvHwRegionType=RAM
            DLMU0_NonCached: vBaseEnvHwRegionStartAddress=2952790016, vBaseEnvHwRegionSize=8192, vBaseEnvHwRegionType=RAM
            DLMU1_Cached: vBaseEnvHwRegionStartAddress=2415984640, vBaseEnvHwRegionSize=65536, vBaseEnvHwRegionType=RAM
            DLMU1_NonCached: vBaseEnvHwRegionStartAddress=2952855552, vBaseEnvHwRegionSize=65536, vBaseEnvHwRegionType=RAM
            DFlash0: vBaseEnvHwRegionStartAddress=2936012800, vBaseEnvHwRegionSize=1048576, vBaseEnvHwRegionType=ROM
            DFlash1: vBaseEnvHwRegionStartAddress=2948595712, vBaseEnvHwRegionSize=131072, vBaseEnvHwRegionType=ROM
            EMEM0_Cached: vBaseEnvHwRegionStartAddress=2566914048, vBaseEnvHwRegionSize=1048576, vBaseEnvHwRegionType=RAM
            EMEM1_NonCached: vBaseEnvHwRegionStartAddress=3103784960, vBaseEnvHwRegionSize=1048576, vBaseEnvHwRegionType=RAM
        TC356T: vBaseEnvCpuCoreAmount=3, vBaseEnvCpuMaxFrequency=300000000, vBaseEnvTestedDerivative=TC35x, vBaseEnvTestedDerivativeDescription=Infineon Aurix 2G TC35x Family, vBaseEnvAvailableChannels_Can=7, vBaseEnvAvailableChannels_Ethernet=1, vBaseEnvAvailableChannels_Flexray=2, vBaseEnvAvailableChannels_Lin=4
          vBaseEnvAdditionalParameters: vBaseEnvWatchdogGroup=B, vBaseEnvPllGroup=B, vBaseEnvPortGroup=B, vBaseEnvResetGroup=B, vBaseEnvDerivativeGroup=TC3xx
          32 x vBaseEnvMemLayoutHwRegion:
            DSPR0: vBaseEnvHwRegionStartAddress=1879048192, vBaseEnvHwRegionSize=245760, vBaseEnvHwRegionType=RAM
            PSPR0: vBaseEnvHwRegionStartAddress=1880096768, vBaseEnvHwRegionSize=65536, vBaseEnvHwRegionType=RAM
            DSPR1: vBaseEnvHwRegionStartAddress=1610612736, vBaseEnvHwRegionSize=245760, vBaseEnvHwRegionType=RAM
            PSPR1: vBaseEnvHwRegionStartAddress=1611661312, vBaseEnvHwRegionSize=65536, vBaseEnvHwRegionType=RAM
            DSPR2: vBaseEnvHwRegionStartAddress=1342177280, vBaseEnvHwRegionSize=98304, vBaseEnvHwRegionType=RAM
            PSPR2: vBaseEnvHwRegionStartAddress=1343225856, vBaseEnvHwRegionSize=65536, vBaseEnvHwRegionType=RAM
            PFlash0_Cached: vBaseEnvHwRegionStartAddress=2147483648, vBaseEnvHwRegionSize=2097152, vBaseEnvHwRegionType=ROM
            PFlash0_NonCached: vBaseEnvHwRegionStartAddress=2684354560, vBaseEnvHwRegionSize=2097152, vBaseEnvHwRegionType=ROM
            PFlash1_Cached: vBaseEnvHwRegionStartAddress=2150629376, vBaseEnvHwRegionSize=2097152, vBaseEnvHwRegionType=ROM
            PFlash1_NonCached: vBaseEnvHwRegionStartAddress=2687500288, vBaseEnvHwRegionSize=2097152, vBaseEnvHwRegionType=ROM
            LMU0_Cached: vBaseEnvHwRegionStartAddress=2416181248, vBaseEnvHwRegionSize=262144, vBaseEnvHwRegionType=RAM
            LMU0_NonCached: vBaseEnvHwRegionStartAddress=2953052160, vBaseEnvHwRegionSize=262144, vBaseEnvHwRegionType=RAM
            LMU1_Cached: vBaseEnvHwRegionStartAddress=2416443392, vBaseEnvHwRegionSize=262144, vBaseEnvHwRegionType=RAM
            LMU1_NonCached: vBaseEnvHwRegionStartAddress=2953314304, vBaseEnvHwRegionSize=262144, vBaseEnvHwRegionType=RAM
            BMHD0: vBaseEnvHwRegionStartAddress=2940207104, vBaseEnvHwRegionSize=512, vBaseEnvHwRegionType=ROM
            BMHD1: vBaseEnvHwRegionStartAddress=2940207616, vBaseEnvHwRegionSize=512, vBaseEnvHwRegionType=ROM
            BMHD2: vBaseEnvHwRegionStartAddress=2940208128, vBaseEnvHwRegionSize=512, vBaseEnvHwRegionType=ROM
            BMHD3: vBaseEnvHwRegionStartAddress=2940208640, vBaseEnvHwRegionSize=512, vBaseEnvHwRegionType=ROM
            OLDA_Cached: vBaseEnvHwRegionStartAddress=2413821952, vBaseEnvHwRegionSize=524288, vBaseEnvHwRegionType=RAM
            OLDA_NonCached: vBaseEnvHwRegionStartAddress=2950692864, vBaseEnvHwRegionSize=524288, vBaseEnvHwRegionType=RAM
            DLMU0_Cached: vBaseEnvHwRegionStartAddress=2415919104, vBaseEnvHwRegionSize=65536, vBaseEnvHwRegionType=RAM
            DLMU0_NonCached: vBaseEnvHwRegionStartAddress=2952790016, vBaseEnvHwRegionSize=65536, vBaseEnvHwRegionType=RAM
            DLMU1_Cached: vBaseEnvHwRegionStartAddress=2415984640, vBaseEnvHwRegionSize=65536, vBaseEnvHwRegionType=RAM
            DLMU1_NonCached: vBaseEnvHwRegionStartAddress=2952855552, vBaseEnvHwRegionSize=65536, vBaseEnvHwRegionType=RAM
            DLMU2_Cached: vBaseEnvHwRegionStartAddress=2416050176, vBaseEnvHwRegionSize=65536, vBaseEnvHwRegionType=RAM
            DLMU2_NonCached: vBaseEnvHwRegionStartAddress=2952921088, vBaseEnvHwRegionSize=65536, vBaseEnvHwRegionType=RAM
            EMEM0_Cached: vBaseEnvHwRegionStartAddress=2566914048, vBaseEnvHwRegionSize=1048576, vBaseEnvHwRegionType=RAM
            EMEM0_NonCached: vBaseEnvHwRegionStartAddress=3103784960, vBaseEnvHwRegionSize=1048576, vBaseEnvHwRegionType=RAM
            EMEM1_Cached: vBaseEnvHwRegionStartAddress=2567962624, vBaseEnvHwRegionSize=1048576, vBaseEnvHwRegionType=RAM
            EMEM1_NonCached: vBaseEnvHwRegionStartAddress=3104833536, vBaseEnvHwRegionSize=1048576, vBaseEnvHwRegionType=RAM
            DFlash0: vBaseEnvHwRegionStartAddress=2936012800, vBaseEnvHwRegionSize=131072, vBaseEnvHwRegionType=ROM
            DFlash1: vBaseEnvHwRegionStartAddress=2948595712, vBaseEnvHwRegionSize=131072, vBaseEnvHwRegionType=ROM
        TC357T: vBaseEnvCpuCoreAmount=3, vBaseEnvCpuMaxFrequency=300000000, vBaseEnvTestedDerivative=TC35x, vBaseEnvTestedDerivativeDescription=Infineon Aurix 2G TC35x Family, vBaseEnvAvailableChannels_Can=8, vBaseEnvAvailableChannels_Ethernet=1, vBaseEnvAvailableChannels_Flexray=2, vBaseEnvAvailableChannels_Lin=4
          vBaseEnvAdditionalParameters: vBaseEnvWatchdogGroup=B, vBaseEnvPllGroup=B, vBaseEnvPortGroup=B, vBaseEnvResetGroup=B, vBaseEnvDerivativeGroup=TC3xx
          32 x vBaseEnvMemLayoutHwRegion:
            DSPR0: vBaseEnvHwRegionStartAddress=1879048192, vBaseEnvHwRegionSize=245760, vBaseEnvHwRegionType=RAM
            PSPR0: vBaseEnvHwRegionStartAddress=1880096768, vBaseEnvHwRegionSize=65536, vBaseEnvHwRegionType=RAM
            DSPR1: vBaseEnvHwRegionStartAddress=1610612736, vBaseEnvHwRegionSize=245760, vBaseEnvHwRegionType=RAM
            PSPR1: vBaseEnvHwRegionStartAddress=1611661312, vBaseEnvHwRegionSize=65536, vBaseEnvHwRegionType=RAM
            DSPR2: vBaseEnvHwRegionStartAddress=1342177280, vBaseEnvHwRegionSize=98304, vBaseEnvHwRegionType=RAM
            PSPR2: vBaseEnvHwRegionStartAddress=1343225856, vBaseEnvHwRegionSize=65536, vBaseEnvHwRegionType=RAM
            PFlash0_Cached: vBaseEnvHwRegionStartAddress=2147483648, vBaseEnvHwRegionSize=2097152, vBaseEnvHwRegionType=ROM
            PFlash0_NonCached: vBaseEnvHwRegionStartAddress=2684354560, vBaseEnvHwRegionSize=2097152, vBaseEnvHwRegionType=ROM
            PFlash1_Cached: vBaseEnvHwRegionStartAddress=2150629376, vBaseEnvHwRegionSize=2097152, vBaseEnvHwRegionType=ROM
            PFlash1_NonCached: vBaseEnvHwRegionStartAddress=2687500288, vBaseEnvHwRegionSize=2097152, vBaseEnvHwRegionType=ROM
            LMU0_Cached: vBaseEnvHwRegionStartAddress=2416181248, vBaseEnvHwRegionSize=262144, vBaseEnvHwRegionType=RAM
            LMU0_NonCached: vBaseEnvHwRegionStartAddress=2953052160, vBaseEnvHwRegionSize=262144, vBaseEnvHwRegionType=RAM
            LMU1_Cached: vBaseEnvHwRegionStartAddress=2416443392, vBaseEnvHwRegionSize=262144, vBaseEnvHwRegionType=RAM
            LMU1_NonCached: vBaseEnvHwRegionStartAddress=2953314304, vBaseEnvHwRegionSize=262144, vBaseEnvHwRegionType=RAM
            BMHD0: vBaseEnvHwRegionStartAddress=2940207104, vBaseEnvHwRegionSize=512, vBaseEnvHwRegionType=ROM
            BMHD1: vBaseEnvHwRegionStartAddress=2940207616, vBaseEnvHwRegionSize=512, vBaseEnvHwRegionType=ROM
            BMHD2: vBaseEnvHwRegionStartAddress=2940208128, vBaseEnvHwRegionSize=512, vBaseEnvHwRegionType=ROM
            BMHD3: vBaseEnvHwRegionStartAddress=2940208640, vBaseEnvHwRegionSize=512, vBaseEnvHwRegionType=ROM
            OLDA_Cached: vBaseEnvHwRegionStartAddress=2413821952, vBaseEnvHwRegionSize=524288, vBaseEnvHwRegionType=RAM
            OLDA_NonCached: vBaseEnvHwRegionStartAddress=2950692864, vBaseEnvHwRegionSize=524288, vBaseEnvHwRegionType=RAM
            DLMU0_Cached: vBaseEnvHwRegionStartAddress=2415919104, vBaseEnvHwRegionSize=65536, vBaseEnvHwRegionType=RAM
            DLMU0_NonCached: vBaseEnvHwRegionStartAddress=2952790016, vBaseEnvHwRegionSize=65536, vBaseEnvHwRegionType=RAM
            DLMU1_Cached: vBaseEnvHwRegionStartAddress=2415984640, vBaseEnvHwRegionSize=65536, vBaseEnvHwRegionType=RAM
            DLMU1_NonCached: vBaseEnvHwRegionStartAddress=2952855552, vBaseEnvHwRegionSize=65536, vBaseEnvHwRegionType=RAM
            DLMU2_Cached: vBaseEnvHwRegionStartAddress=2416050176, vBaseEnvHwRegionSize=65536, vBaseEnvHwRegionType=RAM
            DLMU2_NonCached: vBaseEnvHwRegionStartAddress=2952921088, vBaseEnvHwRegionSize=65536, vBaseEnvHwRegionType=RAM
            EMEM0_Cached: vBaseEnvHwRegionStartAddress=2566914048, vBaseEnvHwRegionSize=1048576, vBaseEnvHwRegionType=RAM
            EMEM0_NonCached: vBaseEnvHwRegionStartAddress=3103784960, vBaseEnvHwRegionSize=1048576, vBaseEnvHwRegionType=RAM
            EMEM1_Cached: vBaseEnvHwRegionStartAddress=2567962624, vBaseEnvHwRegionSize=1048576, vBaseEnvHwRegionType=RAM
            EMEM1_NonCached: vBaseEnvHwRegionStartAddress=3104833536, vBaseEnvHwRegionSize=1048576, vBaseEnvHwRegionType=RAM
            DFlash0: vBaseEnvHwRegionStartAddress=2936012800, vBaseEnvHwRegionSize=131072, vBaseEnvHwRegionType=ROM
            DFlash1: vBaseEnvHwRegionStartAddress=2948595712, vBaseEnvHwRegionSize=131072, vBaseEnvHwRegionType=ROM
        TC360D: vBaseEnvCpuCoreAmount=2, vBaseEnvCpuMaxFrequency=300000000, vBaseEnvTestedDerivative=TC36x, vBaseEnvTestedDerivativeDescription=Infineon Aurix 2G TC36x Family, vBaseEnvAvailableChannels_Can=8, vBaseEnvAvailableChannels_Ethernet=1, vBaseEnvAvailableChannels_Flexray=2, vBaseEnvAvailableChannels_Lin=12
          vBaseEnvAdditionalParameters: vBaseEnvWatchdogGroup=B, vBaseEnvPllGroup=B, vBaseEnvPortGroup=B, vBaseEnvResetGroup=B, vBaseEnvDerivativeGroup=TC3xx
          24 x vBaseEnvMemLayoutHwRegion:
            DSPR0: vBaseEnvHwRegionStartAddress=1879048192, vBaseEnvHwRegionSize=196608, vBaseEnvHwRegionType=RAM
            PSPR0: vBaseEnvHwRegionStartAddress=1880096768, vBaseEnvHwRegionSize=32768, vBaseEnvHwRegionType=RAM
            DSPR1: vBaseEnvHwRegionStartAddress=1610612736, vBaseEnvHwRegionSize=196608, vBaseEnvHwRegionType=RAM
            PSPR1: vBaseEnvHwRegionStartAddress=1611661312, vBaseEnvHwRegionSize=32768, vBaseEnvHwRegionType=RAM
            PFlash0_Cached: vBaseEnvHwRegionStartAddress=2147483648, vBaseEnvHwRegionSize=2097152, vBaseEnvHwRegionType=ROM
            PFlash0_NonCached: vBaseEnvHwRegionStartAddress=2684354560, vBaseEnvHwRegionSize=2097152, vBaseEnvHwRegionType=ROM
            PFlash1_Cached: vBaseEnvHwRegionStartAddress=2150629376, vBaseEnvHwRegionSize=2097152, vBaseEnvHwRegionType=ROM
            PFlash1_NonCached: vBaseEnvHwRegionStartAddress=2687500288, vBaseEnvHwRegionSize=2097152, vBaseEnvHwRegionType=ROM
            LMU0_Cached: vBaseEnvHwRegionStartAddress=2415919104, vBaseEnvHwRegionSize=65536, vBaseEnvHwRegionType=RAM
            LMU0_NonCached: vBaseEnvHwRegionStartAddress=2952790016, vBaseEnvHwRegionSize=65536, vBaseEnvHwRegionType=RAM
            LMU1_Cached: vBaseEnvHwRegionStartAddress=2415984640, vBaseEnvHwRegionSize=65536, vBaseEnvHwRegionType=RAM
            LMU1_NonCached: vBaseEnvHwRegionStartAddress=2952855552, vBaseEnvHwRegionSize=65536, vBaseEnvHwRegionType=RAM
            BMHD0: vBaseEnvHwRegionStartAddress=2940207104, vBaseEnvHwRegionSize=512, vBaseEnvHwRegionType=ROM
            BMHD1: vBaseEnvHwRegionStartAddress=2940207616, vBaseEnvHwRegionSize=512, vBaseEnvHwRegionType=ROM
            BMHD2: vBaseEnvHwRegionStartAddress=2940208128, vBaseEnvHwRegionSize=512, vBaseEnvHwRegionType=ROM
            BMHD3: vBaseEnvHwRegionStartAddress=2940208640, vBaseEnvHwRegionSize=512, vBaseEnvHwRegionType=ROM
            OLDA_Cached: vBaseEnvHwRegionStartAddress=2413821952, vBaseEnvHwRegionSize=524288, vBaseEnvHwRegionType=RAM
            OLDA_NonCached: vBaseEnvHwRegionStartAddress=2950692864, vBaseEnvHwRegionSize=524288, vBaseEnvHwRegionType=RAM
            DLMU0_Cached: vBaseEnvHwRegionStartAddress=2415919104, vBaseEnvHwRegionSize=65536, vBaseEnvHwRegionType=RAM
            DLMU0_NonCached: vBaseEnvHwRegionStartAddress=2952790016, vBaseEnvHwRegionSize=65536, vBaseEnvHwRegionType=RAM
            DLMU1_Cached: vBaseEnvHwRegionStartAddress=2415984640, vBaseEnvHwRegionSize=65536, vBaseEnvHwRegionType=RAM
            DLMU1_NonCached: vBaseEnvHwRegionStartAddress=2952855552, vBaseEnvHwRegionSize=65536, vBaseEnvHwRegionType=RAM
            DFlash0: vBaseEnvHwRegionStartAddress=2936012800, vBaseEnvHwRegionSize=131072, vBaseEnvHwRegionType=ROM
            DFlash1: vBaseEnvHwRegionStartAddress=2948595712, vBaseEnvHwRegionSize=131072, vBaseEnvHwRegionType=ROM
        TC364D: vBaseEnvCpuCoreAmount=2, vBaseEnvCpuMaxFrequency=300000000, vBaseEnvTestedDerivative=TC36x, vBaseEnvTestedDerivativeDescription=Infineon Aurix 2G TC36x Family, vBaseEnvAvailableChannels_Can=8, vBaseEnvAvailableChannels_Ethernet=1, vBaseEnvAvailableChannels_Flexray=2, vBaseEnvAvailableChannels_Lin=12
          vBaseEnvAdditionalParameters: vBaseEnvWatchdogGroup=B, vBaseEnvPllGroup=B, vBaseEnvPortGroup=B, vBaseEnvResetGroup=B, vBaseEnvDerivativeGroup=TC3xx
          24 x vBaseEnvMemLayoutHwRegion:
            DSPR0: vBaseEnvHwRegionStartAddress=1879048192, vBaseEnvHwRegionSize=196608, vBaseEnvHwRegionType=RAM
            PSPR0: vBaseEnvHwRegionStartAddress=1880096768, vBaseEnvHwRegionSize=32768, vBaseEnvHwRegionType=RAM
            DSPR1: vBaseEnvHwRegionStartAddress=1610612736, vBaseEnvHwRegionSize=196608, vBaseEnvHwRegionType=RAM
            PSPR1: vBaseEnvHwRegionStartAddress=1611661312, vBaseEnvHwRegionSize=32768, vBaseEnvHwRegionType=RAM
            PFlash0_Cached: vBaseEnvHwRegionStartAddress=2147483648, vBaseEnvHwRegionSize=2097152, vBaseEnvHwRegionType=ROM
            PFlash0_NonCached: vBaseEnvHwRegionStartAddress=2684354560, vBaseEnvHwRegionSize=2097152, vBaseEnvHwRegionType=ROM
            PFlash1_Cached: vBaseEnvHwRegionStartAddress=2150629376, vBaseEnvHwRegionSize=2097152, vBaseEnvHwRegionType=ROM
            PFlash1_NonCached: vBaseEnvHwRegionStartAddress=2687500288, vBaseEnvHwRegionSize=2097152, vBaseEnvHwRegionType=ROM
            LMU0_Cached: vBaseEnvHwRegionStartAddress=2415919104, vBaseEnvHwRegionSize=65536, vBaseEnvHwRegionType=RAM
            LMU0_NonCached: vBaseEnvHwRegionStartAddress=2952790016, vBaseEnvHwRegionSize=65536, vBaseEnvHwRegionType=RAM
            LMU1_Cached: vBaseEnvHwRegionStartAddress=2415984640, vBaseEnvHwRegionSize=65536, vBaseEnvHwRegionType=RAM
            LMU1_NonCached: vBaseEnvHwRegionStartAddress=2952855552, vBaseEnvHwRegionSize=65536, vBaseEnvHwRegionType=RAM
            BMHD0: vBaseEnvHwRegionStartAddress=2940207104, vBaseEnvHwRegionSize=512, vBaseEnvHwRegionType=ROM
            BMHD1: vBaseEnvHwRegionStartAddress=2940207616, vBaseEnvHwRegionSize=512, vBaseEnvHwRegionType=ROM
            BMHD2: vBaseEnvHwRegionStartAddress=2940208128, vBaseEnvHwRegionSize=512, vBaseEnvHwRegionType=ROM
            BMHD3: vBaseEnvHwRegionStartAddress=2940208640, vBaseEnvHwRegionSize=512, vBaseEnvHwRegionType=ROM
            OLDA_Cached: vBaseEnvHwRegionStartAddress=2413821952, vBaseEnvHwRegionSize=524288, vBaseEnvHwRegionType=RAM
            OLDA_NonCached: vBaseEnvHwRegionStartAddress=2950692864, vBaseEnvHwRegionSize=524288, vBaseEnvHwRegionType=RAM
            DLMU0_Cached: vBaseEnvHwRegionStartAddress=2415919104, vBaseEnvHwRegionSize=65536, vBaseEnvHwRegionType=RAM
            DLMU0_NonCached: vBaseEnvHwRegionStartAddress=2952790016, vBaseEnvHwRegionSize=65536, vBaseEnvHwRegionType=RAM
            DLMU1_Cached: vBaseEnvHwRegionStartAddress=2415984640, vBaseEnvHwRegionSize=65536, vBaseEnvHwRegionType=RAM
            DLMU1_NonCached: vBaseEnvHwRegionStartAddress=2952855552, vBaseEnvHwRegionSize=65536, vBaseEnvHwRegionType=RAM
            DFlash0: vBaseEnvHwRegionStartAddress=2936012800, vBaseEnvHwRegionSize=131072, vBaseEnvHwRegionType=ROM
            DFlash1: vBaseEnvHwRegionStartAddress=2948595712, vBaseEnvHwRegionSize=131072, vBaseEnvHwRegionType=ROM
        TC365D: vBaseEnvCpuCoreAmount=2, vBaseEnvCpuMaxFrequency=300000000, vBaseEnvTestedDerivative=TC36x, vBaseEnvTestedDerivativeDescription=Infineon Aurix 2G TC36x Family, vBaseEnvAvailableChannels_Can=8, vBaseEnvAvailableChannels_Ethernet=1, vBaseEnvAvailableChannels_Flexray=2, vBaseEnvAvailableChannels_Lin=12
          vBaseEnvAdditionalParameters: vBaseEnvWatchdogGroup=B, vBaseEnvPllGroup=B, vBaseEnvPortGroup=B, vBaseEnvResetGroup=B, vBaseEnvDerivativeGroup=TC3xx
          24 x vBaseEnvMemLayoutHwRegion:
            DSPR0: vBaseEnvHwRegionStartAddress=1879048192, vBaseEnvHwRegionSize=196608, vBaseEnvHwRegionType=RAM
            PSPR0: vBaseEnvHwRegionStartAddress=1880096768, vBaseEnvHwRegionSize=32768, vBaseEnvHwRegionType=RAM
            DSPR1: vBaseEnvHwRegionStartAddress=1610612736, vBaseEnvHwRegionSize=196608, vBaseEnvHwRegionType=RAM
            PSPR1: vBaseEnvHwRegionStartAddress=1611661312, vBaseEnvHwRegionSize=32768, vBaseEnvHwRegionType=RAM
            PFlash0_Cached: vBaseEnvHwRegionStartAddress=2147483648, vBaseEnvHwRegionSize=2097152, vBaseEnvHwRegionType=ROM
            PFlash0_NonCached: vBaseEnvHwRegionStartAddress=2684354560, vBaseEnvHwRegionSize=2097152, vBaseEnvHwRegionType=ROM
            PFlash1_Cached: vBaseEnvHwRegionStartAddress=2150629376, vBaseEnvHwRegionSize=2097152, vBaseEnvHwRegionType=ROM
            PFlash1_NonCached: vBaseEnvHwRegionStartAddress=2687500288, vBaseEnvHwRegionSize=2097152, vBaseEnvHwRegionType=ROM
            LMU0_Cached: vBaseEnvHwRegionStartAddress=2415919104, vBaseEnvHwRegionSize=65536, vBaseEnvHwRegionType=RAM
            LMU0_NonCached: vBaseEnvHwRegionStartAddress=2952790016, vBaseEnvHwRegionSize=65536, vBaseEnvHwRegionType=RAM
            LMU1_Cached: vBaseEnvHwRegionStartAddress=2415984640, vBaseEnvHwRegionSize=65536, vBaseEnvHwRegionType=RAM
            LMU1_NonCached: vBaseEnvHwRegionStartAddress=2952855552, vBaseEnvHwRegionSize=65536, vBaseEnvHwRegionType=RAM
            BMHD0: vBaseEnvHwRegionStartAddress=2940207104, vBaseEnvHwRegionSize=512, vBaseEnvHwRegionType=ROM
            BMHD1: vBaseEnvHwRegionStartAddress=2940207616, vBaseEnvHwRegionSize=512, vBaseEnvHwRegionType=ROM
            BMHD2: vBaseEnvHwRegionStartAddress=2940208128, vBaseEnvHwRegionSize=512, vBaseEnvHwRegionType=ROM
            BMHD3: vBaseEnvHwRegionStartAddress=2940208640, vBaseEnvHwRegionSize=512, vBaseEnvHwRegionType=ROM
            OLDA_Cached: vBaseEnvHwRegionStartAddress=2413821952, vBaseEnvHwRegionSize=524288, vBaseEnvHwRegionType=RAM
            OLDA_NonCached: vBaseEnvHwRegionStartAddress=2950692864, vBaseEnvHwRegionSize=524288, vBaseEnvHwRegionType=RAM
            DLMU0_Cached: vBaseEnvHwRegionStartAddress=2415919104, vBaseEnvHwRegionSize=65536, vBaseEnvHwRegionType=RAM
            DLMU0_NonCached: vBaseEnvHwRegionStartAddress=2952790016, vBaseEnvHwRegionSize=65536, vBaseEnvHwRegionType=RAM
            DLMU1_Cached: vBaseEnvHwRegionStartAddress=2415984640, vBaseEnvHwRegionSize=65536, vBaseEnvHwRegionType=RAM
            DLMU1_NonCached: vBaseEnvHwRegionStartAddress=2952855552, vBaseEnvHwRegionSize=65536, vBaseEnvHwRegionType=RAM
            DFlash0: vBaseEnvHwRegionStartAddress=2936012800, vBaseEnvHwRegionSize=131072, vBaseEnvHwRegionType=ROM
            DFlash1: vBaseEnvHwRegionStartAddress=2948595712, vBaseEnvHwRegionSize=131072, vBaseEnvHwRegionType=ROM
        TC366D: vBaseEnvCpuCoreAmount=2, vBaseEnvCpuMaxFrequency=300000000, vBaseEnvTestedDerivative=TC36x, vBaseEnvTestedDerivativeDescription=Infineon Aurix 2G TC36x Family, vBaseEnvAvailableChannels_Can=8, vBaseEnvAvailableChannels_Ethernet=1, vBaseEnvAvailableChannels_Flexray=2, vBaseEnvAvailableChannels_Lin=12
          vBaseEnvAdditionalParameters: vBaseEnvWatchdogGroup=B, vBaseEnvPllGroup=B, vBaseEnvPortGroup=B, vBaseEnvResetGroup=B, vBaseEnvDerivativeGroup=TC3xx
          24 x vBaseEnvMemLayoutHwRegion:
            DSPR0: vBaseEnvHwRegionStartAddress=1879048192, vBaseEnvHwRegionSize=196608, vBaseEnvHwRegionType=RAM
            PSPR0: vBaseEnvHwRegionStartAddress=1880096768, vBaseEnvHwRegionSize=32768, vBaseEnvHwRegionType=RAM
            DSPR1: vBaseEnvHwRegionStartAddress=1610612736, vBaseEnvHwRegionSize=196608, vBaseEnvHwRegionType=RAM
            PSPR1: vBaseEnvHwRegionStartAddress=1611661312, vBaseEnvHwRegionSize=32768, vBaseEnvHwRegionType=RAM
            PFlash0_Cached: vBaseEnvHwRegionStartAddress=2147483648, vBaseEnvHwRegionSize=2097152, vBaseEnvHwRegionType=ROM
            PFlash0_NonCached: vBaseEnvHwRegionStartAddress=2684354560, vBaseEnvHwRegionSize=2097152, vBaseEnvHwRegionType=ROM
            PFlash1_Cached: vBaseEnvHwRegionStartAddress=2150629376, vBaseEnvHwRegionSize=2097152, vBaseEnvHwRegionType=ROM
            PFlash1_NonCached: vBaseEnvHwRegionStartAddress=2687500288, vBaseEnvHwRegionSize=2097152, vBaseEnvHwRegionType=ROM
            LMU0_Cached: vBaseEnvHwRegionStartAddress=2415919104, vBaseEnvHwRegionSize=65536, vBaseEnvHwRegionType=RAM
            LMU0_NonCached: vBaseEnvHwRegionStartAddress=2952790016, vBaseEnvHwRegionSize=65536, vBaseEnvHwRegionType=RAM
            LMU1_Cached: vBaseEnvHwRegionStartAddress=2415984640, vBaseEnvHwRegionSize=65536, vBaseEnvHwRegionType=RAM
            LMU1_NonCached: vBaseEnvHwRegionStartAddress=2952855552, vBaseEnvHwRegionSize=65536, vBaseEnvHwRegionType=RAM
            BMHD0: vBaseEnvHwRegionStartAddress=2940207104, vBaseEnvHwRegionSize=512, vBaseEnvHwRegionType=ROM
            BMHD1: vBaseEnvHwRegionStartAddress=2940207616, vBaseEnvHwRegionSize=512, vBaseEnvHwRegionType=ROM
            BMHD2: vBaseEnvHwRegionStartAddress=2940208128, vBaseEnvHwRegionSize=512, vBaseEnvHwRegionType=ROM
            BMHD3: vBaseEnvHwRegionStartAddress=2940208640, vBaseEnvHwRegionSize=512, vBaseEnvHwRegionType=ROM
            OLDA_Cached: vBaseEnvHwRegionStartAddress=2413821952, vBaseEnvHwRegionSize=524288, vBaseEnvHwRegionType=RAM
            OLDA_NonCached: vBaseEnvHwRegionStartAddress=2950692864, vBaseEnvHwRegionSize=524288, vBaseEnvHwRegionType=RAM
            DLMU0_Cached: vBaseEnvHwRegionStartAddress=2415919104, vBaseEnvHwRegionSize=65536, vBaseEnvHwRegionType=RAM
            DLMU0_NonCached: vBaseEnvHwRegionStartAddress=2952790016, vBaseEnvHwRegionSize=65536, vBaseEnvHwRegionType=RAM
            DLMU1_Cached: vBaseEnvHwRegionStartAddress=2415984640, vBaseEnvHwRegionSize=65536, vBaseEnvHwRegionType=RAM
            DLMU1_NonCached: vBaseEnvHwRegionStartAddress=2952855552, vBaseEnvHwRegionSize=65536, vBaseEnvHwRegionType=RAM
            DFlash0: vBaseEnvHwRegionStartAddress=2936012800, vBaseEnvHwRegionSize=131072, vBaseEnvHwRegionType=ROM
            DFlash1: vBaseEnvHwRegionStartAddress=2948595712, vBaseEnvHwRegionSize=131072, vBaseEnvHwRegionType=ROM
        TC367D: vBaseEnvCpuCoreAmount=2, vBaseEnvCpuMaxFrequency=300000000, vBaseEnvTestedDerivative=TC36x, vBaseEnvTestedDerivativeDescription=Infineon Aurix 2G TC36x Family, vBaseEnvAvailableChannels_Can=8, vBaseEnvAvailableChannels_Ethernet=1, vBaseEnvAvailableChannels_Flexray=2, vBaseEnvAvailableChannels_Lin=12
          vBaseEnvAdditionalParameters: vBaseEnvWatchdogGroup=B, vBaseEnvPllGroup=B, vBaseEnvPortGroup=B, vBaseEnvResetGroup=B, vBaseEnvDerivativeGroup=TC3xx
          24 x vBaseEnvMemLayoutHwRegion:
            DSPR0: vBaseEnvHwRegionStartAddress=1879048192, vBaseEnvHwRegionSize=196608, vBaseEnvHwRegionType=RAM
            PSPR0: vBaseEnvHwRegionStartAddress=1880096768, vBaseEnvHwRegionSize=32768, vBaseEnvHwRegionType=RAM
            DSPR1: vBaseEnvHwRegionStartAddress=1610612736, vBaseEnvHwRegionSize=196608, vBaseEnvHwRegionType=RAM
            PSPR1: vBaseEnvHwRegionStartAddress=1611661312, vBaseEnvHwRegionSize=32768, vBaseEnvHwRegionType=RAM
            PFlash0_Cached: vBaseEnvHwRegionStartAddress=2147483648, vBaseEnvHwRegionSize=2097152, vBaseEnvHwRegionType=ROM
            PFlash0_NonCached: vBaseEnvHwRegionStartAddress=2684354560, vBaseEnvHwRegionSize=2097152, vBaseEnvHwRegionType=ROM
            PFlash1_Cached: vBaseEnvHwRegionStartAddress=2150629376, vBaseEnvHwRegionSize=2097152, vBaseEnvHwRegionType=ROM
            PFlash1_NonCached: vBaseEnvHwRegionStartAddress=2687500288, vBaseEnvHwRegionSize=2097152, vBaseEnvHwRegionType=ROM
            LMU0_Cached: vBaseEnvHwRegionStartAddress=2415919104, vBaseEnvHwRegionSize=65536, vBaseEnvHwRegionType=RAM
            LMU0_NonCached: vBaseEnvHwRegionStartAddress=2952790016, vBaseEnvHwRegionSize=65536, vBaseEnvHwRegionType=RAM
            LMU1_Cached: vBaseEnvHwRegionStartAddress=2415984640, vBaseEnvHwRegionSize=65536, vBaseEnvHwRegionType=RAM
            LMU1_NonCached: vBaseEnvHwRegionStartAddress=2952855552, vBaseEnvHwRegionSize=65536, vBaseEnvHwRegionType=RAM
            BMHD0: vBaseEnvHwRegionStartAddress=2940207104, vBaseEnvHwRegionSize=512, vBaseEnvHwRegionType=ROM
            BMHD1: vBaseEnvHwRegionStartAddress=2940207616, vBaseEnvHwRegionSize=512, vBaseEnvHwRegionType=ROM
            BMHD2: vBaseEnvHwRegionStartAddress=2940208128, vBaseEnvHwRegionSize=512, vBaseEnvHwRegionType=ROM
            BMHD3: vBaseEnvHwRegionStartAddress=2940208640, vBaseEnvHwRegionSize=512, vBaseEnvHwRegionType=ROM
            OLDA_Cached: vBaseEnvHwRegionStartAddress=2413821952, vBaseEnvHwRegionSize=524288, vBaseEnvHwRegionType=RAM
            OLDA_NonCached: vBaseEnvHwRegionStartAddress=2950692864, vBaseEnvHwRegionSize=524288, vBaseEnvHwRegionType=RAM
            DLMU0_Cached: vBaseEnvHwRegionStartAddress=2415919104, vBaseEnvHwRegionSize=65536, vBaseEnvHwRegionType=RAM
            DLMU0_NonCached: vBaseEnvHwRegionStartAddress=2952790016, vBaseEnvHwRegionSize=65536, vBaseEnvHwRegionType=RAM
            DLMU1_Cached: vBaseEnvHwRegionStartAddress=2415984640, vBaseEnvHwRegionSize=65536, vBaseEnvHwRegionType=RAM
            DLMU1_NonCached: vBaseEnvHwRegionStartAddress=2952855552, vBaseEnvHwRegionSize=65536, vBaseEnvHwRegionType=RAM
            DFlash0: vBaseEnvHwRegionStartAddress=2936012800, vBaseEnvHwRegionSize=131072, vBaseEnvHwRegionType=ROM
            DFlash1: vBaseEnvHwRegionStartAddress=2948595712, vBaseEnvHwRegionSize=131072, vBaseEnvHwRegionType=ROM
        TC370T: vBaseEnvCpuCoreAmount=3, vBaseEnvCpuMaxFrequency=300000000, vBaseEnvTestedDerivative=TC37x, vBaseEnvTestedDerivativeDescription=Infineon Aurix 2G TC37x Family, vBaseEnvAvailableChannels_Can=8, vBaseEnvAvailableChannels_Ethernet=1, vBaseEnvAvailableChannels_Flexray=2, vBaseEnvAvailableChannels_Lin=12
          vBaseEnvAdditionalParameters: vBaseEnvWatchdogGroup=B, vBaseEnvPllGroup=B, vBaseEnvPortGroup=B, vBaseEnvResetGroup=B, vBaseEnvDerivativeGroup=TC3xx
          26 x vBaseEnvMemLayoutHwRegion:
            DSPR0: vBaseEnvHwRegionStartAddress=1879048192, vBaseEnvHwRegionSize=245760, vBaseEnvHwRegionType=RAM
            PSPR0: vBaseEnvHwRegionStartAddress=1880096768, vBaseEnvHwRegionSize=65536, vBaseEnvHwRegionType=RAM
            DSPR1: vBaseEnvHwRegionStartAddress=1610612736, vBaseEnvHwRegionSize=245760, vBaseEnvHwRegionType=RAM
            PSPR1: vBaseEnvHwRegionStartAddress=1611661312, vBaseEnvHwRegionSize=65536, vBaseEnvHwRegionType=RAM
            DSPR2: vBaseEnvHwRegionStartAddress=1342177280, vBaseEnvHwRegionSize=98304, vBaseEnvHwRegionType=RAM
            PSPR2: vBaseEnvHwRegionStartAddress=1343225856, vBaseEnvHwRegionSize=65536, vBaseEnvHwRegionType=RAM
            PFlash0_Cached: vBaseEnvHwRegionStartAddress=2147483648, vBaseEnvHwRegionSize=3145728, vBaseEnvHwRegionType=ROM
            PFlash0_NonCached: vBaseEnvHwRegionStartAddress=2684354560, vBaseEnvHwRegionSize=3145728, vBaseEnvHwRegionType=ROM
            PFlash1_Cached: vBaseEnvHwRegionStartAddress=2150629376, vBaseEnvHwRegionSize=3145728, vBaseEnvHwRegionType=ROM
            PFlash1_NonCached: vBaseEnvHwRegionStartAddress=2687500288, vBaseEnvHwRegionSize=3145728, vBaseEnvHwRegionType=ROM
            BMHD0: vBaseEnvHwRegionStartAddress=2940207104, vBaseEnvHwRegionSize=512, vBaseEnvHwRegionType=ROM
            BMHD1: vBaseEnvHwRegionStartAddress=2940207616, vBaseEnvHwRegionSize=512, vBaseEnvHwRegionType=ROM
            BMHD2: vBaseEnvHwRegionStartAddress=2940208128, vBaseEnvHwRegionSize=512, vBaseEnvHwRegionType=ROM
            BMHD3: vBaseEnvHwRegionStartAddress=2940208640, vBaseEnvHwRegionSize=512, vBaseEnvHwRegionType=ROM
            OLDA_Cached: vBaseEnvHwRegionStartAddress=2413821952, vBaseEnvHwRegionSize=524288, vBaseEnvHwRegionType=RAM
            OLDA_NonCached: vBaseEnvHwRegionStartAddress=2950692864, vBaseEnvHwRegionSize=524288, vBaseEnvHwRegionType=RAM
            DLMU0_Cached: vBaseEnvHwRegionStartAddress=2415919104, vBaseEnvHwRegionSize=65536, vBaseEnvHwRegionType=RAM
            DLMU0_NonCached: vBaseEnvHwRegionStartAddress=2952790016, vBaseEnvHwRegionSize=65536, vBaseEnvHwRegionType=RAM
            DLMU1_Cached: vBaseEnvHwRegionStartAddress=2415984640, vBaseEnvHwRegionSize=65536, vBaseEnvHwRegionType=RAM
            DLMU1_NonCached: vBaseEnvHwRegionStartAddress=2952855552, vBaseEnvHwRegionSize=65536, vBaseEnvHwRegionType=RAM
            DLMU2_Cached: vBaseEnvHwRegionStartAddress=2416050176, vBaseEnvHwRegionSize=65536, vBaseEnvHwRegionType=RAM
            DLMU2_NonCached: vBaseEnvHwRegionStartAddress=2952921088, vBaseEnvHwRegionSize=65536, vBaseEnvHwRegionType=RAM
            DAM0_Cached: vBaseEnvHwRegionStartAddress=2420113408, vBaseEnvHwRegionSize=32768, vBaseEnvHwRegionType=RAM
            DAM0_NonCached: vBaseEnvHwRegionStartAddress=2956984320, vBaseEnvHwRegionSize=32768, vBaseEnvHwRegionType=RAM
            DFlash0: vBaseEnvHwRegionStartAddress=2936012800, vBaseEnvHwRegionSize=131072, vBaseEnvHwRegionType=ROM
            DFlash1: vBaseEnvHwRegionStartAddress=2948595712, vBaseEnvHwRegionSize=131072, vBaseEnvHwRegionType=ROM
        TC374T: vBaseEnvCpuCoreAmount=3, vBaseEnvCpuMaxFrequency=300000000, vBaseEnvTestedDerivative=TC37x, vBaseEnvTestedDerivativeDescription=Infineon Aurix 2G TC37x Family, vBaseEnvAvailableChannels_Can=12, vBaseEnvAvailableChannels_Ethernet=2, vBaseEnvAvailableChannels_Flexray=2, vBaseEnvAvailableChannels_Lin=12
          vBaseEnvAdditionalParameters: vBaseEnvWatchdogGroup=B, vBaseEnvPllGroup=B, vBaseEnvPortGroup=B, vBaseEnvResetGroup=B, vBaseEnvDerivativeGroup=TC3xx
          26 x vBaseEnvMemLayoutHwRegion:
            DSPR0: vBaseEnvHwRegionStartAddress=1879048192, vBaseEnvHwRegionSize=245760, vBaseEnvHwRegionType=RAM
            PSPR0: vBaseEnvHwRegionStartAddress=1880096768, vBaseEnvHwRegionSize=65536, vBaseEnvHwRegionType=RAM
            DSPR1: vBaseEnvHwRegionStartAddress=1610612736, vBaseEnvHwRegionSize=245760, vBaseEnvHwRegionType=RAM
            PSPR1: vBaseEnvHwRegionStartAddress=1611661312, vBaseEnvHwRegionSize=65536, vBaseEnvHwRegionType=RAM
            DSPR2: vBaseEnvHwRegionStartAddress=1342177280, vBaseEnvHwRegionSize=98304, vBaseEnvHwRegionType=RAM
            PSPR2: vBaseEnvHwRegionStartAddress=1343225856, vBaseEnvHwRegionSize=65536, vBaseEnvHwRegionType=RAM
            PFlash0_Cached: vBaseEnvHwRegionStartAddress=2147483648, vBaseEnvHwRegionSize=3145728, vBaseEnvHwRegionType=ROM
            PFlash0_NonCached: vBaseEnvHwRegionStartAddress=2684354560, vBaseEnvHwRegionSize=3145728, vBaseEnvHwRegionType=ROM
            PFlash1_Cached: vBaseEnvHwRegionStartAddress=2150629376, vBaseEnvHwRegionSize=3145728, vBaseEnvHwRegionType=ROM
            PFlash1_NonCached: vBaseEnvHwRegionStartAddress=2687500288, vBaseEnvHwRegionSize=3145728, vBaseEnvHwRegionType=ROM
            BMHD0: vBaseEnvHwRegionStartAddress=2940207104, vBaseEnvHwRegionSize=512, vBaseEnvHwRegionType=ROM
            BMHD1: vBaseEnvHwRegionStartAddress=2940207616, vBaseEnvHwRegionSize=512, vBaseEnvHwRegionType=ROM
            BMHD2: vBaseEnvHwRegionStartAddress=2940208128, vBaseEnvHwRegionSize=512, vBaseEnvHwRegionType=ROM
            BMHD3: vBaseEnvHwRegionStartAddress=2940208640, vBaseEnvHwRegionSize=512, vBaseEnvHwRegionType=ROM
            OLDA_Cached: vBaseEnvHwRegionStartAddress=2413821952, vBaseEnvHwRegionSize=524288, vBaseEnvHwRegionType=RAM
            OLDA_NonCached: vBaseEnvHwRegionStartAddress=2950692864, vBaseEnvHwRegionSize=524288, vBaseEnvHwRegionType=RAM
            DLMU0_Cached: vBaseEnvHwRegionStartAddress=2415919104, vBaseEnvHwRegionSize=65536, vBaseEnvHwRegionType=RAM
            DLMU0_NonCached: vBaseEnvHwRegionStartAddress=2952790016, vBaseEnvHwRegionSize=65536, vBaseEnvHwRegionType=RAM
            DLMU1_Cached: vBaseEnvHwRegionStartAddress=2415984640, vBaseEnvHwRegionSize=65536, vBaseEnvHwRegionType=RAM
            DLMU1_NonCached: vBaseEnvHwRegionStartAddress=2952855552, vBaseEnvHwRegionSize=65536, vBaseEnvHwRegionType=RAM
            DLMU2_Cached: vBaseEnvHwRegionStartAddress=2416050176, vBaseEnvHwRegionSize=65536, vBaseEnvHwRegionType=RAM
            DLMU2_NonCached: vBaseEnvHwRegionStartAddress=2952921088, vBaseEnvHwRegionSize=65536, vBaseEnvHwRegionType=RAM
            DAM0_Cached: vBaseEnvHwRegionStartAddress=2420113408, vBaseEnvHwRegionSize=32768, vBaseEnvHwRegionType=RAM
            DAM0_NonCached: vBaseEnvHwRegionStartAddress=2956984320, vBaseEnvHwRegionSize=32768, vBaseEnvHwRegionType=RAM
            DFlash0: vBaseEnvHwRegionStartAddress=2936012800, vBaseEnvHwRegionSize=131072, vBaseEnvHwRegionType=ROM
            DFlash1: vBaseEnvHwRegionStartAddress=2948595712, vBaseEnvHwRegionSize=131072, vBaseEnvHwRegionType=ROM
        TC375D: vBaseEnvCpuCoreAmount=2, vBaseEnvCpuMaxFrequency=300000000, vBaseEnvTestedDerivative=TC37x, vBaseEnvTestedDerivativeDescription=Infineon Aurix 2G TC37x Family, vBaseEnvAvailableChannels_Can=8, vBaseEnvAvailableChannels_Ethernet=1, vBaseEnvAvailableChannels_Flexray=2, vBaseEnvAvailableChannels_Lin=12
          vBaseEnvAdditionalParameters: vBaseEnvWatchdogGroup=B, vBaseEnvPllGroup=B, vBaseEnvPortGroup=B, vBaseEnvResetGroup=B, vBaseEnvDerivativeGroup=TC3xx
          22 x vBaseEnvMemLayoutHwRegion:
            DSPR0: vBaseEnvHwRegionStartAddress=1879048192, vBaseEnvHwRegionSize=245760, vBaseEnvHwRegionType=RAM
            PSPR0: vBaseEnvHwRegionStartAddress=1880096768, vBaseEnvHwRegionSize=65536, vBaseEnvHwRegionType=RAM
            DSPR1: vBaseEnvHwRegionStartAddress=1610612736, vBaseEnvHwRegionSize=245760, vBaseEnvHwRegionType=RAM
            PSPR1: vBaseEnvHwRegionStartAddress=1611661312, vBaseEnvHwRegionSize=65536, vBaseEnvHwRegionType=RAM
            PFlash0_Cached: vBaseEnvHwRegionStartAddress=2147483648, vBaseEnvHwRegionSize=3145728, vBaseEnvHwRegionType=ROM
            PFlash0_NonCached: vBaseEnvHwRegionStartAddress=2684354560, vBaseEnvHwRegionSize=3145728, vBaseEnvHwRegionType=ROM
            PFlash1_Cached: vBaseEnvHwRegionStartAddress=2150629376, vBaseEnvHwRegionSize=3145728, vBaseEnvHwRegionType=ROM
            PFlash1_NonCached: vBaseEnvHwRegionStartAddress=2687500288, vBaseEnvHwRegionSize=3145728, vBaseEnvHwRegionType=ROM
            BMHD0: vBaseEnvHwRegionStartAddress=2940207104, vBaseEnvHwRegionSize=512, vBaseEnvHwRegionType=ROM
            BMHD1: vBaseEnvHwRegionStartAddress=2940207616, vBaseEnvHwRegionSize=512, vBaseEnvHwRegionType=ROM
            BMHD2: vBaseEnvHwRegionStartAddress=2940208128, vBaseEnvHwRegionSize=512, vBaseEnvHwRegionType=ROM
            BMHD3: vBaseEnvHwRegionStartAddress=2940208640, vBaseEnvHwRegionSize=512, vBaseEnvHwRegionType=ROM
            OLDA_Cached: vBaseEnvHwRegionStartAddress=2413821952, vBaseEnvHwRegionSize=524288, vBaseEnvHwRegionType=RAM
            OLDA_NonCached: vBaseEnvHwRegionStartAddress=2950692864, vBaseEnvHwRegionSize=524288, vBaseEnvHwRegionType=RAM
            DLMU0_Cached: vBaseEnvHwRegionStartAddress=2415919104, vBaseEnvHwRegionSize=65536, vBaseEnvHwRegionType=RAM
            DLMU0_NonCached: vBaseEnvHwRegionStartAddress=2952790016, vBaseEnvHwRegionSize=65536, vBaseEnvHwRegionType=RAM
            DLMU1_Cached: vBaseEnvHwRegionStartAddress=2415984640, vBaseEnvHwRegionSize=65536, vBaseEnvHwRegionType=RAM
            DLMU1_NonCached: vBaseEnvHwRegionStartAddress=2952855552, vBaseEnvHwRegionSize=65536, vBaseEnvHwRegionType=RAM
            DAM0_Cached: vBaseEnvHwRegionStartAddress=2420113408, vBaseEnvHwRegionSize=32768, vBaseEnvHwRegionType=RAM
            DAM0_NonCached: vBaseEnvHwRegionStartAddress=2956984320, vBaseEnvHwRegionSize=32768, vBaseEnvHwRegionType=RAM
            DFlash0: vBaseEnvHwRegionStartAddress=2936012800, vBaseEnvHwRegionSize=131072, vBaseEnvHwRegionType=ROM
            DFlash1: vBaseEnvHwRegionStartAddress=2948595712, vBaseEnvHwRegionSize=131072, vBaseEnvHwRegionType=ROM
        TC375T: vBaseEnvCpuCoreAmount=3, vBaseEnvCpuMaxFrequency=300000000, vBaseEnvTestedDerivative=TC37x, vBaseEnvTestedDerivativeDescription=Infineon Aurix 2G TC37x Family, vBaseEnvAvailableChannels_Can=12, vBaseEnvAvailableChannels_Ethernet=2, vBaseEnvAvailableChannels_Flexray=2, vBaseEnvAvailableChannels_Lin=12
          vBaseEnvAdditionalParameters: vBaseEnvWatchdogGroup=B, vBaseEnvPllGroup=B, vBaseEnvPortGroup=B, vBaseEnvResetGroup=B, vBaseEnvDerivativeGroup=TC3xx
          26 x vBaseEnvMemLayoutHwRegion:
            DSPR0: vBaseEnvHwRegionStartAddress=1879048192, vBaseEnvHwRegionSize=245760, vBaseEnvHwRegionType=RAM
            PSPR0: vBaseEnvHwRegionStartAddress=1880096768, vBaseEnvHwRegionSize=65536, vBaseEnvHwRegionType=RAM
            DSPR1: vBaseEnvHwRegionStartAddress=1610612736, vBaseEnvHwRegionSize=245760, vBaseEnvHwRegionType=RAM
            PSPR1: vBaseEnvHwRegionStartAddress=1611661312, vBaseEnvHwRegionSize=65536, vBaseEnvHwRegionType=RAM
            DSPR2: vBaseEnvHwRegionStartAddress=1342177280, vBaseEnvHwRegionSize=98304, vBaseEnvHwRegionType=RAM
            PSPR2: vBaseEnvHwRegionStartAddress=1343225856, vBaseEnvHwRegionSize=65536, vBaseEnvHwRegionType=RAM
            PFlash0_Cached: vBaseEnvHwRegionStartAddress=2147483648, vBaseEnvHwRegionSize=3145728, vBaseEnvHwRegionType=ROM
            PFlash0_NonCached: vBaseEnvHwRegionStartAddress=2684354560, vBaseEnvHwRegionSize=3145728, vBaseEnvHwRegionType=ROM
            PFlash1_Cached: vBaseEnvHwRegionStartAddress=2150629376, vBaseEnvHwRegionSize=3145728, vBaseEnvHwRegionType=ROM
            PFlash1_NonCached: vBaseEnvHwRegionStartAddress=2687500288, vBaseEnvHwRegionSize=3145728, vBaseEnvHwRegionType=ROM
            BMHD0: vBaseEnvHwRegionStartAddress=2940207104, vBaseEnvHwRegionSize=512, vBaseEnvHwRegionType=ROM
            BMHD1: vBaseEnvHwRegionStartAddress=2940207616, vBaseEnvHwRegionSize=512, vBaseEnvHwRegionType=ROM
            BMHD2: vBaseEnvHwRegionStartAddress=2940208128, vBaseEnvHwRegionSize=512, vBaseEnvHwRegionType=ROM
            BMHD3: vBaseEnvHwRegionStartAddress=2940208640, vBaseEnvHwRegionSize=512, vBaseEnvHwRegionType=ROM
            OLDA_Cached: vBaseEnvHwRegionStartAddress=2413821952, vBaseEnvHwRegionSize=524288, vBaseEnvHwRegionType=RAM
            OLDA_NonCached: vBaseEnvHwRegionStartAddress=2950692864, vBaseEnvHwRegionSize=524288, vBaseEnvHwRegionType=RAM
            DLMU0_Cached: vBaseEnvHwRegionStartAddress=2415919104, vBaseEnvHwRegionSize=65536, vBaseEnvHwRegionType=RAM
            DLMU0_NonCached: vBaseEnvHwRegionStartAddress=2952790016, vBaseEnvHwRegionSize=65536, vBaseEnvHwRegionType=RAM
            DLMU1_Cached: vBaseEnvHwRegionStartAddress=2415984640, vBaseEnvHwRegionSize=65536, vBaseEnvHwRegionType=RAM
            DLMU1_NonCached: vBaseEnvHwRegionStartAddress=2952855552, vBaseEnvHwRegionSize=65536, vBaseEnvHwRegionType=RAM
            DLMU2_Cached: vBaseEnvHwRegionStartAddress=2416050176, vBaseEnvHwRegionSize=65536, vBaseEnvHwRegionType=RAM
            DLMU2_NonCached: vBaseEnvHwRegionStartAddress=2952921088, vBaseEnvHwRegionSize=65536, vBaseEnvHwRegionType=RAM
            DAM0_Cached: vBaseEnvHwRegionStartAddress=2420113408, vBaseEnvHwRegionSize=32768, vBaseEnvHwRegionType=RAM
            DAM0_NonCached: vBaseEnvHwRegionStartAddress=2956984320, vBaseEnvHwRegionSize=32768, vBaseEnvHwRegionType=RAM
            DFlash0: vBaseEnvHwRegionStartAddress=2936012800, vBaseEnvHwRegionSize=131072, vBaseEnvHwRegionType=ROM
            DFlash1: vBaseEnvHwRegionStartAddress=2948595712, vBaseEnvHwRegionSize=131072, vBaseEnvHwRegionType=ROM
        TC377D: vBaseEnvCpuCoreAmount=2, vBaseEnvCpuMaxFrequency=300000000, vBaseEnvTestedDerivative=TC37x, vBaseEnvTestedDerivativeDescription=Infineon Aurix 2G TC37x Family, vBaseEnvAvailableChannels_Can=8, vBaseEnvAvailableChannels_Ethernet=1, vBaseEnvAvailableChannels_Flexray=2, vBaseEnvAvailableChannels_Lin=12
          vBaseEnvAdditionalParameters: vBaseEnvWatchdogGroup=B, vBaseEnvPllGroup=B, vBaseEnvPortGroup=B, vBaseEnvResetGroup=B, vBaseEnvDerivativeGroup=TC3xx
          22 x vBaseEnvMemLayoutHwRegion:
            DSPR0: vBaseEnvHwRegionStartAddress=1879048192, vBaseEnvHwRegionSize=245760, vBaseEnvHwRegionType=RAM
            PSPR0: vBaseEnvHwRegionStartAddress=1880096768, vBaseEnvHwRegionSize=65536, vBaseEnvHwRegionType=RAM
            DSPR1: vBaseEnvHwRegionStartAddress=1610612736, vBaseEnvHwRegionSize=245760, vBaseEnvHwRegionType=RAM
            PSPR1: vBaseEnvHwRegionStartAddress=1611661312, vBaseEnvHwRegionSize=65536, vBaseEnvHwRegionType=RAM
            PFlash0_Cached: vBaseEnvHwRegionStartAddress=2147483648, vBaseEnvHwRegionSize=3145728, vBaseEnvHwRegionType=ROM
            PFlash0_NonCached: vBaseEnvHwRegionStartAddress=2684354560, vBaseEnvHwRegionSize=3145728, vBaseEnvHwRegionType=ROM
            PFlash1_Cached: vBaseEnvHwRegionStartAddress=2150629376, vBaseEnvHwRegionSize=3145728, vBaseEnvHwRegionType=ROM
            PFlash1_NonCached: vBaseEnvHwRegionStartAddress=2687500288, vBaseEnvHwRegionSize=3145728, vBaseEnvHwRegionType=ROM
            BMHD0: vBaseEnvHwRegionStartAddress=2940207104, vBaseEnvHwRegionSize=512, vBaseEnvHwRegionType=ROM
            BMHD1: vBaseEnvHwRegionStartAddress=2940207616, vBaseEnvHwRegionSize=512, vBaseEnvHwRegionType=ROM
            BMHD2: vBaseEnvHwRegionStartAddress=2940208128, vBaseEnvHwRegionSize=512, vBaseEnvHwRegionType=ROM
            BMHD3: vBaseEnvHwRegionStartAddress=2940208640, vBaseEnvHwRegionSize=512, vBaseEnvHwRegionType=ROM
            OLDA_Cached: vBaseEnvHwRegionStartAddress=2413821952, vBaseEnvHwRegionSize=524288, vBaseEnvHwRegionType=RAM
            OLDA_NonCached: vBaseEnvHwRegionStartAddress=2950692864, vBaseEnvHwRegionSize=524288, vBaseEnvHwRegionType=RAM
            DLMU0_Cached: vBaseEnvHwRegionStartAddress=2415919104, vBaseEnvHwRegionSize=65536, vBaseEnvHwRegionType=RAM
            DLMU0_NonCached: vBaseEnvHwRegionStartAddress=2952790016, vBaseEnvHwRegionSize=65536, vBaseEnvHwRegionType=RAM
            DLMU1_Cached: vBaseEnvHwRegionStartAddress=2415984640, vBaseEnvHwRegionSize=65536, vBaseEnvHwRegionType=RAM
            DLMU1_NonCached: vBaseEnvHwRegionStartAddress=2952855552, vBaseEnvHwRegionSize=65536, vBaseEnvHwRegionType=RAM
            DAM0_Cached: vBaseEnvHwRegionStartAddress=2420113408, vBaseEnvHwRegionSize=32768, vBaseEnvHwRegionType=RAM
            DAM0_NonCached: vBaseEnvHwRegionStartAddress=2956984320, vBaseEnvHwRegionSize=32768, vBaseEnvHwRegionType=RAM
            DFlash0: vBaseEnvHwRegionStartAddress=2936012800, vBaseEnvHwRegionSize=131072, vBaseEnvHwRegionType=ROM
            DFlash1: vBaseEnvHwRegionStartAddress=2948595712, vBaseEnvHwRegionSize=131072, vBaseEnvHwRegionType=ROM
        TC377T: vBaseEnvCpuCoreAmount=3, vBaseEnvCpuMaxFrequency=300000000, vBaseEnvTestedDerivative=TC37x, vBaseEnvTestedDerivativeDescription=Infineon Aurix 2G TC37x Family, vBaseEnvAvailableChannels_Can=12, vBaseEnvAvailableChannels_Ethernet=2, vBaseEnvAvailableChannels_Flexray=2, vBaseEnvAvailableChannels_Lin=12
          vBaseEnvAdditionalParameters: vBaseEnvWatchdogGroup=B, vBaseEnvPllGroup=B, vBaseEnvPortGroup=B, vBaseEnvResetGroup=B, vBaseEnvDerivativeGroup=TC3xx
          26 x vBaseEnvMemLayoutHwRegion:
            DSPR0: vBaseEnvHwRegionStartAddress=1879048192, vBaseEnvHwRegionSize=245760, vBaseEnvHwRegionType=RAM
            PSPR0: vBaseEnvHwRegionStartAddress=1880096768, vBaseEnvHwRegionSize=65536, vBaseEnvHwRegionType=RAM
            DSPR1: vBaseEnvHwRegionStartAddress=1610612736, vBaseEnvHwRegionSize=245760, vBaseEnvHwRegionType=RAM
            PSPR1: vBaseEnvHwRegionStartAddress=1611661312, vBaseEnvHwRegionSize=65536, vBaseEnvHwRegionType=RAM
            DSPR2: vBaseEnvHwRegionStartAddress=1342177280, vBaseEnvHwRegionSize=98304, vBaseEnvHwRegionType=RAM
            PSPR2: vBaseEnvHwRegionStartAddress=1343225856, vBaseEnvHwRegionSize=65536, vBaseEnvHwRegionType=RAM
            PFlash0_Cached: vBaseEnvHwRegionStartAddress=2147483648, vBaseEnvHwRegionSize=3145728, vBaseEnvHwRegionType=ROM
            PFlash0_NonCached: vBaseEnvHwRegionStartAddress=2684354560, vBaseEnvHwRegionSize=3145728, vBaseEnvHwRegionType=ROM
            PFlash1_Cached: vBaseEnvHwRegionStartAddress=2150629376, vBaseEnvHwRegionSize=3145728, vBaseEnvHwRegionType=ROM
            PFlash1_NonCached: vBaseEnvHwRegionStartAddress=2687500288, vBaseEnvHwRegionSize=3145728, vBaseEnvHwRegionType=ROM
            BMHD0: vBaseEnvHwRegionStartAddress=2940207104, vBaseEnvHwRegionSize=512, vBaseEnvHwRegionType=ROM
            BMHD1: vBaseEnvHwRegionStartAddress=2940207616, vBaseEnvHwRegionSize=512, vBaseEnvHwRegionType=ROM
            BMHD2: vBaseEnvHwRegionStartAddress=2940208128, vBaseEnvHwRegionSize=512, vBaseEnvHwRegionType=ROM
            BMHD3: vBaseEnvHwRegionStartAddress=2940208640, vBaseEnvHwRegionSize=512, vBaseEnvHwRegionType=ROM
            OLDA_Cached: vBaseEnvHwRegionStartAddress=2413821952, vBaseEnvHwRegionSize=524288, vBaseEnvHwRegionType=RAM
            OLDA_NonCached: vBaseEnvHwRegionStartAddress=2950692864, vBaseEnvHwRegionSize=524288, vBaseEnvHwRegionType=RAM
            DLMU0_Cached: vBaseEnvHwRegionStartAddress=2415919104, vBaseEnvHwRegionSize=65536, vBaseEnvHwRegionType=RAM
            DLMU0_NonCached: vBaseEnvHwRegionStartAddress=2952790016, vBaseEnvHwRegionSize=65536, vBaseEnvHwRegionType=RAM
            DLMU1_Cached: vBaseEnvHwRegionStartAddress=2415984640, vBaseEnvHwRegionSize=65536, vBaseEnvHwRegionType=RAM
            DLMU1_NonCached: vBaseEnvHwRegionStartAddress=2952855552, vBaseEnvHwRegionSize=65536, vBaseEnvHwRegionType=RAM
            DLMU2_Cached: vBaseEnvHwRegionStartAddress=2416050176, vBaseEnvHwRegionSize=65536, vBaseEnvHwRegionType=RAM
            DLMU2_NonCached: vBaseEnvHwRegionStartAddress=2952921088, vBaseEnvHwRegionSize=65536, vBaseEnvHwRegionType=RAM
            DAM0_Cached: vBaseEnvHwRegionStartAddress=2420113408, vBaseEnvHwRegionSize=32768, vBaseEnvHwRegionType=RAM
            DAM0_NonCached: vBaseEnvHwRegionStartAddress=2956984320, vBaseEnvHwRegionSize=32768, vBaseEnvHwRegionType=RAM
            DFlash0: vBaseEnvHwRegionStartAddress=2936012800, vBaseEnvHwRegionSize=131072, vBaseEnvHwRegionType=ROM
            DFlash1: vBaseEnvHwRegionStartAddress=2948595712, vBaseEnvHwRegionSize=131072, vBaseEnvHwRegionType=ROM
        TC377V: vBaseEnvCpuCoreAmount=3, vBaseEnvCpuMaxFrequency=300000000, vBaseEnvTestedDerivative=TC37x, vBaseEnvTestedDerivativeDescription=Infineon Aurix 2G TC37x Family, vBaseEnvAvailableChannels_Can=8, vBaseEnvAvailableChannels_Ethernet=1, vBaseEnvAvailableChannels_Flexray=2, vBaseEnvAvailableChannels_Lin=12
          vBaseEnvAdditionalParameters: vBaseEnvWatchdogGroup=B, vBaseEnvPllGroup=B, vBaseEnvPortGroup=B, vBaseEnvResetGroup=B, vBaseEnvDerivativeGroup=TC3xx
          26 x vBaseEnvMemLayoutHwRegion:
            DSPR0: vBaseEnvHwRegionStartAddress=1879048192, vBaseEnvHwRegionSize=245760, vBaseEnvHwRegionType=RAM
            PSPR0: vBaseEnvHwRegionStartAddress=1880096768, vBaseEnvHwRegionSize=65536, vBaseEnvHwRegionType=RAM
            DSPR1: vBaseEnvHwRegionStartAddress=1610612736, vBaseEnvHwRegionSize=245760, vBaseEnvHwRegionType=RAM
            PSPR1: vBaseEnvHwRegionStartAddress=1611661312, vBaseEnvHwRegionSize=65536, vBaseEnvHwRegionType=RAM
            DSPR2: vBaseEnvHwRegionStartAddress=1342177280, vBaseEnvHwRegionSize=98304, vBaseEnvHwRegionType=RAM
            PSPR2: vBaseEnvHwRegionStartAddress=1343225856, vBaseEnvHwRegionSize=65536, vBaseEnvHwRegionType=RAM
            PFlash0_Cached: vBaseEnvHwRegionStartAddress=2147483648, vBaseEnvHwRegionSize=3145728, vBaseEnvHwRegionType=ROM
            PFlash0_NonCached: vBaseEnvHwRegionStartAddress=2684354560, vBaseEnvHwRegionSize=3145728, vBaseEnvHwRegionType=ROM
            PFlash1_Cached: vBaseEnvHwRegionStartAddress=2150629376, vBaseEnvHwRegionSize=3145728, vBaseEnvHwRegionType=ROM
            PFlash1_NonCached: vBaseEnvHwRegionStartAddress=2687500288, vBaseEnvHwRegionSize=3145728, vBaseEnvHwRegionType=ROM
            BMHD0: vBaseEnvHwRegionStartAddress=2940207104, vBaseEnvHwRegionSize=512, vBaseEnvHwRegionType=ROM
            BMHD1: vBaseEnvHwRegionStartAddress=2940207616, vBaseEnvHwRegionSize=512, vBaseEnvHwRegionType=ROM
            BMHD2: vBaseEnvHwRegionStartAddress=2940208128, vBaseEnvHwRegionSize=512, vBaseEnvHwRegionType=ROM
            BMHD3: vBaseEnvHwRegionStartAddress=2940208640, vBaseEnvHwRegionSize=512, vBaseEnvHwRegionType=ROM
            OLDA_Cached: vBaseEnvHwRegionStartAddress=2413821952, vBaseEnvHwRegionSize=524288, vBaseEnvHwRegionType=RAM
            OLDA_NonCached: vBaseEnvHwRegionStartAddress=2950692864, vBaseEnvHwRegionSize=524288, vBaseEnvHwRegionType=RAM
            DLMU0_Cached: vBaseEnvHwRegionStartAddress=2415919104, vBaseEnvHwRegionSize=65536, vBaseEnvHwRegionType=RAM
            DLMU0_NonCached: vBaseEnvHwRegionStartAddress=2952790016, vBaseEnvHwRegionSize=65536, vBaseEnvHwRegionType=RAM
            DLMU1_Cached: vBaseEnvHwRegionStartAddress=2415984640, vBaseEnvHwRegionSize=65536, vBaseEnvHwRegionType=RAM
            DLMU1_NonCached: vBaseEnvHwRegionStartAddress=2952855552, vBaseEnvHwRegionSize=65536, vBaseEnvHwRegionType=RAM
            DLMU2_Cached: vBaseEnvHwRegionStartAddress=2416050176, vBaseEnvHwRegionSize=65536, vBaseEnvHwRegionType=RAM
            DLMU2_NonCached: vBaseEnvHwRegionStartAddress=2952921088, vBaseEnvHwRegionSize=65536, vBaseEnvHwRegionType=RAM
            DAM0_Cached: vBaseEnvHwRegionStartAddress=2420113408, vBaseEnvHwRegionSize=32768, vBaseEnvHwRegionType=RAM
            DAM0_NonCached: vBaseEnvHwRegionStartAddress=2956984320, vBaseEnvHwRegionSize=32768, vBaseEnvHwRegionType=RAM
            DFlash0: vBaseEnvHwRegionStartAddress=2936012800, vBaseEnvHwRegionSize=131072, vBaseEnvHwRegionType=ROM
            DFlash1: vBaseEnvHwRegionStartAddress=2948595712, vBaseEnvHwRegionSize=131072, vBaseEnvHwRegionType=ROM
        TC380Q: vBaseEnvCpuCoreAmount=4, vBaseEnvCpuMaxFrequency=300000000, vBaseEnvTestedDerivative=TC38x, vBaseEnvTestedDerivativeDescription=Infineon Aurix 2G TC38x Family, vBaseEnvAvailableChannels_Can=12, vBaseEnvAvailableChannels_Ethernet=1, vBaseEnvAvailableChannels_Flexray=4, vBaseEnvAvailableChannels_Lin=24
          vBaseEnvAdditionalParameters: vBaseEnvWatchdogGroup=B, vBaseEnvPllGroup=B, vBaseEnvPortGroup=B, vBaseEnvResetGroup=B, vBaseEnvDerivativeGroup=TC3xx
          36 x vBaseEnvMemLayoutHwRegion:
            DSPR0: vBaseEnvHwRegionStartAddress=1879048192, vBaseEnvHwRegionSize=245760, vBaseEnvHwRegionType=RAM
            PSPR0: vBaseEnvHwRegionStartAddress=1880096768, vBaseEnvHwRegionSize=65536, vBaseEnvHwRegionType=RAM
            DSPR1: vBaseEnvHwRegionStartAddress=1610612736, vBaseEnvHwRegionSize=245760, vBaseEnvHwRegionType=RAM
            PSPR1: vBaseEnvHwRegionStartAddress=1611661312, vBaseEnvHwRegionSize=65536, vBaseEnvHwRegionType=RAM
            DSPR2: vBaseEnvHwRegionStartAddress=1342177280, vBaseEnvHwRegionSize=98304, vBaseEnvHwRegionType=RAM
            PSPR2: vBaseEnvHwRegionStartAddress=1343225856, vBaseEnvHwRegionSize=65536, vBaseEnvHwRegionType=RAM
            DSPR3: vBaseEnvHwRegionStartAddress=1073741824, vBaseEnvHwRegionSize=98304, vBaseEnvHwRegionType=RAM
            PSPR3: vBaseEnvHwRegionStartAddress=1074790400, vBaseEnvHwRegionSize=98304, vBaseEnvHwRegionType=RAM
            PFlash0_Cached: vBaseEnvHwRegionStartAddress=2147483648, vBaseEnvHwRegionSize=3145728, vBaseEnvHwRegionType=ROM
            PFlash0_NonCached: vBaseEnvHwRegionStartAddress=2684354560, vBaseEnvHwRegionSize=3145728, vBaseEnvHwRegionType=ROM
            PFlash1_Cached: vBaseEnvHwRegionStartAddress=2150629376, vBaseEnvHwRegionSize=3145728, vBaseEnvHwRegionType=ROM
            PFlash1_NonCached: vBaseEnvHwRegionStartAddress=2687500288, vBaseEnvHwRegionSize=3145728, vBaseEnvHwRegionType=ROM
            PFlash2_Cached: vBaseEnvHwRegionStartAddress=2153775104, vBaseEnvHwRegionSize=3145728, vBaseEnvHwRegionType=ROM
            PFlash2_NonCached: vBaseEnvHwRegionStartAddress=2690646016, vBaseEnvHwRegionSize=3145728, vBaseEnvHwRegionType=ROM
            PFlash3_Cached: vBaseEnvHwRegionStartAddress=2156920832, vBaseEnvHwRegionSize=1048576, vBaseEnvHwRegionType=ROM
            PFlash3_NonCached: vBaseEnvHwRegionStartAddress=2693791744, vBaseEnvHwRegionSize=1048576, vBaseEnvHwRegionType=ROM
            LMU0_Cached: vBaseEnvHwRegionStartAddress=2416181248, vBaseEnvHwRegionSize=131072, vBaseEnvHwRegionType=RAM
            LMU0_NonCached: vBaseEnvHwRegionStartAddress=2953052160, vBaseEnvHwRegionSize=131072, vBaseEnvHwRegionType=RAM
            BMHD0: vBaseEnvHwRegionStartAddress=2940207104, vBaseEnvHwRegionSize=512, vBaseEnvHwRegionType=ROM
            BMHD1: vBaseEnvHwRegionStartAddress=2940207616, vBaseEnvHwRegionSize=512, vBaseEnvHwRegionType=ROM
            BMHD2: vBaseEnvHwRegionStartAddress=2940208128, vBaseEnvHwRegionSize=512, vBaseEnvHwRegionType=ROM
            BMHD3: vBaseEnvHwRegionStartAddress=2940208640, vBaseEnvHwRegionSize=512, vBaseEnvHwRegionType=ROM
            OLDA_Cached: vBaseEnvHwRegionStartAddress=2413821952, vBaseEnvHwRegionSize=524288, vBaseEnvHwRegionType=RAM
            OLDA_NonCached: vBaseEnvHwRegionStartAddress=2950692864, vBaseEnvHwRegionSize=524288, vBaseEnvHwRegionType=RAM
            DLMU0_Cached: vBaseEnvHwRegionStartAddress=2415919104, vBaseEnvHwRegionSize=65536, vBaseEnvHwRegionType=RAM
            DLMU0_NonCached: vBaseEnvHwRegionStartAddress=2952790016, vBaseEnvHwRegionSize=65536, vBaseEnvHwRegionType=RAM
            DLMU1_Cached: vBaseEnvHwRegionStartAddress=2415984640, vBaseEnvHwRegionSize=65536, vBaseEnvHwRegionType=RAM
            DLMU1_NonCached: vBaseEnvHwRegionStartAddress=2952855552, vBaseEnvHwRegionSize=65536, vBaseEnvHwRegionType=RAM
            DLMU2_Cached: vBaseEnvHwRegionStartAddress=2416050176, vBaseEnvHwRegionSize=65536, vBaseEnvHwRegionType=RAM
            DLMU2_NonCached: vBaseEnvHwRegionStartAddress=2952921088, vBaseEnvHwRegionSize=65536, vBaseEnvHwRegionType=RAM
            DLMU3_Cached: vBaseEnvHwRegionStartAddress=2416115712, vBaseEnvHwRegionSize=65536, vBaseEnvHwRegionType=RAM
            DLMU3_NonCached: vBaseEnvHwRegionStartAddress=2952986624, vBaseEnvHwRegionSize=65536, vBaseEnvHwRegionType=RAM
            DAM0_Cached: vBaseEnvHwRegionStartAddress=2420113408, vBaseEnvHwRegionSize=65536, vBaseEnvHwRegionType=RAM
            DAM0_NonCached: vBaseEnvHwRegionStartAddress=2956984320, vBaseEnvHwRegionSize=65536, vBaseEnvHwRegionType=RAM
            DFlash0: vBaseEnvHwRegionStartAddress=2936012800, vBaseEnvHwRegionSize=524288, vBaseEnvHwRegionType=ROM
            DFlash1: vBaseEnvHwRegionStartAddress=2948595712, vBaseEnvHwRegionSize=131072, vBaseEnvHwRegionType=ROM
        TC387T: vBaseEnvCpuCoreAmount=3, vBaseEnvCpuMaxFrequency=300000000, vBaseEnvTestedDerivative=TC38x, vBaseEnvTestedDerivativeDescription=Infineon Aurix 2G TC38x Family, vBaseEnvAvailableChannels_Can=12, vBaseEnvAvailableChannels_Ethernet=1, vBaseEnvAvailableChannels_Flexray=4, vBaseEnvAvailableChannels_Lin=24
          vBaseEnvAdditionalParameters: vBaseEnvWatchdogGroup=B, vBaseEnvPllGroup=B, vBaseEnvPortGroup=B, vBaseEnvResetGroup=B, vBaseEnvDerivativeGroup=TC3xx
          20 x vBaseEnvMemLayoutHwRegion:
            DSPR0: vBaseEnvHwRegionStartAddress=1879048192, vBaseEnvHwRegionSize=245760, vBaseEnvHwRegionType=RAM
            PSPR0: vBaseEnvHwRegionStartAddress=1880096768, vBaseEnvHwRegionSize=65536, vBaseEnvHwRegionType=RAM
            DSPR1: vBaseEnvHwRegionStartAddress=1610612736, vBaseEnvHwRegionSize=245760, vBaseEnvHwRegionType=RAM
            PSPR1: vBaseEnvHwRegionStartAddress=1611661312, vBaseEnvHwRegionSize=65536, vBaseEnvHwRegionType=RAM
            DSPR2: vBaseEnvHwRegionStartAddress=1342177280, vBaseEnvHwRegionSize=98304, vBaseEnvHwRegionType=RAM
            PSPR2: vBaseEnvHwRegionStartAddress=1343225856, vBaseEnvHwRegionSize=65536, vBaseEnvHwRegionType=RAM
            PFlash0_Cached: vBaseEnvHwRegionStartAddress=2147483648, vBaseEnvHwRegionSize=3145728, vBaseEnvHwRegionType=ROM
            PFlash0_NonCached: vBaseEnvHwRegionStartAddress=2684354560, vBaseEnvHwRegionSize=3145728, vBaseEnvHwRegionType=ROM
            PFlash1_Cached: vBaseEnvHwRegionStartAddress=2150629376, vBaseEnvHwRegionSize=3145728, vBaseEnvHwRegionType=ROM
            PFlash1_NonCached: vBaseEnvHwRegionStartAddress=2687500288, vBaseEnvHwRegionSize=3145728, vBaseEnvHwRegionType=ROM
            PFlash2_Cached: vBaseEnvHwRegionStartAddress=2153775104, vBaseEnvHwRegionSize=3145728, vBaseEnvHwRegionType=ROM
            PFlash2_NonCached: vBaseEnvHwRegionStartAddress=2690646016, vBaseEnvHwRegionSize=3145728, vBaseEnvHwRegionType=ROM
            PFlash3_Cached: vBaseEnvHwRegionStartAddress=2156920832, vBaseEnvHwRegionSize=1048576, vBaseEnvHwRegionType=ROM
            PFlash3_NonCached: vBaseEnvHwRegionStartAddress=2693791744, vBaseEnvHwRegionSize=1048576, vBaseEnvHwRegionType=ROM
            LMU0_Cached: vBaseEnvHwRegionStartAddress=2416181248, vBaseEnvHwRegionSize=131072, vBaseEnvHwRegionType=RAM
            LMU0_NonCached: vBaseEnvHwRegionStartAddress=2953052160, vBaseEnvHwRegionSize=131072, vBaseEnvHwRegionType=RAM
            BMHD0: vBaseEnvHwRegionStartAddress=2940207104, vBaseEnvHwRegionSize=512, vBaseEnvHwRegionType=ROM
            BMHD1: vBaseEnvHwRegionStartAddress=2940207616, vBaseEnvHwRegionSize=512, vBaseEnvHwRegionType=ROM
            BMHD2: vBaseEnvHwRegionStartAddress=2940208128, vBaseEnvHwRegionSize=512, vBaseEnvHwRegionType=ROM
            BMHD3: vBaseEnvHwRegionStartAddress=2940208640, vBaseEnvHwRegionSize=512, vBaseEnvHwRegionType=ROM
        TC387Q: vBaseEnvCpuCoreAmount=4, vBaseEnvCpuMaxFrequency=300000000, vBaseEnvTestedDerivative=TC38x, vBaseEnvTestedDerivativeDescription=Infineon Aurix 2G TC38x Family, vBaseEnvAvailableChannels_Can=12, vBaseEnvAvailableChannels_Ethernet=1, vBaseEnvAvailableChannels_Flexray=4, vBaseEnvAvailableChannels_Lin=24
          vBaseEnvAdditionalParameters: vBaseEnvWatchdogGroup=B, vBaseEnvPllGroup=B, vBaseEnvPortGroup=B, vBaseEnvResetGroup=B, vBaseEnvDerivativeGroup=TC3xx
          36 x vBaseEnvMemLayoutHwRegion:
            DSPR0: vBaseEnvHwRegionStartAddress=1879048192, vBaseEnvHwRegionSize=245760, vBaseEnvHwRegionType=RAM
            PSPR0: vBaseEnvHwRegionStartAddress=1880096768, vBaseEnvHwRegionSize=65536, vBaseEnvHwRegionType=RAM
            DSPR1: vBaseEnvHwRegionStartAddress=1610612736, vBaseEnvHwRegionSize=245760, vBaseEnvHwRegionType=RAM
            PSPR1: vBaseEnvHwRegionStartAddress=1611661312, vBaseEnvHwRegionSize=65536, vBaseEnvHwRegionType=RAM
            DSPR2: vBaseEnvHwRegionStartAddress=1342177280, vBaseEnvHwRegionSize=98304, vBaseEnvHwRegionType=RAM
            PSPR2: vBaseEnvHwRegionStartAddress=1343225856, vBaseEnvHwRegionSize=65536, vBaseEnvHwRegionType=RAM
            DSPR3: vBaseEnvHwRegionStartAddress=1073741824, vBaseEnvHwRegionSize=98304, vBaseEnvHwRegionType=RAM
            PSPR3: vBaseEnvHwRegionStartAddress=1074790400, vBaseEnvHwRegionSize=98304, vBaseEnvHwRegionType=RAM
            PFlash0_Cached: vBaseEnvHwRegionStartAddress=2147483648, vBaseEnvHwRegionSize=3145728, vBaseEnvHwRegionType=ROM
            PFlash0_NonCached: vBaseEnvHwRegionStartAddress=2684354560, vBaseEnvHwRegionSize=3145728, vBaseEnvHwRegionType=ROM
            PFlash1_Cached: vBaseEnvHwRegionStartAddress=2150629376, vBaseEnvHwRegionSize=3145728, vBaseEnvHwRegionType=ROM
            PFlash1_NonCached: vBaseEnvHwRegionStartAddress=2687500288, vBaseEnvHwRegionSize=3145728, vBaseEnvHwRegionType=ROM
            PFlash2_Cached: vBaseEnvHwRegionStartAddress=2153775104, vBaseEnvHwRegionSize=3145728, vBaseEnvHwRegionType=ROM
            PFlash2_NonCached: vBaseEnvHwRegionStartAddress=2690646016, vBaseEnvHwRegionSize=3145728, vBaseEnvHwRegionType=ROM
            PFlash3_Cached: vBaseEnvHwRegionStartAddress=2156920832, vBaseEnvHwRegionSize=1048576, vBaseEnvHwRegionType=ROM
            PFlash3_NonCached: vBaseEnvHwRegionStartAddress=2693791744, vBaseEnvHwRegionSize=1048576, vBaseEnvHwRegionType=ROM
            LMU0_Cached: vBaseEnvHwRegionStartAddress=2416181248, vBaseEnvHwRegionSize=131072, vBaseEnvHwRegionType=RAM
            LMU0_NonCached: vBaseEnvHwRegionStartAddress=2953052160, vBaseEnvHwRegionSize=131072, vBaseEnvHwRegionType=RAM
            BMHD0: vBaseEnvHwRegionStartAddress=2940207104, vBaseEnvHwRegionSize=512, vBaseEnvHwRegionType=ROM
            BMHD1: vBaseEnvHwRegionStartAddress=2940207616, vBaseEnvHwRegionSize=512, vBaseEnvHwRegionType=ROM
            BMHD2: vBaseEnvHwRegionStartAddress=2940208128, vBaseEnvHwRegionSize=512, vBaseEnvHwRegionType=ROM
            BMHD3: vBaseEnvHwRegionStartAddress=2940208640, vBaseEnvHwRegionSize=512, vBaseEnvHwRegionType=ROM
            OLDA_Cached: vBaseEnvHwRegionStartAddress=2413821952, vBaseEnvHwRegionSize=524288, vBaseEnvHwRegionType=RAM
            OLDA_NonCached: vBaseEnvHwRegionStartAddress=2950692864, vBaseEnvHwRegionSize=524288, vBaseEnvHwRegionType=RAM
            DLMU0_Cached: vBaseEnvHwRegionStartAddress=2415919104, vBaseEnvHwRegionSize=65536, vBaseEnvHwRegionType=RAM
            DLMU0_NonCached: vBaseEnvHwRegionStartAddress=2952790016, vBaseEnvHwRegionSize=65536, vBaseEnvHwRegionType=RAM
            DLMU1_Cached: vBaseEnvHwRegionStartAddress=2415984640, vBaseEnvHwRegionSize=65536, vBaseEnvHwRegionType=RAM
            DLMU1_NonCached: vBaseEnvHwRegionStartAddress=2952855552, vBaseEnvHwRegionSize=65536, vBaseEnvHwRegionType=RAM
            DLMU2_Cached: vBaseEnvHwRegionStartAddress=2416050176, vBaseEnvHwRegionSize=65536, vBaseEnvHwRegionType=RAM
            DLMU2_NonCached: vBaseEnvHwRegionStartAddress=2952921088, vBaseEnvHwRegionSize=65536, vBaseEnvHwRegionType=RAM
            DLMU3_Cached: vBaseEnvHwRegionStartAddress=2416115712, vBaseEnvHwRegionSize=65536, vBaseEnvHwRegionType=RAM
            DLMU3_NonCached: vBaseEnvHwRegionStartAddress=2952986624, vBaseEnvHwRegionSize=65536, vBaseEnvHwRegionType=RAM
            DAM0_Cached: vBaseEnvHwRegionStartAddress=2420113408, vBaseEnvHwRegionSize=65536, vBaseEnvHwRegionType=RAM
            DAM0_NonCached: vBaseEnvHwRegionStartAddress=2956984320, vBaseEnvHwRegionSize=65536, vBaseEnvHwRegionType=RAM
            DFlash0: vBaseEnvHwRegionStartAddress=2936012800, vBaseEnvHwRegionSize=524288, vBaseEnvHwRegionType=ROM
            DFlash1: vBaseEnvHwRegionStartAddress=2948595712, vBaseEnvHwRegionSize=131072, vBaseEnvHwRegionType=ROM
        TC389Q: vBaseEnvCpuCoreAmount=4, vBaseEnvCpuMaxFrequency=300000000, vBaseEnvTestedDerivative=TC38x, vBaseEnvTestedDerivativeDescription=Infineon Aurix 2G TC38x Family, vBaseEnvAvailableChannels_Can=12, vBaseEnvAvailableChannels_Ethernet=1, vBaseEnvAvailableChannels_Flexray=4, vBaseEnvAvailableChannels_Lin=24
          vBaseEnvAdditionalParameters: vBaseEnvWatchdogGroup=B, vBaseEnvPllGroup=B, vBaseEnvPortGroup=B, vBaseEnvResetGroup=B, vBaseEnvDerivativeGroup=TC3xx
          36 x vBaseEnvMemLayoutHwRegion:
            DSPR0: vBaseEnvHwRegionStartAddress=1879048192, vBaseEnvHwRegionSize=245760, vBaseEnvHwRegionType=RAM
            PSPR0: vBaseEnvHwRegionStartAddress=1880096768, vBaseEnvHwRegionSize=65536, vBaseEnvHwRegionType=RAM
            DSPR1: vBaseEnvHwRegionStartAddress=1610612736, vBaseEnvHwRegionSize=245760, vBaseEnvHwRegionType=RAM
            PSPR1: vBaseEnvHwRegionStartAddress=1611661312, vBaseEnvHwRegionSize=65536, vBaseEnvHwRegionType=RAM
            DSPR2: vBaseEnvHwRegionStartAddress=1342177280, vBaseEnvHwRegionSize=98304, vBaseEnvHwRegionType=RAM
            PSPR2: vBaseEnvHwRegionStartAddress=1343225856, vBaseEnvHwRegionSize=65536, vBaseEnvHwRegionType=RAM
            DSPR3: vBaseEnvHwRegionStartAddress=1073741824, vBaseEnvHwRegionSize=98304, vBaseEnvHwRegionType=RAM
            PSPR3: vBaseEnvHwRegionStartAddress=1074790400, vBaseEnvHwRegionSize=98304, vBaseEnvHwRegionType=RAM
            PFlash0_Cached: vBaseEnvHwRegionStartAddress=2147483648, vBaseEnvHwRegionSize=3145728, vBaseEnvHwRegionType=ROM
            PFlash0_NonCached: vBaseEnvHwRegionStartAddress=2684354560, vBaseEnvHwRegionSize=3145728, vBaseEnvHwRegionType=ROM
            PFlash1_Cached: vBaseEnvHwRegionStartAddress=2150629376, vBaseEnvHwRegionSize=3145728, vBaseEnvHwRegionType=ROM
            PFlash1_NonCached: vBaseEnvHwRegionStartAddress=2687500288, vBaseEnvHwRegionSize=3145728, vBaseEnvHwRegionType=ROM
            PFlash2_Cached: vBaseEnvHwRegionStartAddress=2153775104, vBaseEnvHwRegionSize=3145728, vBaseEnvHwRegionType=ROM
            PFlash2_NonCached: vBaseEnvHwRegionStartAddress=2690646016, vBaseEnvHwRegionSize=3145728, vBaseEnvHwRegionType=ROM
            PFlash3_Cached: vBaseEnvHwRegionStartAddress=2156920832, vBaseEnvHwRegionSize=1048576, vBaseEnvHwRegionType=ROM
            PFlash3_NonCached: vBaseEnvHwRegionStartAddress=2693791744, vBaseEnvHwRegionSize=1048576, vBaseEnvHwRegionType=ROM
            LMU0_Cached: vBaseEnvHwRegionStartAddress=2416181248, vBaseEnvHwRegionSize=131072, vBaseEnvHwRegionType=RAM
            LMU0_NonCached: vBaseEnvHwRegionStartAddress=2953052160, vBaseEnvHwRegionSize=131072, vBaseEnvHwRegionType=RAM
            BMHD0: vBaseEnvHwRegionStartAddress=2940207104, vBaseEnvHwRegionSize=512, vBaseEnvHwRegionType=ROM
            BMHD1: vBaseEnvHwRegionStartAddress=2940207616, vBaseEnvHwRegionSize=512, vBaseEnvHwRegionType=ROM
            BMHD2: vBaseEnvHwRegionStartAddress=2940208128, vBaseEnvHwRegionSize=512, vBaseEnvHwRegionType=ROM
            BMHD3: vBaseEnvHwRegionStartAddress=2940208640, vBaseEnvHwRegionSize=512, vBaseEnvHwRegionType=ROM
            OLDA_Cached: vBaseEnvHwRegionStartAddress=2413821952, vBaseEnvHwRegionSize=524288, vBaseEnvHwRegionType=RAM
            OLDA_NonCached: vBaseEnvHwRegionStartAddress=2950692864, vBaseEnvHwRegionSize=524288, vBaseEnvHwRegionType=RAM
            DLMU0_Cached: vBaseEnvHwRegionStartAddress=2415919104, vBaseEnvHwRegionSize=65536, vBaseEnvHwRegionType=RAM
            DLMU0_NonCached: vBaseEnvHwRegionStartAddress=2952790016, vBaseEnvHwRegionSize=65536, vBaseEnvHwRegionType=RAM
            DLMU1_Cached: vBaseEnvHwRegionStartAddress=2415984640, vBaseEnvHwRegionSize=65536, vBaseEnvHwRegionType=RAM
            DLMU1_NonCached: vBaseEnvHwRegionStartAddress=2952855552, vBaseEnvHwRegionSize=65536, vBaseEnvHwRegionType=RAM
            DLMU2_Cached: vBaseEnvHwRegionStartAddress=2416050176, vBaseEnvHwRegionSize=65536, vBaseEnvHwRegionType=RAM
            DLMU2_NonCached: vBaseEnvHwRegionStartAddress=2952921088, vBaseEnvHwRegionSize=65536, vBaseEnvHwRegionType=RAM
            DLMU3_Cached: vBaseEnvHwRegionStartAddress=2416115712, vBaseEnvHwRegionSize=65536, vBaseEnvHwRegionType=RAM
            DLMU3_NonCached: vBaseEnvHwRegionStartAddress=2952986624, vBaseEnvHwRegionSize=65536, vBaseEnvHwRegionType=RAM
            DAM0_Cached: vBaseEnvHwRegionStartAddress=2420113408, vBaseEnvHwRegionSize=65536, vBaseEnvHwRegionType=RAM
            DAM0_NonCached: vBaseEnvHwRegionStartAddress=2956984320, vBaseEnvHwRegionSize=65536, vBaseEnvHwRegionType=RAM
            DFlash0: vBaseEnvHwRegionStartAddress=2936012800, vBaseEnvHwRegionSize=524288, vBaseEnvHwRegionType=ROM
            DFlash1: vBaseEnvHwRegionStartAddress=2948595712, vBaseEnvHwRegionSize=131072, vBaseEnvHwRegionType=ROM
        TC397Q_StepB: vBaseEnvCpuCoreAmount=4, vBaseEnvCpuMaxFrequency=300000000, vBaseEnvTestedDerivative=TC39x, vBaseEnvTestedDerivativeDescription=Infineon Aurix 2G TC39x Family, vBaseEnvAvailableChannels_Can=12, vBaseEnvAvailableChannels_Ethernet=1, vBaseEnvAvailableChannels_Flexray=4, vBaseEnvAvailableChannels_Lin=12
          vBaseEnvAdditionalParameters: vBaseEnvWatchdogGroup=B, vBaseEnvPllGroup=B, vBaseEnvPortGroup=B, vBaseEnvResetGroup=B, vBaseEnvDerivativeGroup=TC3xx
          30 x vBaseEnvMemLayoutHwRegion:
            DSPR0: vBaseEnvHwRegionStartAddress=1879048192, vBaseEnvHwRegionSize=245760, vBaseEnvHwRegionType=RAM
            PSPR0: vBaseEnvHwRegionStartAddress=1880096768, vBaseEnvHwRegionSize=65536, vBaseEnvHwRegionType=RAM
            DSPR1: vBaseEnvHwRegionStartAddress=1610612736, vBaseEnvHwRegionSize=245760, vBaseEnvHwRegionType=RAM
            PSPR1: vBaseEnvHwRegionStartAddress=1611661312, vBaseEnvHwRegionSize=65536, vBaseEnvHwRegionType=RAM
            DSPR2: vBaseEnvHwRegionStartAddress=1342177280, vBaseEnvHwRegionSize=98304, vBaseEnvHwRegionType=RAM
            PSPR2: vBaseEnvHwRegionStartAddress=1343225856, vBaseEnvHwRegionSize=65536, vBaseEnvHwRegionType=RAM
            DSPR3: vBaseEnvHwRegionStartAddress=1073741824, vBaseEnvHwRegionSize=98304, vBaseEnvHwRegionType=RAM
            PSPR3: vBaseEnvHwRegionStartAddress=1074790400, vBaseEnvHwRegionSize=98304, vBaseEnvHwRegionType=RAM
            PFlash0_Cached: vBaseEnvHwRegionStartAddress=2147483648, vBaseEnvHwRegionSize=3145728, vBaseEnvHwRegionType=ROM
            PFlash0_NonCached: vBaseEnvHwRegionStartAddress=2684354560, vBaseEnvHwRegionSize=3145728, vBaseEnvHwRegionType=ROM
            PFlash1_Cached: vBaseEnvHwRegionStartAddress=2150629376, vBaseEnvHwRegionSize=3145728, vBaseEnvHwRegionType=ROM
            PFlash1_NonCached: vBaseEnvHwRegionStartAddress=2687500288, vBaseEnvHwRegionSize=3145728, vBaseEnvHwRegionType=ROM
            PFlash2_Cached: vBaseEnvHwRegionStartAddress=2153775104, vBaseEnvHwRegionSize=3145728, vBaseEnvHwRegionType=ROM
            PFlash2_NonCached: vBaseEnvHwRegionStartAddress=2690646016, vBaseEnvHwRegionSize=3145728, vBaseEnvHwRegionType=ROM
            PFlash3_Cached: vBaseEnvHwRegionStartAddress=2156920832, vBaseEnvHwRegionSize=3145728, vBaseEnvHwRegionType=ROM
            PFlash3_NonCached: vBaseEnvHwRegionStartAddress=2693791744, vBaseEnvHwRegionSize=3145728, vBaseEnvHwRegionType=ROM
            PFlash4_Cached: vBaseEnvHwRegionStartAddress=2160066560, vBaseEnvHwRegionSize=3145728, vBaseEnvHwRegionType=ROM
            PFlash4_NonCached: vBaseEnvHwRegionStartAddress=2696937472, vBaseEnvHwRegionSize=3145728, vBaseEnvHwRegionType=ROM
            PFlash5_Cached: vBaseEnvHwRegionStartAddress=2163212288, vBaseEnvHwRegionSize=1048576, vBaseEnvHwRegionType=ROM
            PFlash5_NonCached: vBaseEnvHwRegionStartAddress=2700083200, vBaseEnvHwRegionSize=1048576, vBaseEnvHwRegionType=ROM
            LMU0_Cached: vBaseEnvHwRegionStartAddress=2416181248, vBaseEnvHwRegionSize=262144, vBaseEnvHwRegionType=RAM
            LMU0_NonCached: vBaseEnvHwRegionStartAddress=2953052160, vBaseEnvHwRegionSize=262144, vBaseEnvHwRegionType=RAM
            LMU1_Cached: vBaseEnvHwRegionStartAddress=2416443392, vBaseEnvHwRegionSize=262144, vBaseEnvHwRegionType=RAM
            LMU1_NonCached: vBaseEnvHwRegionStartAddress=2953314304, vBaseEnvHwRegionSize=262144, vBaseEnvHwRegionType=RAM
            LMU2_Cached: vBaseEnvHwRegionStartAddress=2416705536, vBaseEnvHwRegionSize=262144, vBaseEnvHwRegionType=RAM
            LMU2_NonCached: vBaseEnvHwRegionStartAddress=2953576448, vBaseEnvHwRegionSize=262144, vBaseEnvHwRegionType=RAM
            BMHD0: vBaseEnvHwRegionStartAddress=2940207104, vBaseEnvHwRegionSize=512, vBaseEnvHwRegionType=ROM
            BMHD1: vBaseEnvHwRegionStartAddress=2940207616, vBaseEnvHwRegionSize=512, vBaseEnvHwRegionType=ROM
            BMHD2: vBaseEnvHwRegionStartAddress=2940208128, vBaseEnvHwRegionSize=512, vBaseEnvHwRegionType=ROM
            BMHD3: vBaseEnvHwRegionStartAddress=2940208640, vBaseEnvHwRegionSize=512, vBaseEnvHwRegionType=ROM
        TC397X_StepA: vBaseEnvCpuCoreAmount=6, vBaseEnvCpuMaxFrequency=300000000, vBaseEnvTestedDerivative=TC39x, vBaseEnvTestedDerivativeDescription=Infineon Aurix 2G TC39x Family, vBaseEnvAvailableChannels_Can=12, vBaseEnvAvailableChannels_Ethernet=1, vBaseEnvAvailableChannels_Flexray=4, vBaseEnvAvailableChannels_Lin=8
          vBaseEnvAdditionalParameters: vBaseEnvWatchdogGroup=B, vBaseEnvPllGroup=C, vBaseEnvPortGroup=B, vBaseEnvResetGroup=B, vBaseEnvDerivativeGroup=TC3xx
          62 x vBaseEnvMemLayoutHwRegion:
            DSPR0: vBaseEnvHwRegionStartAddress=1879048192, vBaseEnvHwRegionSize=245760, vBaseEnvHwRegionType=RAM
            PSPR0: vBaseEnvHwRegionStartAddress=1880096768, vBaseEnvHwRegionSize=65536, vBaseEnvHwRegionType=RAM
            DSPR1: vBaseEnvHwRegionStartAddress=1610612736, vBaseEnvHwRegionSize=245760, vBaseEnvHwRegionType=RAM
            PSPR1: vBaseEnvHwRegionStartAddress=1611661312, vBaseEnvHwRegionSize=65536, vBaseEnvHwRegionType=RAM
            DSPR2: vBaseEnvHwRegionStartAddress=1342177280, vBaseEnvHwRegionSize=98304, vBaseEnvHwRegionType=RAM
            PSPR2: vBaseEnvHwRegionStartAddress=1343225856, vBaseEnvHwRegionSize=65536, vBaseEnvHwRegionType=RAM
            DSPR3: vBaseEnvHwRegionStartAddress=1073741824, vBaseEnvHwRegionSize=98304, vBaseEnvHwRegionType=RAM
            PSPR3: vBaseEnvHwRegionStartAddress=1074790400, vBaseEnvHwRegionSize=98304, vBaseEnvHwRegionType=RAM
            DSPR4: vBaseEnvHwRegionStartAddress=805306368, vBaseEnvHwRegionSize=98304, vBaseEnvHwRegionType=RAM
            PSPR4: vBaseEnvHwRegionStartAddress=806354944, vBaseEnvHwRegionSize=98304, vBaseEnvHwRegionType=RAM
            DSPR5: vBaseEnvHwRegionSize=98304, vBaseEnvHwRegionStartAddress=268435456, vBaseEnvHwRegionType=RAM
            PSPR5: vBaseEnvHwRegionStartAddress=269484032, vBaseEnvHwRegionSize=98304, vBaseEnvHwRegionType=RAM
            PFlash0_Cached: vBaseEnvHwRegionStartAddress=2147483648, vBaseEnvHwRegionSize=3145728, vBaseEnvHwRegionType=ROM
            PFlash0_NonCached: vBaseEnvHwRegionStartAddress=2684354560, vBaseEnvHwRegionSize=3145728, vBaseEnvHwRegionType=ROM
            PFlash1_Cached: vBaseEnvHwRegionStartAddress=2150629376, vBaseEnvHwRegionSize=3145728, vBaseEnvHwRegionType=ROM
            PFlash1_NonCached: vBaseEnvHwRegionStartAddress=2687500288, vBaseEnvHwRegionSize=3145728, vBaseEnvHwRegionType=ROM
            PFlash2_Cached: vBaseEnvHwRegionStartAddress=2153775104, vBaseEnvHwRegionSize=3145728, vBaseEnvHwRegionType=ROM
            PFlash2_NonCached: vBaseEnvHwRegionStartAddress=2690646016, vBaseEnvHwRegionSize=3145728, vBaseEnvHwRegionType=ROM
            PFlash3_Cached: vBaseEnvHwRegionStartAddress=2156920832, vBaseEnvHwRegionSize=3145728, vBaseEnvHwRegionType=ROM
            PFlash3_NonCached: vBaseEnvHwRegionStartAddress=2693791744, vBaseEnvHwRegionSize=3145728, vBaseEnvHwRegionType=ROM
            PFlash4_Cached: vBaseEnvHwRegionStartAddress=2160066560, vBaseEnvHwRegionSize=3145728, vBaseEnvHwRegionType=ROM
            PFlash4_NonCached: vBaseEnvHwRegionStartAddress=2696937472, vBaseEnvHwRegionSize=3145728, vBaseEnvHwRegionType=ROM
            PFlash5_Cached: vBaseEnvHwRegionStartAddress=2163212288, vBaseEnvHwRegionSize=1048576, vBaseEnvHwRegionType=ROM
            PFlash5_NonCached: vBaseEnvHwRegionStartAddress=2700083200, vBaseEnvHwRegionSize=1048576, vBaseEnvHwRegionType=ROM
            LMU0_Cached: vBaseEnvHwRegionStartAddress=2416181248, vBaseEnvHwRegionSize=262144, vBaseEnvHwRegionType=RAM
            LMU0_NonCached: vBaseEnvHwRegionStartAddress=2953052160, vBaseEnvHwRegionSize=262144, vBaseEnvHwRegionType=RAM
            LMU1_Cached: vBaseEnvHwRegionStartAddress=2416443392, vBaseEnvHwRegionSize=262144, vBaseEnvHwRegionType=RAM
            LMU1_NonCached: vBaseEnvHwRegionStartAddress=2953314304, vBaseEnvHwRegionSize=262144, vBaseEnvHwRegionType=RAM
            LMU2_Cached: vBaseEnvHwRegionStartAddress=2416705536, vBaseEnvHwRegionSize=262144, vBaseEnvHwRegionType=RAM
            LMU2_NonCached: vBaseEnvHwRegionStartAddress=2953576448, vBaseEnvHwRegionSize=262144, vBaseEnvHwRegionType=RAM
            BMHD0: vBaseEnvHwRegionStartAddress=2940207104, vBaseEnvHwRegionSize=512, vBaseEnvHwRegionType=ROM
            BMHD1: vBaseEnvHwRegionStartAddress=2940207616, vBaseEnvHwRegionSize=512, vBaseEnvHwRegionType=ROM
            BMHD2: vBaseEnvHwRegionStartAddress=2940208128, vBaseEnvHwRegionSize=512, vBaseEnvHwRegionType=ROM
            BMHD3: vBaseEnvHwRegionStartAddress=2940208640, vBaseEnvHwRegionSize=512, vBaseEnvHwRegionType=ROM
            DLMU0_Cached: vBaseEnvHwRegionStartAddress=2415919104, vBaseEnvHwRegionSize=65536, vBaseEnvHwRegionType=RAM
            DLMU1_Cached: vBaseEnvHwRegionStartAddress=2415984640, vBaseEnvHwRegionSize=65536, vBaseEnvHwRegionType=RAM
            DLMU2_Cached: vBaseEnvHwRegionStartAddress=2416050176, vBaseEnvHwRegionSize=65536, vBaseEnvHwRegionType=RAM
            DLMU3_Cached: vBaseEnvHwRegionStartAddress=2416115712, vBaseEnvHwRegionSize=65536, vBaseEnvHwRegionType=RAM
            DLMU4_Cached: vBaseEnvHwRegionStartAddress=2416967680, vBaseEnvHwRegionSize=65536, vBaseEnvHwRegionType=RAM
            DLMU5_Cached: vBaseEnvHwRegionStartAddress=2417033216, vBaseEnvHwRegionSize=65536, vBaseEnvHwRegionType=RAM
            DLMU0_NonCached: vBaseEnvHwRegionStartAddress=2952790016, vBaseEnvHwRegionSize=65536, vBaseEnvHwRegionType=RAM
            DLMU1_NonCached: vBaseEnvHwRegionStartAddress=2952855552, vBaseEnvHwRegionSize=65536, vBaseEnvHwRegionType=RAM
            DLMU2_NonCached: vBaseEnvHwRegionStartAddress=2952921088, vBaseEnvHwRegionSize=65536, vBaseEnvHwRegionType=RAM
            DLMU3_NonCached: vBaseEnvHwRegionStartAddress=2952986624, vBaseEnvHwRegionSize=65536, vBaseEnvHwRegionType=RAM
            DLMU4_NonCached: vBaseEnvHwRegionStartAddress=2953838592, vBaseEnvHwRegionSize=65536, vBaseEnvHwRegionType=RAM
            DLMU5_NonCached: vBaseEnvHwRegionStartAddress=2953904128, vBaseEnvHwRegionSize=65536, vBaseEnvHwRegionType=RAM
            OLDA_Cached: vBaseEnvHwRegionStartAddress=2413821952, vBaseEnvHwRegionSize=524288, vBaseEnvHwRegionType=RAM
            OLDA_NonCached: vBaseEnvHwRegionStartAddress=2950692864, vBaseEnvHwRegionSize=524288, vBaseEnvHwRegionType=RAM
            DAM0_Cached: vBaseEnvHwRegionStartAddress=2420113408, vBaseEnvHwRegionSize=65536, vBaseEnvHwRegionType=RAM
            DAM0_NonCached: vBaseEnvHwRegionStartAddress=2956984320, vBaseEnvHwRegionSize=65536, vBaseEnvHwRegionType=RAM
            DAM1_Cached: vBaseEnvHwRegionStartAddress=2420178944, vBaseEnvHwRegionSize=65536, vBaseEnvHwRegionType=RAM
            DAM1_NonCached: vBaseEnvHwRegionStartAddress=2957049856, vBaseEnvHwRegionSize=65536, vBaseEnvHwRegionType=RAM
            EMEM0_Cached: vBaseEnvHwRegionStartAddress=2566914048, vBaseEnvHwRegionSize=1048576, vBaseEnvHwRegionType=RAM
            EMEM0_NonCached: vBaseEnvHwRegionStartAddress=3103784960, vBaseEnvHwRegionSize=1048576, vBaseEnvHwRegionType=RAM
            EMEM1_Cached: vBaseEnvHwRegionStartAddress=2567962624, vBaseEnvHwRegionSize=1048576, vBaseEnvHwRegionType=RAM
            EMEM1_NonCached: vBaseEnvHwRegionStartAddress=3104833536, vBaseEnvHwRegionSize=1048576, vBaseEnvHwRegionType=RAM
            EMEM2_Cached: vBaseEnvHwRegionStartAddress=2569011200, vBaseEnvHwRegionSize=1048576, vBaseEnvHwRegionType=RAM
            EMEM2_NonCached: vBaseEnvHwRegionStartAddress=3105882112, vBaseEnvHwRegionSize=1048576, vBaseEnvHwRegionType=RAM
            EMEM3_Cached: vBaseEnvHwRegionStartAddress=2570059776, vBaseEnvHwRegionSize=1048576, vBaseEnvHwRegionType=RAM
            EMEM3_NonCached: vBaseEnvHwRegionStartAddress=3106930688, vBaseEnvHwRegionSize=1048576, vBaseEnvHwRegionType=RAM
            DFlash0: vBaseEnvHwRegionStartAddress=2936012800, vBaseEnvHwRegionSize=1048576, vBaseEnvHwRegionType=ROM
            DFlash1: vBaseEnvHwRegionStartAddress=2948595712, vBaseEnvHwRegionSize=131072, vBaseEnvHwRegionType=ROM
        TC397X_StepB: vBaseEnvCpuCoreAmount=6, vBaseEnvCpuMaxFrequency=300000000, vBaseEnvTestedDerivative=TC39x, vBaseEnvTestedDerivativeDescription=Infineon Aurix 2G TC39x Family, vBaseEnvAvailableChannels_Can=12, vBaseEnvAvailableChannels_Ethernet=1, vBaseEnvAvailableChannels_Flexray=4, vBaseEnvAvailableChannels_Lin=12
          vBaseEnvAdditionalParameters: vBaseEnvWatchdogGroup=B, vBaseEnvPllGroup=B, vBaseEnvPortGroup=B, vBaseEnvResetGroup=B, vBaseEnvDerivativeGroup=TC3xx
          62 x vBaseEnvMemLayoutHwRegion:
            DSPR0: vBaseEnvHwRegionStartAddress=1879048192, vBaseEnvHwRegionSize=245760, vBaseEnvHwRegionType=RAM
            PSPR0: vBaseEnvHwRegionStartAddress=1880096768, vBaseEnvHwRegionSize=65536, vBaseEnvHwRegionType=RAM
            DSPR1: vBaseEnvHwRegionStartAddress=1610612736, vBaseEnvHwRegionSize=245760, vBaseEnvHwRegionType=RAM
            PSPR1: vBaseEnvHwRegionStartAddress=1611661312, vBaseEnvHwRegionSize=65536, vBaseEnvHwRegionType=RAM
            DSPR2: vBaseEnvHwRegionStartAddress=1342177280, vBaseEnvHwRegionSize=98304, vBaseEnvHwRegionType=RAM
            PSPR2: vBaseEnvHwRegionStartAddress=1343225856, vBaseEnvHwRegionSize=65536, vBaseEnvHwRegionType=RAM
            DSPR3: vBaseEnvHwRegionStartAddress=1073741824, vBaseEnvHwRegionSize=98304, vBaseEnvHwRegionType=RAM
            PSPR3: vBaseEnvHwRegionStartAddress=1074790400, vBaseEnvHwRegionSize=98304, vBaseEnvHwRegionType=RAM
            DSPR4: vBaseEnvHwRegionStartAddress=805306368, vBaseEnvHwRegionSize=98304, vBaseEnvHwRegionType=RAM
            PSPR4: vBaseEnvHwRegionStartAddress=806354944, vBaseEnvHwRegionSize=98304, vBaseEnvHwRegionType=RAM
            DSPR5: vBaseEnvHwRegionSize=98304, vBaseEnvHwRegionStartAddress=268435456, vBaseEnvHwRegionType=RAM
            PSPR5: vBaseEnvHwRegionStartAddress=269484032, vBaseEnvHwRegionSize=98304, vBaseEnvHwRegionType=RAM
            PFlash0_Cached: vBaseEnvHwRegionStartAddress=2147483648, vBaseEnvHwRegionSize=3145728, vBaseEnvHwRegionType=ROM
            PFlash0_NonCached: vBaseEnvHwRegionStartAddress=2684354560, vBaseEnvHwRegionSize=3145728, vBaseEnvHwRegionType=ROM
            PFlash1_Cached: vBaseEnvHwRegionStartAddress=2150629376, vBaseEnvHwRegionSize=3145728, vBaseEnvHwRegionType=ROM
            PFlash1_NonCached: vBaseEnvHwRegionStartAddress=2687500288, vBaseEnvHwRegionSize=3145728, vBaseEnvHwRegionType=ROM
            PFlash2_Cached: vBaseEnvHwRegionStartAddress=2153775104, vBaseEnvHwRegionSize=3145728, vBaseEnvHwRegionType=ROM
            PFlash2_NonCached: vBaseEnvHwRegionStartAddress=2690646016, vBaseEnvHwRegionSize=3145728, vBaseEnvHwRegionType=ROM
            PFlash3_Cached: vBaseEnvHwRegionStartAddress=2156920832, vBaseEnvHwRegionSize=3145728, vBaseEnvHwRegionType=ROM
            PFlash3_NonCached: vBaseEnvHwRegionStartAddress=2693791744, vBaseEnvHwRegionSize=3145728, vBaseEnvHwRegionType=ROM
            PFlash4_Cached: vBaseEnvHwRegionStartAddress=2160066560, vBaseEnvHwRegionSize=3145728, vBaseEnvHwRegionType=ROM
            PFlash4_NonCached: vBaseEnvHwRegionStartAddress=2696937472, vBaseEnvHwRegionSize=3145728, vBaseEnvHwRegionType=ROM
            PFlash5_Cached: vBaseEnvHwRegionStartAddress=2163212288, vBaseEnvHwRegionSize=1048576, vBaseEnvHwRegionType=ROM
            PFlash5_NonCached: vBaseEnvHwRegionStartAddress=2700083200, vBaseEnvHwRegionSize=1048576, vBaseEnvHwRegionType=ROM
            LMU0_Cached: vBaseEnvHwRegionStartAddress=2416181248, vBaseEnvHwRegionSize=262144, vBaseEnvHwRegionType=RAM
            LMU0_NonCached: vBaseEnvHwRegionStartAddress=2953052160, vBaseEnvHwRegionSize=262144, vBaseEnvHwRegionType=RAM
            LMU1_Cached: vBaseEnvHwRegionStartAddress=2416443392, vBaseEnvHwRegionSize=262144, vBaseEnvHwRegionType=RAM
            LMU1_NonCached: vBaseEnvHwRegionStartAddress=2953314304, vBaseEnvHwRegionSize=262144, vBaseEnvHwRegionType=RAM
            LMU2_Cached: vBaseEnvHwRegionStartAddress=2416705536, vBaseEnvHwRegionSize=262144, vBaseEnvHwRegionType=RAM
            LMU2_NonCached: vBaseEnvHwRegionStartAddress=2953576448, vBaseEnvHwRegionSize=262144, vBaseEnvHwRegionType=RAM
            BMHD0: vBaseEnvHwRegionStartAddress=2940207104, vBaseEnvHwRegionSize=512, vBaseEnvHwRegionType=ROM
            BMHD1: vBaseEnvHwRegionStartAddress=2940207616, vBaseEnvHwRegionSize=512, vBaseEnvHwRegionType=ROM
            BMHD2: vBaseEnvHwRegionStartAddress=2940208128, vBaseEnvHwRegionSize=512, vBaseEnvHwRegionType=ROM
            BMHD3: vBaseEnvHwRegionStartAddress=2940208640, vBaseEnvHwRegionSize=512, vBaseEnvHwRegionType=ROM
            DLMU0_Cached: vBaseEnvHwRegionStartAddress=2415919104, vBaseEnvHwRegionSize=65536, vBaseEnvHwRegionType=RAM
            DLMU1_Cached: vBaseEnvHwRegionStartAddress=2415984640, vBaseEnvHwRegionSize=65536, vBaseEnvHwRegionType=RAM
            DLMU2_Cached: vBaseEnvHwRegionStartAddress=2416050176, vBaseEnvHwRegionSize=65536, vBaseEnvHwRegionType=RAM
            DLMU3_Cached: vBaseEnvHwRegionStartAddress=2416115712, vBaseEnvHwRegionSize=65536, vBaseEnvHwRegionType=RAM
            DLMU4_Cached: vBaseEnvHwRegionStartAddress=2416967680, vBaseEnvHwRegionSize=65536, vBaseEnvHwRegionType=RAM
            DLMU5_Cached: vBaseEnvHwRegionStartAddress=2417033216, vBaseEnvHwRegionSize=65536, vBaseEnvHwRegionType=RAM
            DLMU0_NonCached: vBaseEnvHwRegionStartAddress=2952790016, vBaseEnvHwRegionSize=65536, vBaseEnvHwRegionType=RAM
            DLMU1_NonCached: vBaseEnvHwRegionStartAddress=2952855552, vBaseEnvHwRegionSize=65536, vBaseEnvHwRegionType=RAM
            DLMU2_NonCached: vBaseEnvHwRegionStartAddress=2952921088, vBaseEnvHwRegionSize=65536, vBaseEnvHwRegionType=RAM
            DLMU3_NonCached: vBaseEnvHwRegionStartAddress=2952986624, vBaseEnvHwRegionSize=65536, vBaseEnvHwRegionType=RAM
            DLMU4_NonCached: vBaseEnvHwRegionStartAddress=2953838592, vBaseEnvHwRegionSize=65536, vBaseEnvHwRegionType=RAM
            DLMU5_NonCached: vBaseEnvHwRegionStartAddress=2953904128, vBaseEnvHwRegionSize=65536, vBaseEnvHwRegionType=RAM
            OLDA_Cached: vBaseEnvHwRegionStartAddress=2413821952, vBaseEnvHwRegionSize=524288, vBaseEnvHwRegionType=RAM
            OLDA_NonCached: vBaseEnvHwRegionStartAddress=2950692864, vBaseEnvHwRegionSize=524288, vBaseEnvHwRegionType=RAM
            DAM0_Cached: vBaseEnvHwRegionStartAddress=2420113408, vBaseEnvHwRegionSize=65536, vBaseEnvHwRegionType=RAM
            DAM0_NonCached: vBaseEnvHwRegionStartAddress=2956984320, vBaseEnvHwRegionSize=65536, vBaseEnvHwRegionType=RAM
            DAM1_Cached: vBaseEnvHwRegionStartAddress=2420178944, vBaseEnvHwRegionSize=65536, vBaseEnvHwRegionType=RAM
            DAM1_NonCached: vBaseEnvHwRegionStartAddress=2957049856, vBaseEnvHwRegionSize=65536, vBaseEnvHwRegionType=RAM
            EMEM0_Cached: vBaseEnvHwRegionStartAddress=2566914048, vBaseEnvHwRegionSize=1048576, vBaseEnvHwRegionType=RAM
            EMEM0_NonCached: vBaseEnvHwRegionStartAddress=3103784960, vBaseEnvHwRegionSize=1048576, vBaseEnvHwRegionType=RAM
            EMEM1_Cached: vBaseEnvHwRegionStartAddress=2567962624, vBaseEnvHwRegionSize=1048576, vBaseEnvHwRegionType=RAM
            EMEM1_NonCached: vBaseEnvHwRegionStartAddress=3104833536, vBaseEnvHwRegionSize=1048576, vBaseEnvHwRegionType=RAM
            EMEM2_Cached: vBaseEnvHwRegionStartAddress=2569011200, vBaseEnvHwRegionSize=1048576, vBaseEnvHwRegionType=RAM
            EMEM2_NonCached: vBaseEnvHwRegionStartAddress=3105882112, vBaseEnvHwRegionSize=1048576, vBaseEnvHwRegionType=RAM
            EMEM3_Cached: vBaseEnvHwRegionStartAddress=2570059776, vBaseEnvHwRegionSize=1048576, vBaseEnvHwRegionType=RAM
            EMEM3_NonCached: vBaseEnvHwRegionStartAddress=3106930688, vBaseEnvHwRegionSize=1048576, vBaseEnvHwRegionType=RAM
            DFlash0: vBaseEnvHwRegionStartAddress=2936012800, vBaseEnvHwRegionSize=1048576, vBaseEnvHwRegionType=ROM
            DFlash1: vBaseEnvHwRegionStartAddress=2948595712, vBaseEnvHwRegionSize=131072, vBaseEnvHwRegionType=ROM
        TC399X_StepA: vBaseEnvCpuCoreAmount=6, vBaseEnvCpuMaxFrequency=300000000, vBaseEnvTestedDerivative=TC39x, vBaseEnvTestedDerivativeDescription=Infineon Aurix 2G TC39x Family, vBaseEnvAvailableChannels_Can=12, vBaseEnvAvailableChannels_Ethernet=1, vBaseEnvAvailableChannels_Flexray=4, vBaseEnvAvailableChannels_Lin=8
          vBaseEnvAdditionalParameters: vBaseEnvWatchdogGroup=B, vBaseEnvPllGroup=C, vBaseEnvPortGroup=B, vBaseEnvResetGroup=B, vBaseEnvDerivativeGroup=TC3xx
          62 x vBaseEnvMemLayoutHwRegion:
            DSPR0: vBaseEnvHwRegionStartAddress=1879048192, vBaseEnvHwRegionSize=245760, vBaseEnvHwRegionType=RAM
            PSPR0: vBaseEnvHwRegionStartAddress=1880096768, vBaseEnvHwRegionSize=65536, vBaseEnvHwRegionType=RAM
            DSPR1: vBaseEnvHwRegionStartAddress=1610612736, vBaseEnvHwRegionSize=245760, vBaseEnvHwRegionType=RAM
            PSPR1: vBaseEnvHwRegionStartAddress=1611661312, vBaseEnvHwRegionSize=65536, vBaseEnvHwRegionType=RAM
            DSPR2: vBaseEnvHwRegionStartAddress=1342177280, vBaseEnvHwRegionSize=98304, vBaseEnvHwRegionType=RAM
            PSPR2: vBaseEnvHwRegionStartAddress=1343225856, vBaseEnvHwRegionSize=65536, vBaseEnvHwRegionType=RAM
            DSPR3: vBaseEnvHwRegionStartAddress=1073741824, vBaseEnvHwRegionSize=98304, vBaseEnvHwRegionType=RAM
            PSPR3: vBaseEnvHwRegionStartAddress=1074790400, vBaseEnvHwRegionSize=98304, vBaseEnvHwRegionType=RAM
            DSPR4: vBaseEnvHwRegionStartAddress=805306368, vBaseEnvHwRegionSize=98304, vBaseEnvHwRegionType=RAM
            PSPR4: vBaseEnvHwRegionStartAddress=806354944, vBaseEnvHwRegionSize=98304, vBaseEnvHwRegionType=RAM
            DSPR5: vBaseEnvHwRegionSize=98304, vBaseEnvHwRegionStartAddress=268435456, vBaseEnvHwRegionType=RAM
            PSPR5: vBaseEnvHwRegionStartAddress=269484032, vBaseEnvHwRegionSize=98304, vBaseEnvHwRegionType=RAM
            PFlash0_Cached: vBaseEnvHwRegionStartAddress=2147483648, vBaseEnvHwRegionSize=3145728, vBaseEnvHwRegionType=ROM
            PFlash0_NonCached: vBaseEnvHwRegionStartAddress=2684354560, vBaseEnvHwRegionSize=3145728, vBaseEnvHwRegionType=ROM
            PFlash1_Cached: vBaseEnvHwRegionStartAddress=2150629376, vBaseEnvHwRegionSize=3145728, vBaseEnvHwRegionType=ROM
            PFlash1_NonCached: vBaseEnvHwRegionStartAddress=2687500288, vBaseEnvHwRegionSize=3145728, vBaseEnvHwRegionType=ROM
            PFlash2_Cached: vBaseEnvHwRegionStartAddress=2153775104, vBaseEnvHwRegionSize=3145728, vBaseEnvHwRegionType=ROM
            PFlash2_NonCached: vBaseEnvHwRegionStartAddress=2690646016, vBaseEnvHwRegionSize=3145728, vBaseEnvHwRegionType=ROM
            PFlash3_Cached: vBaseEnvHwRegionStartAddress=2156920832, vBaseEnvHwRegionSize=3145728, vBaseEnvHwRegionType=ROM
            PFlash3_NonCached: vBaseEnvHwRegionStartAddress=2693791744, vBaseEnvHwRegionSize=3145728, vBaseEnvHwRegionType=ROM
            PFlash4_Cached: vBaseEnvHwRegionStartAddress=2160066560, vBaseEnvHwRegionSize=3145728, vBaseEnvHwRegionType=ROM
            PFlash4_NonCached: vBaseEnvHwRegionStartAddress=2696937472, vBaseEnvHwRegionSize=3145728, vBaseEnvHwRegionType=ROM
            PFlash5_Cached: vBaseEnvHwRegionStartAddress=2163212288, vBaseEnvHwRegionSize=1048576, vBaseEnvHwRegionType=ROM
            PFlash5_NonCached: vBaseEnvHwRegionStartAddress=2700083200, vBaseEnvHwRegionSize=1048576, vBaseEnvHwRegionType=ROM
            LMU0_Cached: vBaseEnvHwRegionStartAddress=2416181248, vBaseEnvHwRegionSize=262144, vBaseEnvHwRegionType=RAM
            LMU0_NonCached: vBaseEnvHwRegionStartAddress=2953052160, vBaseEnvHwRegionSize=262144, vBaseEnvHwRegionType=RAM
            LMU1_Cached: vBaseEnvHwRegionStartAddress=2416443392, vBaseEnvHwRegionSize=262144, vBaseEnvHwRegionType=RAM
            LMU1_NonCached: vBaseEnvHwRegionStartAddress=2953314304, vBaseEnvHwRegionSize=262144, vBaseEnvHwRegionType=RAM
            LMU2_Cached: vBaseEnvHwRegionStartAddress=2416705536, vBaseEnvHwRegionSize=262144, vBaseEnvHwRegionType=RAM
            LMU2_NonCached: vBaseEnvHwRegionStartAddress=2953576448, vBaseEnvHwRegionSize=262144, vBaseEnvHwRegionType=RAM
            BMHD0: vBaseEnvHwRegionStartAddress=2940207104, vBaseEnvHwRegionSize=512, vBaseEnvHwRegionType=ROM
            BMHD1: vBaseEnvHwRegionStartAddress=2940207616, vBaseEnvHwRegionSize=512, vBaseEnvHwRegionType=ROM
            BMHD2: vBaseEnvHwRegionStartAddress=2940208128, vBaseEnvHwRegionSize=512, vBaseEnvHwRegionType=ROM
            BMHD3: vBaseEnvHwRegionStartAddress=2940208640, vBaseEnvHwRegionSize=512, vBaseEnvHwRegionType=ROM
            DLMU0_Cached: vBaseEnvHwRegionStartAddress=2415919104, vBaseEnvHwRegionSize=65536, vBaseEnvHwRegionType=RAM
            DLMU1_Cached: vBaseEnvHwRegionStartAddress=2415984640, vBaseEnvHwRegionSize=65536, vBaseEnvHwRegionType=RAM
            DLMU2_Cached: vBaseEnvHwRegionStartAddress=2416050176, vBaseEnvHwRegionSize=65536, vBaseEnvHwRegionType=RAM
            DLMU3_Cached: vBaseEnvHwRegionStartAddress=2416115712, vBaseEnvHwRegionSize=65536, vBaseEnvHwRegionType=RAM
            DLMU4_Cached: vBaseEnvHwRegionStartAddress=2416967680, vBaseEnvHwRegionSize=65536, vBaseEnvHwRegionType=RAM
            DLMU5_Cached: vBaseEnvHwRegionStartAddress=2417033216, vBaseEnvHwRegionSize=65536, vBaseEnvHwRegionType=RAM
            DLMU0_NonCached: vBaseEnvHwRegionStartAddress=2952790016, vBaseEnvHwRegionSize=65536, vBaseEnvHwRegionType=RAM
            DLMU1_NonCached: vBaseEnvHwRegionStartAddress=2952855552, vBaseEnvHwRegionSize=65536, vBaseEnvHwRegionType=RAM
            DLMU2_NonCached: vBaseEnvHwRegionStartAddress=2952921088, vBaseEnvHwRegionSize=65536, vBaseEnvHwRegionType=RAM
            DLMU3_NonCached: vBaseEnvHwRegionStartAddress=2952986624, vBaseEnvHwRegionSize=65536, vBaseEnvHwRegionType=RAM
            DLMU4_NonCached: vBaseEnvHwRegionStartAddress=2953838592, vBaseEnvHwRegionSize=65536, vBaseEnvHwRegionType=RAM
            DLMU5_NonCached: vBaseEnvHwRegionStartAddress=2953904128, vBaseEnvHwRegionSize=65536, vBaseEnvHwRegionType=RAM
            OLDA_Cached: vBaseEnvHwRegionStartAddress=2413821952, vBaseEnvHwRegionSize=524288, vBaseEnvHwRegionType=RAM
            OLDA_NonCached: vBaseEnvHwRegionStartAddress=2950692864, vBaseEnvHwRegionSize=524288, vBaseEnvHwRegionType=RAM
            DAM0_Cached: vBaseEnvHwRegionStartAddress=2420113408, vBaseEnvHwRegionSize=65536, vBaseEnvHwRegionType=RAM
            DAM0_NonCached: vBaseEnvHwRegionStartAddress=2956984320, vBaseEnvHwRegionSize=65536, vBaseEnvHwRegionType=RAM
            DAM1_Cached: vBaseEnvHwRegionStartAddress=2420178944, vBaseEnvHwRegionSize=65536, vBaseEnvHwRegionType=RAM
            DAM1_NonCached: vBaseEnvHwRegionStartAddress=2957049856, vBaseEnvHwRegionSize=65536, vBaseEnvHwRegionType=RAM
            EMEM0_Cached: vBaseEnvHwRegionStartAddress=2566914048, vBaseEnvHwRegionSize=1048576, vBaseEnvHwRegionType=RAM
            EMEM0_NonCached: vBaseEnvHwRegionStartAddress=3103784960, vBaseEnvHwRegionSize=1048576, vBaseEnvHwRegionType=RAM
            EMEM1_Cached: vBaseEnvHwRegionStartAddress=2567962624, vBaseEnvHwRegionSize=1048576, vBaseEnvHwRegionType=RAM
            EMEM1_NonCached: vBaseEnvHwRegionStartAddress=3104833536, vBaseEnvHwRegionSize=1048576, vBaseEnvHwRegionType=RAM
            EMEM2_Cached: vBaseEnvHwRegionStartAddress=2569011200, vBaseEnvHwRegionSize=1048576, vBaseEnvHwRegionType=RAM
            EMEM2_NonCached: vBaseEnvHwRegionStartAddress=3105882112, vBaseEnvHwRegionSize=1048576, vBaseEnvHwRegionType=RAM
            EMEM3_Cached: vBaseEnvHwRegionStartAddress=2570059776, vBaseEnvHwRegionSize=1048576, vBaseEnvHwRegionType=RAM
            EMEM3_NonCached: vBaseEnvHwRegionStartAddress=3106930688, vBaseEnvHwRegionSize=1048576, vBaseEnvHwRegionType=RAM
            DFlash0: vBaseEnvHwRegionStartAddress=2936012800, vBaseEnvHwRegionSize=1048576, vBaseEnvHwRegionType=ROM
            DFlash1: vBaseEnvHwRegionStartAddress=2948595712, vBaseEnvHwRegionSize=131072, vBaseEnvHwRegionType=ROM
        TC399X_StepB: vBaseEnvCpuCoreAmount=6, vBaseEnvCpuMaxFrequency=300000000, vBaseEnvTestedDerivative=TC39x, vBaseEnvTestedDerivativeDescription=Infineon Aurix 2G TC39x Family, vBaseEnvAvailableChannels_Can=12, vBaseEnvAvailableChannels_Ethernet=1, vBaseEnvAvailableChannels_Flexray=4, vBaseEnvAvailableChannels_Lin=12
          vBaseEnvAdditionalParameters: vBaseEnvWatchdogGroup=B, vBaseEnvPllGroup=B, vBaseEnvPortGroup=B, vBaseEnvResetGroup=B, vBaseEnvDerivativeGroup=TC3xx
          62 x vBaseEnvMemLayoutHwRegion:
            DSPR0: vBaseEnvHwRegionStartAddress=1879048192, vBaseEnvHwRegionSize=245760, vBaseEnvHwRegionType=RAM
            PSPR0: vBaseEnvHwRegionStartAddress=1880096768, vBaseEnvHwRegionSize=65536, vBaseEnvHwRegionType=RAM
            DSPR1: vBaseEnvHwRegionStartAddress=1610612736, vBaseEnvHwRegionSize=245760, vBaseEnvHwRegionType=RAM
            PSPR1: vBaseEnvHwRegionStartAddress=1611661312, vBaseEnvHwRegionSize=65536, vBaseEnvHwRegionType=RAM
            DSPR2: vBaseEnvHwRegionStartAddress=1342177280, vBaseEnvHwRegionSize=98304, vBaseEnvHwRegionType=RAM
            PSPR2: vBaseEnvHwRegionStartAddress=1343225856, vBaseEnvHwRegionSize=65536, vBaseEnvHwRegionType=RAM
            DSPR3: vBaseEnvHwRegionStartAddress=1073741824, vBaseEnvHwRegionSize=98304, vBaseEnvHwRegionType=RAM
            PSPR3: vBaseEnvHwRegionStartAddress=1074790400, vBaseEnvHwRegionSize=98304, vBaseEnvHwRegionType=RAM
            DSPR4: vBaseEnvHwRegionStartAddress=805306368, vBaseEnvHwRegionSize=98304, vBaseEnvHwRegionType=RAM
            PSPR4: vBaseEnvHwRegionStartAddress=806354944, vBaseEnvHwRegionSize=98304, vBaseEnvHwRegionType=RAM
            DSPR5: vBaseEnvHwRegionSize=98304, vBaseEnvHwRegionStartAddress=268435456, vBaseEnvHwRegionType=RAM
            PSPR5: vBaseEnvHwRegionStartAddress=269484032, vBaseEnvHwRegionSize=98304, vBaseEnvHwRegionType=RAM
            PFlash0_Cached: vBaseEnvHwRegionStartAddress=2147483648, vBaseEnvHwRegionSize=3145728, vBaseEnvHwRegionType=ROM
            PFlash0_NonCached: vBaseEnvHwRegionStartAddress=2684354560, vBaseEnvHwRegionSize=3145728, vBaseEnvHwRegionType=ROM
            PFlash1_Cached: vBaseEnvHwRegionStartAddress=2150629376, vBaseEnvHwRegionSize=3145728, vBaseEnvHwRegionType=ROM
            PFlash1_NonCached: vBaseEnvHwRegionStartAddress=2687500288, vBaseEnvHwRegionSize=3145728, vBaseEnvHwRegionType=ROM
            PFlash2_Cached: vBaseEnvHwRegionStartAddress=2153775104, vBaseEnvHwRegionSize=3145728, vBaseEnvHwRegionType=ROM
            PFlash2_NonCached: vBaseEnvHwRegionStartAddress=2690646016, vBaseEnvHwRegionSize=3145728, vBaseEnvHwRegionType=ROM
            PFlash3_Cached: vBaseEnvHwRegionStartAddress=2156920832, vBaseEnvHwRegionSize=3145728, vBaseEnvHwRegionType=ROM
            PFlash3_NonCached: vBaseEnvHwRegionStartAddress=2693791744, vBaseEnvHwRegionSize=3145728, vBaseEnvHwRegionType=ROM
            PFlash4_Cached: vBaseEnvHwRegionStartAddress=2160066560, vBaseEnvHwRegionSize=3145728, vBaseEnvHwRegionType=ROM
            PFlash4_NonCached: vBaseEnvHwRegionStartAddress=2696937472, vBaseEnvHwRegionSize=3145728, vBaseEnvHwRegionType=ROM
            PFlash5_Cached: vBaseEnvHwRegionStartAddress=2163212288, vBaseEnvHwRegionSize=1048576, vBaseEnvHwRegionType=ROM
            PFlash5_NonCached: vBaseEnvHwRegionStartAddress=2700083200, vBaseEnvHwRegionSize=1048576, vBaseEnvHwRegionType=ROM
            LMU0_Cached: vBaseEnvHwRegionStartAddress=2416181248, vBaseEnvHwRegionSize=262144, vBaseEnvHwRegionType=RAM
            LMU0_NonCached: vBaseEnvHwRegionStartAddress=2953052160, vBaseEnvHwRegionSize=262144, vBaseEnvHwRegionType=RAM
            LMU1_Cached: vBaseEnvHwRegionStartAddress=2416443392, vBaseEnvHwRegionSize=262144, vBaseEnvHwRegionType=RAM
            LMU1_NonCached: vBaseEnvHwRegionStartAddress=2953314304, vBaseEnvHwRegionSize=262144, vBaseEnvHwRegionType=RAM
            LMU2_Cached: vBaseEnvHwRegionStartAddress=2416705536, vBaseEnvHwRegionSize=262144, vBaseEnvHwRegionType=RAM
            LMU2_NonCached: vBaseEnvHwRegionStartAddress=2953576448, vBaseEnvHwRegionSize=262144, vBaseEnvHwRegionType=RAM
            BMHD0: vBaseEnvHwRegionStartAddress=2940207104, vBaseEnvHwRegionSize=512, vBaseEnvHwRegionType=ROM
            BMHD1: vBaseEnvHwRegionStartAddress=2940207616, vBaseEnvHwRegionSize=512, vBaseEnvHwRegionType=ROM
            BMHD2: vBaseEnvHwRegionStartAddress=2940208128, vBaseEnvHwRegionSize=512, vBaseEnvHwRegionType=ROM
            BMHD3: vBaseEnvHwRegionStartAddress=2940208640, vBaseEnvHwRegionSize=512, vBaseEnvHwRegionType=ROM
            DLMU0_Cached: vBaseEnvHwRegionStartAddress=2415919104, vBaseEnvHwRegionSize=65536, vBaseEnvHwRegionType=RAM
            DLMU1_Cached: vBaseEnvHwRegionStartAddress=2415984640, vBaseEnvHwRegionSize=65536, vBaseEnvHwRegionType=RAM
            DLMU2_Cached: vBaseEnvHwRegionStartAddress=2416050176, vBaseEnvHwRegionSize=65536, vBaseEnvHwRegionType=RAM
            DLMU3_Cached: vBaseEnvHwRegionStartAddress=2416115712, vBaseEnvHwRegionSize=65536, vBaseEnvHwRegionType=RAM
            DLMU4_Cached: vBaseEnvHwRegionStartAddress=2416967680, vBaseEnvHwRegionSize=65536, vBaseEnvHwRegionType=RAM
            DLMU5_Cached: vBaseEnvHwRegionStartAddress=2417033216, vBaseEnvHwRegionSize=65536, vBaseEnvHwRegionType=RAM
            DLMU0_NonCached: vBaseEnvHwRegionStartAddress=2952790016, vBaseEnvHwRegionSize=65536, vBaseEnvHwRegionType=RAM
            DLMU1_NonCached: vBaseEnvHwRegionStartAddress=2952855552, vBaseEnvHwRegionSize=65536, vBaseEnvHwRegionType=RAM
            DLMU2_NonCached: vBaseEnvHwRegionStartAddress=2952921088, vBaseEnvHwRegionSize=65536, vBaseEnvHwRegionType=RAM
            DLMU3_NonCached: vBaseEnvHwRegionStartAddress=2952986624, vBaseEnvHwRegionSize=65536, vBaseEnvHwRegionType=RAM
            DLMU4_NonCached: vBaseEnvHwRegionStartAddress=2953838592, vBaseEnvHwRegionSize=65536, vBaseEnvHwRegionType=RAM
            DLMU5_NonCached: vBaseEnvHwRegionStartAddress=2953904128, vBaseEnvHwRegionSize=65536, vBaseEnvHwRegionType=RAM
            OLDA_Cached: vBaseEnvHwRegionStartAddress=2413821952, vBaseEnvHwRegionSize=524288, vBaseEnvHwRegionType=RAM
            OLDA_NonCached: vBaseEnvHwRegionStartAddress=2950692864, vBaseEnvHwRegionSize=524288, vBaseEnvHwRegionType=RAM
            DAM0_Cached: vBaseEnvHwRegionStartAddress=2420113408, vBaseEnvHwRegionSize=65536, vBaseEnvHwRegionType=RAM
            DAM0_NonCached: vBaseEnvHwRegionStartAddress=2956984320, vBaseEnvHwRegionSize=65536, vBaseEnvHwRegionType=RAM
            DAM1_Cached: vBaseEnvHwRegionStartAddress=2420178944, vBaseEnvHwRegionSize=65536, vBaseEnvHwRegionType=RAM
            DAM1_NonCached: vBaseEnvHwRegionStartAddress=2957049856, vBaseEnvHwRegionSize=65536, vBaseEnvHwRegionType=RAM
            EMEM0_Cached: vBaseEnvHwRegionStartAddress=2566914048, vBaseEnvHwRegionSize=1048576, vBaseEnvHwRegionType=RAM
            EMEM0_NonCached: vBaseEnvHwRegionStartAddress=3103784960, vBaseEnvHwRegionSize=1048576, vBaseEnvHwRegionType=RAM
            EMEM1_Cached: vBaseEnvHwRegionStartAddress=2567962624, vBaseEnvHwRegionSize=1048576, vBaseEnvHwRegionType=RAM
            EMEM1_NonCached: vBaseEnvHwRegionStartAddress=3104833536, vBaseEnvHwRegionSize=1048576, vBaseEnvHwRegionType=RAM
            EMEM2_Cached: vBaseEnvHwRegionStartAddress=2569011200, vBaseEnvHwRegionSize=1048576, vBaseEnvHwRegionType=RAM
            EMEM2_NonCached: vBaseEnvHwRegionStartAddress=3105882112, vBaseEnvHwRegionSize=1048576, vBaseEnvHwRegionType=RAM
            EMEM3_Cached: vBaseEnvHwRegionStartAddress=2570059776, vBaseEnvHwRegionSize=1048576, vBaseEnvHwRegionType=RAM
            EMEM3_NonCached: vBaseEnvHwRegionStartAddress=3106930688, vBaseEnvHwRegionSize=1048576, vBaseEnvHwRegionType=RAM
            DFlash0: vBaseEnvHwRegionStartAddress=2936012800, vBaseEnvHwRegionSize=1048576, vBaseEnvHwRegionType=ROM
            DFlash1: vBaseEnvHwRegionStartAddress=2948595712, vBaseEnvHwRegionSize=131072, vBaseEnvHwRegionType=ROM
        TC3E7Q: vBaseEnvCpuCoreAmount=4, vBaseEnvCpuMaxFrequency=300000000, vBaseEnvTestedDerivative=TC38x, vBaseEnvTestedDerivativeDescription=Infineon Aurix 2G TC38x Family, vBaseEnvAvailableChannels_Can=20, vBaseEnvAvailableChannels_Ethernet=1, vBaseEnvAvailableChannels_Flexray=4, vBaseEnvAvailableChannels_Lin=24
          vBaseEnvAdditionalParameters: vBaseEnvWatchdogGroup=B, vBaseEnvPllGroup=B, vBaseEnvPortGroup=B, vBaseEnvResetGroup=B, vBaseEnvDerivativeGroup=TC3xx
          36 x vBaseEnvMemLayoutHwRegion:
            DSPR0: vBaseEnvHwRegionStartAddress=1879048192, vBaseEnvHwRegionSize=245760, vBaseEnvHwRegionType=RAM
            PSPR0: vBaseEnvHwRegionStartAddress=1880096768, vBaseEnvHwRegionSize=65536, vBaseEnvHwRegionType=RAM
            DSPR1: vBaseEnvHwRegionStartAddress=1610612736, vBaseEnvHwRegionSize=245760, vBaseEnvHwRegionType=RAM
            PSPR1: vBaseEnvHwRegionStartAddress=1611661312, vBaseEnvHwRegionSize=65536, vBaseEnvHwRegionType=RAM
            DSPR2: vBaseEnvHwRegionStartAddress=1342177280, vBaseEnvHwRegionSize=98304, vBaseEnvHwRegionType=RAM
            PSPR2: vBaseEnvHwRegionStartAddress=1343225856, vBaseEnvHwRegionSize=65536, vBaseEnvHwRegionType=RAM
            DSPR3: vBaseEnvHwRegionStartAddress=1073741824, vBaseEnvHwRegionSize=98304, vBaseEnvHwRegionType=RAM
            PSPR3: vBaseEnvHwRegionStartAddress=1074790400, vBaseEnvHwRegionSize=65536, vBaseEnvHwRegionType=RAM
            PFlash0_Cached: vBaseEnvHwRegionStartAddress=2147483648, vBaseEnvHwRegionSize=3145728, vBaseEnvHwRegionType=ROM
            PFlash0_NonCached: vBaseEnvHwRegionStartAddress=2684354560, vBaseEnvHwRegionSize=3145728, vBaseEnvHwRegionType=ROM
            PFlash1_Cached: vBaseEnvHwRegionStartAddress=2150629376, vBaseEnvHwRegionSize=3145728, vBaseEnvHwRegionType=ROM
            PFlash1_NonCached: vBaseEnvHwRegionStartAddress=2687500288, vBaseEnvHwRegionSize=3145728, vBaseEnvHwRegionType=ROM
            PFlash2_Cached: vBaseEnvHwRegionStartAddress=2153775104, vBaseEnvHwRegionSize=3145728, vBaseEnvHwRegionType=ROM
            PFlash2_NonCached: vBaseEnvHwRegionStartAddress=2690646016, vBaseEnvHwRegionSize=3145728, vBaseEnvHwRegionType=ROM
            PFlash3_Cached: vBaseEnvHwRegionStartAddress=2156920832, vBaseEnvHwRegionSize=3145728, vBaseEnvHwRegionType=ROM
            PFlash3_NonCached: vBaseEnvHwRegionStartAddress=2693791744, vBaseEnvHwRegionSize=3145728, vBaseEnvHwRegionType=ROM
            LMU0_Cached: vBaseEnvHwRegionStartAddress=2416181248, vBaseEnvHwRegionSize=262144, vBaseEnvHwRegionType=RAM
            LMU0_NonCached: vBaseEnvHwRegionStartAddress=2953052160, vBaseEnvHwRegionSize=262144, vBaseEnvHwRegionType=RAM
            BMHD0: vBaseEnvHwRegionStartAddress=2940207104, vBaseEnvHwRegionSize=512, vBaseEnvHwRegionType=ROM
            BMHD1: vBaseEnvHwRegionStartAddress=2940207616, vBaseEnvHwRegionSize=512, vBaseEnvHwRegionType=ROM
            BMHD2: vBaseEnvHwRegionStartAddress=2940208128, vBaseEnvHwRegionSize=512, vBaseEnvHwRegionType=ROM
            BMHD3: vBaseEnvHwRegionStartAddress=2940208640, vBaseEnvHwRegionSize=512, vBaseEnvHwRegionType=ROM
            OLDA_Cached: vBaseEnvHwRegionStartAddress=2413821952, vBaseEnvHwRegionSize=524288, vBaseEnvHwRegionType=RAM
            OLDA_NonCached: vBaseEnvHwRegionStartAddress=2950692864, vBaseEnvHwRegionSize=524288, vBaseEnvHwRegionType=RAM
            DLMU0_Cached: vBaseEnvHwRegionStartAddress=2415919104, vBaseEnvHwRegionSize=65536, vBaseEnvHwRegionType=RAM
            DLMU0_NonCached: vBaseEnvHwRegionStartAddress=2952790016, vBaseEnvHwRegionSize=65536, vBaseEnvHwRegionType=RAM
            DLMU1_Cached: vBaseEnvHwRegionStartAddress=2415984640, vBaseEnvHwRegionSize=65536, vBaseEnvHwRegionType=RAM
            DLMU1_NonCached: vBaseEnvHwRegionStartAddress=2952855552, vBaseEnvHwRegionSize=65536, vBaseEnvHwRegionType=RAM
            DLMU2_Cached: vBaseEnvHwRegionStartAddress=2416050176, vBaseEnvHwRegionSize=65536, vBaseEnvHwRegionType=RAM
            DLMU2_NonCached: vBaseEnvHwRegionStartAddress=2952921088, vBaseEnvHwRegionSize=65536, vBaseEnvHwRegionType=RAM
            DLMU3_Cached: vBaseEnvHwRegionStartAddress=2416115712, vBaseEnvHwRegionSize=65536, vBaseEnvHwRegionType=RAM
            DLMU3_NonCached: vBaseEnvHwRegionStartAddress=2952986624, vBaseEnvHwRegionSize=65536, vBaseEnvHwRegionType=RAM
            DAM0_Cached: vBaseEnvHwRegionStartAddress=2956984320, vBaseEnvHwRegionSize=65536, vBaseEnvHwRegionType=RAM
            DAM0_NonCached: vBaseEnvHwRegionStartAddress=2420113408, vBaseEnvHwRegionSize=65536, vBaseEnvHwRegionType=RAM
            DFlash0: vBaseEnvHwRegionStartAddress=2936012800, vBaseEnvHwRegionSize=524288, vBaseEnvHwRegionType=ROM
            DFlash1: vBaseEnvHwRegionStartAddress=2948595712, vBaseEnvHwRegionSize=131072, vBaseEnvHwRegionType=ROM
      62 x vBaseEnvMemLayoutHwRegion:
        DSPR0
        PSPR0
        DSPR1
        PSPR1
        DSPR2
        PSPR2
        DSPR3
        PSPR3
        DSPR4
        PSPR4
        DSPR5
        PSPR5
        PFlash0_Cached
        PFlash0_NonCached
        PFlash1_Cached
        PFlash1_NonCached
        PFlash2_Cached
        PFlash2_NonCached
        PFlash3_Cached
        PFlash3_NonCached
        PFlash4_Cached
        PFlash4_NonCached
        PFlash5_Cached
        PFlash5_NonCached
        LMU0_Cached
        LMU0_NonCached
        LMU1_Cached
        LMU1_NonCached
        LMU2_Cached
        LMU2_NonCached
        BMHD{0..3}
        DLMU{0..5}_Cached
        DLMU{0..5}_NonCached
        OLDA_Cached
        OLDA_NonCached
        DAM0_Cached
        DAM0_NonCached
        DAM1_Cached
        DAM1_NonCached
        EMEM0_Cached
        EMEM0_NonCached
        EMEM1_Cached
        EMEM1_NonCached
        EMEM2_Cached
        EMEM2_NonCached
        EMEM3_Cached
        EMEM3_NonCached
        DFlash0
        DFlash1
  module config vLinkGen: implementation-config-variant=VARIANT-PRE-COMPILE, module-description=vLinkGen_Impl
    vLinkGenMemLayout
      MemRegion_BMHD0 (vLinkGenMemoryRegion):
        vLinkGenMemoryRegionAddrOffset = 0
        vLinkGenMemoryRegionSize = 512
        vLinkGenMemoryRegionAddress = 2940207104
        vLinkGenMemoryRegionAvailable = true
        vLinkGenMemoryRegionHwRegion = vBaseEnvGeneral/BMHD0
        BMHD0 (vLinkGenMemoryRegionBlock):
          vLinkGenMemoryRegionBlockPosition = 0
          vLinkGenMemoryRegionBlockSize = 512
          vLinkGenMemoryRegionBlockAddress = 2940207104
          vLinkGenMemoryRegionBlockBoundary = LOWER
          vLinkGenMemoryRegionBlockInitStage = NONE
      Brs_ExcVect_START (vLinkGenLogicalSymbolGroup):
        vLinkGenSymbolGroupPosition = 5
        vLinkGenSymbolGroupVariant = vLinkGenVariantHandling/DemoFbl
        vLinkGenSymbolGroupVariant = vLinkGenVariantHandling/DemoAppl
        vLinkGenLinkerSymbol: vLinkGenLinkerSymbolPosition=0, vLinkGenLinkerSymbolName=_Brs_ExcVect_START, vLinkGenLinkerSymbolValue=_Brs_ExcVectRam_ROM_START
      BMHD0 (vLinkGenLogicalConstGroup):
        vLinkGenConstGroupPosition = 5
        vLinkGenConstGroupRegion = MemRegion_BMHD0/BMHD0
        vLinkGenConstGroupVariant = vLinkGenVariantHandling/DemoFbl
        vLinkGenConstGroupVariant = DemoBm
        BMHD0 (vLinkGenConstSectionGroup):
          vLinkGenConstSectionGroupPosition = 0
          vLinkGenConstSectionGroupInit = NONE
          vLinkGenConstSectionGroupInitStage = ONE
          vLinkGenConstSectionGroupRef = vLinkGenLinkerSections/BMHD0
      4 x vLinkGenLogicalSymbolGroup:
        HEAPWORKAROUNDLABEL: vLinkGenSymbolGroupPosition=5
          HeapWorkaroundLabel (vLinkGenLinkerSymbol): vLinkGenLinkerSymbolName=__HEAP, vLinkGenLinkerSymbolValue=8, vLinkGenLinkerSymbolPosition=0
          HeapWorkaroundLabelEnd (vLinkGenLinkerSymbol): vLinkGenLinkerSymbolName=__HEAP_END, vLinkGenLinkerSymbolValue=8, vLinkGenLinkerSymbolPosition=0
        FlashDrvSymbols: vLinkGenSymbolGroupPosition=4096, vLinkGenSymbolGroupVariant=FlashDrv
          StartupEntry (vLinkGenLinkerSymbol): vLinkGenLinkerSymbolPosition=0, vLinkGenLinkerSymbolName=brsStartupEntry, vLinkGenLinkerSymbolValue=0
        TargetCompilerSpecificOptions_FlashDrv: vLinkGenSymbolGroupPosition=4096, vLinkGenSymbolGroupVariant=FlashDrv
          StartupEntry (vLinkGenLinkerSymbol): vLinkGenLinkerSymbolPosition=0, vLinkGenLinkerSymbolName=brsStartupEntry, vLinkGenLinkerSymbolValue=0
        Startup_Labels: vLinkGenSymbolGroupPosition=5, vLinkGenSymbolGroupVariant=DemoBm, vLinkGenSymbolGroupVariant=vLinkGenVariantHandling/DemoFbl, vLinkGenSymbolGroupVariant=vLinkGenVariantHandling/DemoAppl
          7 x vLinkGenLinkerSymbol, all with vLinkGenLinkerSymbolValue=Brs_ApplicationEntry, vLinkGenLinkerSymbolPosition=0:
            Startup_Labels1: vLinkGenLinkerSymbolName=StartupEntry
            Startup_Labels2: vLinkGenLinkerSymbolName=_start_tc0
            Startup_Labels3: vLinkGenLinkerSymbolName=_start_tc1
            Startup_Labels4: vLinkGenLinkerSymbolName=_start_tc2
            Startup_Labels5: vLinkGenLinkerSymbolName=_start_tc3
            Startup_Labels6: vLinkGenLinkerSymbolName=_start_tc4
            Startup_Labels7: vLinkGenLinkerSymbolName=_start_tc5
      19 x vLinkGenLogicalConstGroup:
        FblRamCode: vLinkGenConstGroupPosition=1, vLinkGenConstGroupInitCore=0, vLinkGenConstGroupVariant=vLinkGenVariantHandling/DemoFbl, vLinkGenConstGroupVariant=DemoBm, vLinkGenConstGroupContentType=RAM_CODE, vLinkGenConstGroupRegion=BmRomArea, vLinkGenConstGroupRamRegion=DefaultRamArea, vLinkGenConstGroupVariant=vLinkGenVariantHandling/DemoAppl
          RamCodeSection (vLinkGenConstSectionGroup):
            vLinkGenConstSectionGroupPosition = 0
            vLinkGenConstSectionGroupInit = COPY_TO_RAM
            vLinkGenConstSectionGroupInitStage = ONE
            vLinkGenConstSectionGroupAlignment = 4
            vLinkGenConstSectionGroupEndAlignment = 4
            vLinkGenConstSectionGroupRef = RamCodeCoreSection
          vLinkGenConstGroupVariantHandling
            DemoFbl (vLinkGenConstGroupVariantSpecifics): vLinkGenConstGroupSpecificRegion=FblRomArea, vLinkGenConstGroupSpecificVariant=vLinkGenVariantHandling/DemoFbl
            DemoAppl (vLinkGenConstGroupVariantSpecifics): vLinkGenConstGroupSpecificRegion=ApplRomArea, vLinkGenConstGroupSpecificVariant=vLinkGenVariantHandling/DemoAppl
        FblRamConst: vLinkGenConstGroupPosition=0, vLinkGenConstGroupInitCore=0, vLinkGenConstGroupVariant=vLinkGenVariantHandling/DemoFbl, vLinkGenConstGroupVariant=DemoBm, vLinkGenConstGroupContentType=RAM_CONST, vLinkGenConstGroupRegion=BmRomArea, vLinkGenConstGroupRamRegion=DefaultRamArea, vLinkGenConstGroupVariant=vLinkGenVariantHandling/DemoAppl
          RamConstSection (vLinkGenConstSectionGroup):
            vLinkGenConstSectionGroupPosition = 0
            vLinkGenConstSectionGroupInit = COPY_TO_RAM
            vLinkGenConstSectionGroupInitStage = ONE
            vLinkGenConstSectionGroupAlignment = 4
            vLinkGenConstSectionGroupEndAlignment = 4
            vLinkGenConstSectionGroupRef = vLinkGenLinkerSections/RamConstSection
          vLinkGenConstGroupVariantHandling
            DemoFbl (vLinkGenConstGroupVariantSpecifics): vLinkGenConstGroupSpecificRegion=FblRomArea, vLinkGenConstGroupSpecificVariant=vLinkGenVariantHandling/DemoFbl
            DemoAppl (vLinkGenConstGroupVariantSpecifics): vLinkGenConstGroupSpecificRegion=ApplRomArea, vLinkGenConstGroupSpecificVariant=vLinkGenVariantHandling/DemoAppl
        MSR_CODE: vLinkGenConstGroupPosition=50, vLinkGenConstGroupContentType=GLOBAL_CODE, vLinkGenConstGroupVariant=vLinkGenVariantHandling/DemoFbl, vLinkGenConstGroupVariant=DemoBm, vLinkGenConstGroupVariant=vLinkGenVariantHandling/DemoAppl, vLinkGenConstGroupRegion=BmRomArea
          MSR_CODE (vLinkGenConstSectionGroup):
            vLinkGenConstSectionGroupPosition = 0
            vLinkGenConstSectionGroupInit = NONE
            vLinkGenConstSectionGroupInitStage = ONE
            vLinkGenConstSectionGroupRef = vLinkGenLinkerSections/MSR_CODE
          vLinkGenConstGroupVariantHandling
            DemoFbl (vLinkGenConstGroupVariantSpecifics): vLinkGenConstGroupSpecificRegion=FblRomArea, vLinkGenConstGroupSpecificVariant=vLinkGenVariantHandling/DemoFbl
            DemoAppl (vLinkGenConstGroupVariantSpecifics): vLinkGenConstGroupSpecificRegion=ApplRomArea, vLinkGenConstGroupSpecificVariant=vLinkGenVariantHandling/DemoAppl
        MSR_CONST: vLinkGenConstGroupPosition=50, vLinkGenConstGroupContentType=GLOBAL_CONST, vLinkGenConstGroupVariant=vLinkGenVariantHandling/DemoFbl, vLinkGenConstGroupVariant=DemoBm, vLinkGenConstGroupVariant=vLinkGenVariantHandling/DemoAppl, vLinkGenConstGroupRegion=BmRomArea
          MSR_CONST (vLinkGenConstSectionGroup):
            vLinkGenConstSectionGroupPosition = 0
            vLinkGenConstSectionGroupInit = NONE
            vLinkGenConstSectionGroupInitStage = ONE
            vLinkGenConstSectionGroupRef = vLinkGenLinkerSections/MSR_CONST
            vLinkGenConstSectionGroupRef = MSR_CONST_FAST
          vLinkGenConstGroupVariantHandling
            DemoFbl (vLinkGenConstGroupVariantSpecifics): vLinkGenConstGroupSpecificRegion=FblRomArea, vLinkGenConstGroupSpecificVariant=vLinkGenVariantHandling/DemoFbl
            DemoAppl (vLinkGenConstGroupVariantSpecifics): vLinkGenConstGroupSpecificRegion=ApplRomArea, vLinkGenConstGroupSpecificVariant=vLinkGenVariantHandling/DemoAppl
        MSR_PBCFG_CONST: vLinkGenConstGroupPosition=50, vLinkGenConstGroupContentType=GLOBAL_CONST, vLinkGenConstGroupVariant=vLinkGenVariantHandling/DemoFbl, vLinkGenConstGroupVariant=DemoBm, vLinkGenConstGroupVariant=vLinkGenVariantHandling/DemoAppl, vLinkGenConstGroupRegion=BmRomArea
          MSR_PBCFG_CONST (vLinkGenConstSectionGroup):
            vLinkGenConstSectionGroupPosition = 0
            vLinkGenConstSectionGroupInit = NONE
            vLinkGenConstSectionGroupInitStage = ONE
            vLinkGenConstSectionGroupRef = vLinkGenLinkerSections/MSR_PBCFG_CONST
            vLinkGenConstSectionGroupRef = MSR_PBCFG_CONST_FAST
          vLinkGenConstGroupVariantHandling
            DemoFbl (vLinkGenConstGroupVariantSpecifics): vLinkGenConstGroupSpecificRegion=FblRomArea, vLinkGenConstGroupSpecificVariant=vLinkGenVariantHandling/DemoFbl
            DemoAppl (vLinkGenConstGroupVariantSpecifics): vLinkGenConstGroupSpecificRegion=ApplRomArea, vLinkGenConstGroupSpecificVariant=vLinkGenVariantHandling/DemoAppl
        Brs_ExcVectRam: vLinkGenConstGroupInitCore=0, vLinkGenConstGroupPosition=5, vLinkGenConstGroupContentType=RAM_CONST, vLinkGenConstGroupRegion=BmRomArea, vLinkGenConstGroupRamRegion=DefaultRamArea, vLinkGenConstGroupVariant=vLinkGenVariantHandling/DemoFbl, vLinkGenConstGroupVariant=vLinkGenVariantHandling/DemoAppl
          Brs_ExcVectRam (vLinkGenConstSectionGroup):
            vLinkGenConstSectionGroupAlignment = 256
            vLinkGenConstSectionGroupEndAlignment = 8
            vLinkGenConstSectionGroupGapSize = 16
            vLinkGenConstSectionGroupInit = COPY_TO_RAM
            vLinkGenConstSectionGroupInitStage = ONE
            vLinkGenConstSectionGroupPosition = 0
            vLinkGenConstSectionGroupRef = brsExcVectRam
          vLinkGenConstGroupVariantHandling
            DemoFbl (vLinkGenConstGroupVariantSpecifics): vLinkGenConstGroupSpecificRegion=FblRomArea, vLinkGenConstGroupSpecificVariant=vLinkGenVariantHandling/DemoFbl
            DemoAppl (vLinkGenConstGroupVariantSpecifics): vLinkGenConstGroupSpecificRegion=ApplRomArea, vLinkGenConstGroupSpecificVariant=vLinkGenVariantHandling/DemoAppl
        Brs_ExcVect: vLinkGenConstGroupPosition=2, vLinkGenConstGroupContentType=GLOBAL_EXCVEC_CONST, vLinkGenConstGroupVariant=DemoBm, vLinkGenConstGroupRegion=BmRom_Startup
          Brs_ExcVect (vLinkGenConstSectionGroup):
            vLinkGenConstSectionGroupAlignment = 256
            vLinkGenConstSectionGroupEndAlignment = 8
            vLinkGenConstSectionGroupGapSize = 16
            vLinkGenConstSectionGroupPosition = 0
            vLinkGenConstSectionGroupInit = NONE
            vLinkGenConstSectionGroupInitStage = ONE
            vLinkGenConstSectionGroupRef = brsExcVect
            vLinkGenConstSectionGroupRef = brsExcVectConst
        Brs_Startup_Code: vLinkGenConstGroupPosition=1, vLinkGenConstGroupContentType=STARTUP_CODE, vLinkGenConstGroupVariant=DemoBm, vLinkGenConstGroupRegion=BmRom_Startup, vLinkGenConstGroupVariant=vLinkGenVariantHandling/DemoFbl, vLinkGenConstGroupVariant=vLinkGenVariantHandling/DemoAppl
          Brs_Startup_Code (vLinkGenConstSectionGroup):
            vLinkGenConstSectionGroupPosition = 0
            vLinkGenConstSectionGroupInit = NONE
            vLinkGenConstSectionGroupInitStage = ONE
            vLinkGenConstSectionGroupRef = brsStartup
          BrsMain_Startup_Code (vLinkGenConstSectionGroup):
            vLinkGenConstSectionGroupPosition = 0
            vLinkGenConstSectionGroupInit = NONE
            vLinkGenConstSectionGroupInitStage = ONE
            vLinkGenConstSectionGroupRef = brsMainStartup
          vLinkGenConstGroupVariantHandling
            DemoAppl (vLinkGenConstGroupVariantSpecifics): vLinkGenConstGroupSpecificRegion=ApplStartupCode_FirstExecInst, vLinkGenConstGroupSpecificVariant=vLinkGenVariantHandling/DemoAppl
            DemoFbl (vLinkGenConstGroupVariantSpecifics): vLinkGenConstGroupSpecificRegion=FblRomStartup, vLinkGenConstGroupSpecificVariant=vLinkGenVariantHandling/DemoFbl
        Brs_Shared_Const: vLinkGenConstGroupPosition=5, vLinkGenConstGroupContentType=GLOBAL_CONST, vLinkGenConstGroupVariant=DemoBm, vLinkGenConstGroupVariant=vLinkGenVariantHandling/DemoFbl, vLinkGenConstGroupVariant=vLinkGenVariantHandling/DemoAppl, vLinkGenConstGroupRegion=BmRomArea
          Brs_Shared_Const (vLinkGenConstSectionGroup):
            vLinkGenConstSectionGroupPosition = 0
            vLinkGenConstSectionGroupInit = NONE
            vLinkGenConstSectionGroupInitStage = ONE
            vLinkGenConstSectionGroupRef = brsSharedConst
          vLinkGenConstGroupVariantHandling
            DemoAppl (vLinkGenConstGroupVariantSpecifics): vLinkGenConstGroupSpecificVariant=vLinkGenVariantHandling/DemoAppl, vLinkGenConstGroupSpecificRegion=ApplRomArea
        Const_Default: vLinkGenConstGroupPosition=1000, vLinkGenConstGroupRegion=BmRomArea, vLinkGenConstGroupVariant=vLinkGenVariantHandling/DemoFbl, vLinkGenConstGroupVariant=DemoBm, vLinkGenConstGroupVariant=vLinkGenVariantHandling/DemoAppl, vLinkGenConstGroupContentType=GLOBAL_CONST
          vLinkGenConstGroupVariantHandling
            DemoFbl (vLinkGenConstGroupVariantSpecifics): vLinkGenConstGroupSpecificRegion=FblRomArea, vLinkGenConstGroupSpecificVariant=vLinkGenVariantHandling/DemoFbl
            DemoAppl (vLinkGenConstGroupVariantSpecifics): vLinkGenConstGroupSpecificRegion=ApplRomArea, vLinkGenConstGroupSpecificVariant=vLinkGenVariantHandling/DemoAppl
          6 x vLinkGenConstSectionGroup, all with vLinkGenConstSectionGroupPosition=0, vLinkGenConstSectionGroupInit=NONE, vLinkGenConstSectionGroupInitStage=ONE:
            text: vLinkGenConstSectionGroupFlag=vLinkGenConstGroupFlags/EXECUTE, vLinkGenConstSectionGroupRef=vLinkGenLinkerSections/text, vLinkGenConstSectionGroupRef=text_all
            text_vle: vLinkGenConstSectionGroupFlag=vLinkGenConstGroupFlags/EXECUTE, vLinkGenConstSectionGroupFlag=VLE_CODE, vLinkGenConstSectionGroupRef=vLinkGenLinkerSections/text_vle, vLinkGenConstSectionGroupRef=text_vle_all
            rodata: vLinkGenConstSectionGroupFlag=vLinkGenConstGroupFlags/READ, vLinkGenConstSectionGroupRef=vLinkGenLinkerSections/rodata, vLinkGenConstSectionGroupRef=rodata_all
            srodata: vLinkGenConstSectionGroupFlag=vLinkGenConstGroupFlags/READ, vLinkGenConstSectionGroupFlag=vLinkGenConstGroupFlags/SMALL_ADDRESSING, vLinkGenConstSectionGroupRef=vLinkGenLinkerSections/srodata, vLinkGenConstSectionGroupRef=srodata_all
            zrodata: vLinkGenConstSectionGroupFlag=vLinkGenConstGroupFlags/READ, vLinkGenConstSectionGroupFlag=vLinkGenConstGroupFlags/ABSOLUTE_ADDRESSING, vLinkGenConstSectionGroupRef=vLinkGenLinkerSections/zrodata, vLinkGenConstSectionGroupRef=zrodata_all
            sdata2: vLinkGenConstSectionGroupFlag=vLinkGenConstGroupFlags/READ, vLinkGenConstSectionGroupFlag=vLinkGenConstGroupFlags/SMALL_ADDRESSING, vLinkGenConstSectionGroupRef=vLinkGenLinkerSections/sdata2, vLinkGenConstSectionGroupRef=sdata2_all
        Fbl_FblHeader: vLinkGenConstGroupPosition=0, vLinkGenConstGroupRegion=FblHeader, vLinkGenConstGroupVariant=vLinkGenVariantHandling/DemoFbl
          FblHeaderSectionGroup (vLinkGenConstSectionGroup):
            vLinkGenConstSectionGroupPosition = 0
            vLinkGenConstSectionGroupInit = NONE
            vLinkGenConstSectionGroupInitStage = ONE
            vLinkGenConstSectionGroupRef = FblHeaderSection
        FblAppl_BmHdrHeader: vLinkGenConstGroupPosition=0, vLinkGenConstGroupRegion=Rom_FblMemoryArea/FblBmHdrHeader, vLinkGenConstGroupVariant=vLinkGenVariantHandling/DemoFbl, vLinkGenConstGroupVariant=vLinkGenVariantHandling/DemoAppl
          FblBmHdrHeaderGroup (vLinkGenConstSectionGroup):
            vLinkGenConstSectionGroupPosition = 0
            vLinkGenConstSectionGroupInit = NONE
            vLinkGenConstSectionGroupInitStage = ONE
            vLinkGenConstSectionGroupRef = BmHdrHeaderSection
          vLinkGenConstGroupVariantHandling
            DemoFbl (vLinkGenConstGroupVariantSpecifics): vLinkGenConstGroupSpecificRegion=Rom_FblMemoryArea/FblBmHdrHeader, vLinkGenConstGroupSpecificVariant=vLinkGenVariantHandling/DemoFbl
            DemoAppl (vLinkGenConstGroupVariantSpecifics): vLinkGenConstGroupSpecificRegion=ApplBmHdrHeader, vLinkGenConstGroupSpecificVariant=vLinkGenVariantHandling/DemoAppl
        Fbl_PresencePattern: vLinkGenConstGroupPosition=0, vLinkGenConstGroupRegion=FblBlockValPresencePattern, vLinkGenConstGroupVariant=vLinkGenVariantHandling/DemoFbl
          Fbl_PP (vLinkGenConstSectionGroup):
            vLinkGenConstSectionGroupPosition = 0
            vLinkGenConstSectionGroupInit = NONE
            vLinkGenConstSectionGroupInitStage = HARD_RESET_ONLY
            vLinkGenConstSectionGroupRef = FblPresencePatternSection
        Appl_ApplVect: vLinkGenConstGroupPosition=5, vLinkGenConstGroupRegion=ApplVect, vLinkGenConstGroupVariant=vLinkGenVariantHandling/DemoFbl, vLinkGenConstGroupVariant=vLinkGenVariantHandling/DemoAppl
          APPLVECT (vLinkGenConstSectionGroup):
            vLinkGenConstSectionGroupSize = 8
            vLinkGenConstSectionGroupAlignment = 4
            vLinkGenConstSectionGroupPosition = 0
            vLinkGenConstSectionGroupInit = NONE
            vLinkGenConstSectionGroupInitStage = ONE
            vLinkGenConstSectionGroupRef = ApplVectSection
        Bm_BmHeader: vLinkGenConstGroupPosition=0, vLinkGenConstGroupRegion=BmHeader, vLinkGenConstGroupVariant=DemoBm
          BmHeaderSectionGroup (vLinkGenConstSectionGroup):
            vLinkGenConstSectionGroupPosition = 0
            vLinkGenConstSectionGroupInit = NONE
            vLinkGenConstSectionGroupInitStage = ONE
            vLinkGenConstSectionGroupRef = BmHeaderSection
        FlashDrv_Header: vLinkGenConstGroupPosition=0, vLinkGenConstGroupVariant=FlashDrv, vLinkGenConstGroupRegion=FlashDrvArea
          FlashDrvHeaderSectionGroup (vLinkGenConstSectionGroup):
            vLinkGenConstSectionGroupPosition = 0
            vLinkGenConstSectionGroupInit = NONE
            vLinkGenConstSectionGroupInitStage = ONE
            vLinkGenConstSectionGroupRef = FlashDrvHeaderSection
        FlashDrv_Code: vLinkGenConstGroupPosition=500, vLinkGenConstGroupRegion=FlashDrvArea, vLinkGenConstGroupVariant=FlashDrv
          FlashDrv_CodeGroup (vLinkGenConstSectionGroup):
            vLinkGenConstSectionGroupPosition = 0
            vLinkGenConstSectionGroupInit = NONE
            vLinkGenConstSectionGroupInitStage = ONE
            vLinkGenConstSectionGroupRef = vLinkGenLinkerSections/text
            vLinkGenConstSectionGroupRef = text_all
            vLinkGenConstSectionGroupRef = vLinkGenLinkerSections/text_vle
            vLinkGenConstSectionGroupRef = text_vle_all
            vLinkGenConstSectionGroupFlag = vLinkGenConstGroupFlags/EXECUTE
        FlashDrv_Const: vLinkGenConstGroupPosition=500, vLinkGenConstGroupRegion=FlashDrvArea, vLinkGenConstGroupVariant=FlashDrv
          FlashDrv_ConstGroup (vLinkGenConstSectionGroup):
            vLinkGenConstSectionGroupPosition = 0
            vLinkGenConstSectionGroupInit = NONE
            vLinkGenConstSectionGroupInitStage = ONE
            vLinkGenConstSectionGroupRef = vLinkGenLinkerSections/rodata
            vLinkGenConstSectionGroupRef = rodata_all
            vLinkGenConstSectionGroupRef = vLinkGenLinkerSections/srodata
            vLinkGenConstSectionGroupRef = srodata_all
            vLinkGenConstSectionGroupRef = vLinkGenLinkerSections/zrodata
            vLinkGenConstSectionGroupRef = zrodata_all
            vLinkGenConstSectionGroupRef = vLinkGenLinkerSections/sdata2
            vLinkGenConstSectionGroupRef = sdata2_all
        FlashDrv_SpecialCode: vLinkGenConstGroupPosition=500, vLinkGenConstGroupRegion=FlashDrvArea, vLinkGenConstGroupVariant=FlashDrv
          FlashDrv_SpecialCodeGroup (vLinkGenConstSectionGroup):
            vLinkGenConstSectionGroupPosition = 0
            vLinkGenConstSectionGroupInit = NONE
            vLinkGenConstSectionGroupInitStage = ONE
            vLinkGenConstSectionGroupFlag = vLinkGenConstGroupFlags/EXECUTE
            vLinkGenConstSectionGroupRef = traptab
      vLinkGenLinkerSections
        10 x vLinkGenLinkerVarSection:
          vHsmGlobalRamBuffer: vLinkGenLinkerVarSectionName=vHsmGlobalRamBuffer, vLinkGenLinkerVarSectionFast=false
          vHsmIpcMemory: vLinkGenLinkerVarSectionName=vHsmIpcMemory, vLinkGenLinkerVarSectionFast=false
          svHsmGlobalRamBuffer: vLinkGenLinkerVarSectionName=svHsmGlobalRamBuffer, vLinkGenLinkerVarSectionFast=false
          svHsmIpcMemory: vLinkGenLinkerVarSectionName=svHsmIpcMemory, vLinkGenLinkerVarSectionFast=false
          vHsmGlobalRamBuffer_INIT: vLinkGenLinkerVarSectionName=vHsmGlobalRamBuffer_INIT, vLinkGenLinkerVarSectionFast=false
          vHsmGlobalRamBuffer_INIT_FAST: vLinkGenLinkerVarSectionName=vHsmGlobalRamBuffer_INIT_FAST, vLinkGenLinkerVarSectionFast=true
          vHsmGlobalRamBuffer_NO_INIT_FAST: vLinkGenLinkerVarSectionName=vHsmGlobalRamBuffer_NO_INIT_FAST, vLinkGenLinkerVarSectionFast=true
          vHsmIpcMemory_INIT: vLinkGenLinkerVarSectionName=vHsmIpcMemory_INIT, vLinkGenLinkerVarSectionFast=false
          vHsmIpcMemory_INIT_FAST: vLinkGenLinkerVarSectionName=vHsmIpcMemory_INIT_FAST, vLinkGenLinkerVarSectionFast=true
          vHsmIpcMemory_NO_INIT_FAST: vLinkGenLinkerVarSectionName=vHsmIpcMemory_NO_INIT_FAST, vLinkGenLinkerVarSectionFast=true
        MSR_CODE (vLinkGenLinkerCodeSection): vLinkGenLinkerCodeSectionName=MSR_CODE, vLinkGenLinkerCodeSectionFast=false
        MSR_CONST (vLinkGenLinkerConstSection): vLinkGenLinkerConstSectionName=MSR_CONST, vLinkGenLinkerConstSectionFast=false
        MSR_PBCFG_CONST (vLinkGenLinkerConstSection): vLinkGenLinkerConstSectionName=MSR_PBCFG_CONST, vLinkGenLinkerConstSectionFast=false
        4 x vLinkGenLinkerVarSection, all with vLinkGenLinkerVarSectionFast=false:
          MSR_PBCFG_VAR: vLinkGenLinkerVarSectionName=MSR_PBCFG_VAR
          MSR_VAR_CLEARED: vLinkGenLinkerVarSectionName=MSR_VAR_CLEARED
          MSR_VAR_INIT: vLinkGenLinkerVarSectionName=MSR_VAR_INIT
          MSR_VAR_NO_INIT: vLinkGenLinkerVarSectionName=MSR_VAR_NO_INIT
        MSR_CONST_FAST (vLinkGenLinkerConstSection): vLinkGenLinkerConstSectionFast=true, vLinkGenLinkerConstSectionName=MSR_CONST_FAST
        3 x vLinkGenLinkerVarSection, all with vLinkGenLinkerVarSectionFast=true:
          MSR_VAR_FAST_CLEARED: vLinkGenLinkerVarSectionName=MSR_VAR_FAST_CLEARED
          MSR_VAR_FAST_INIT: vLinkGenLinkerVarSectionName=MSR_VAR_FAST_INIT
          MSR_VAR_FAST_NO_INIT: vLinkGenLinkerVarSectionName=MSR_VAR_FAST_NO_INIT
        MSR_PBCFG_CONST_FAST (vLinkGenLinkerConstSection): vLinkGenLinkerConstSectionFast=true, vLinkGenLinkerConstSectionName=MSR_PBCFG_CONST_FAST
        7 x vLinkGenLinkerVarSection:
          MSR_PBCFG_VAR_FAST: vLinkGenLinkerVarSectionFast=true, vLinkGenLinkerVarSectionName=MSR_PBCFG_VAR_FAST
          MSR_PBCFG_VAR_FAST_NO_INIT: vLinkGenLinkerVarSectionFast=true, vLinkGenLinkerVarSectionName=MSR_PBCFG_VAR_FAST_NO_INIT
          MSR_PBCFG_VAR_NO_INIT: vLinkGenLinkerVarSectionName=MSR_PBCFG_VAR_NO_INIT, vLinkGenLinkerVarSectionFast=false
          MSR_VAR_SAVED_ZONE_INIT: vLinkGenLinkerVarSectionName=MSR_VAR_SAVED_ZONE_INIT, vLinkGenLinkerVarSectionFast=false
          MSR_VAR_SAVED_ZONE_NO_INIT: vLinkGenLinkerVarSectionName=MSR_VAR_SAVED_ZONE_NO_INIT, vLinkGenLinkerVarSectionFast=false
          MSR_VAR_SAVED_ZONE_FAST_INIT: vLinkGenLinkerVarSectionFast=true, vLinkGenLinkerVarSectionName=MSR_VAR_SAVED_ZONE_FAST_INIT
          MSR_VAR_SAVED_ZONE_FAST_NO_INIT: vLinkGenLinkerVarSectionFast=true, vLinkGenLinkerVarSectionName=MSR_VAR_SAVED_ZONE_FAST_NO_INIT
        BMHD0 (vLinkGenLinkerConstSection):
          vLinkGenLinkerConstSectionName = BMHD0
          vLinkGenLinkerConstSectionAlignment = 32
          vLinkGenLinkerConstSectionFast = false
          vLinkGenLinkerConstSectionFlag = vLinkGenConstSectionFlags/KEEP
        3 x vLinkGenLinkerCodeSection, all with vLinkGenLinkerCodeSectionFast=false, vLinkGenLinkerCodeSectionFlag=vLinkGenConstSectionFlags/KEEP:
          brsStartup: vLinkGenLinkerCodeSectionName=brsStartup, vLinkGenLinkerCodeSectionAlignment=8
          brsExcVect: vLinkGenLinkerCodeSectionName=brsExcVect
          brsSharedConst: vLinkGenLinkerCodeSectionName=brsSharedConst
        brsExcVectConst (vLinkGenLinkerConstSection):
          vLinkGenLinkerConstSectionName = brsExcVectConst
          vLinkGenLinkerConstSectionFast = false
          vLinkGenLinkerConstSectionFlag = vLinkGenConstSectionFlags/KEEP
        brsExcVectRam (vLinkGenLinkerCodeSection): vLinkGenLinkerCodeSectionName=brsExcVectRam, vLinkGenLinkerCodeSectionFast=false, vLinkGenLinkerCodeSectionFlag=vLinkGenConstSectionFlags/KEEP
        brsMainStartup (vLinkGenLinkerCodeSection): vLinkGenLinkerCodeSectionName=brsMainStartup, vLinkGenLinkerCodeSectionFast=false
        brsSharedVar (vLinkGenLinkerVarSection): vLinkGenLinkerVarSectionName=brsSharedVar, vLinkGenLinkerVarSectionFast=false
        RamCodeCoreSection (vLinkGenLinkerCodeSection): vLinkGenLinkerCodeSectionName=RamCodeCoreSection, vLinkGenLinkerCodeSectionFast=false, vLinkGenLinkerCodeSectionAlignment=0
        EepDummySection (vLinkGenLinkerVarSection): vLinkGenLinkerVarSectionName=EepDummySection, vLinkGenLinkerVarSectionFast=false, vLinkGenLinkerVarSectionAlignment=0
        4 x vLinkGenLinkerConstSection, all with vLinkGenLinkerConstSectionFast=false, vLinkGenLinkerConstSectionAlignment=0:
          BmHeaderSection: vLinkGenLinkerConstSectionName=BmHeaderSection
          RamConstSection: vLinkGenLinkerConstSectionName=RamConstSection
          FblHeaderSection: vLinkGenLinkerConstSectionName=FblHeaderSection
          BmHdrHeaderSection: vLinkGenLinkerConstSectionName=BmHdrHeaderSection, vLinkGenLinkerConstSectionFlag=vLinkGenConstSectionFlags/KEEP
        MagicFlagSection (vLinkGenLinkerVarSection): vLinkGenLinkerVarSectionName=MagicFlagSection, vLinkGenLinkerVarSectionFast=false, vLinkGenLinkerVarSectionAlignment=0
        3 x vLinkGenLinkerConstSection, all with vLinkGenLinkerConstSectionFast=false:
          FblPresencePatternSection: vLinkGenLinkerConstSectionName=FblPresencePatternSection
          ApplVectSection: vLinkGenLinkerConstSectionName=ApplVectSection, vLinkGenLinkerConstSectionFlag=vLinkGenConstSectionFlags/KEEP
          FblManualConstSection: vLinkGenLinkerConstSectionName=rodata, vLinkGenLinkerConstSectionFiles=fbl_diag_oem
        FblFlashDrvSection (vLinkGenLinkerVarSection): vLinkGenLinkerVarSectionName=FblFlashDrvSection, vLinkGenLinkerVarSectionFast=false, vLinkGenLinkerVarSectionAlignment=0
        FlashDrvHeaderSection (vLinkGenLinkerConstSection): vLinkGenLinkerConstSectionName=FlashDrvHeaderSection, vLinkGenLinkerConstSectionFast=false
        text (vLinkGenLinkerCodeSection): vLinkGenLinkerCodeSectionName=text, vLinkGenLinkerCodeSectionFast=false
        text_all (vLinkGenLinkerSpecSection): vLinkGenLinkerSpecSectionValue=.text.*, vLinkGenLinkerSpecSectionPad=0
        text_vle (vLinkGenLinkerCodeSection): vLinkGenLinkerCodeSectionName=text_vle, vLinkGenLinkerCodeSectionFast=false
        text_vle_all (vLinkGenLinkerSpecSection): vLinkGenLinkerSpecSectionValue=.text_vle.*, vLinkGenLinkerSpecSectionPad=0
        rodata (vLinkGenLinkerConstSection): vLinkGenLinkerConstSectionName=rodata, vLinkGenLinkerConstSectionFast=false
        rodata_all (vLinkGenLinkerSpecSection): vLinkGenLinkerSpecSectionValue=.rodata.*, vLinkGenLinkerSpecSectionPad=0
        srodata (vLinkGenLinkerConstSection): vLinkGenLinkerConstSectionName=srodata, vLinkGenLinkerConstSectionFast=true
        srodata_all (vLinkGenLinkerSpecSection): vLinkGenLinkerSpecSectionValue=.srodata.*, vLinkGenLinkerSpecSectionPad=0
        zrodata (vLinkGenLinkerConstSection): vLinkGenLinkerConstSectionName=zrodata, vLinkGenLinkerConstSectionFast=true
        zrodata_all (vLinkGenLinkerSpecSection): vLinkGenLinkerSpecSectionValue=.zrodata.*, vLinkGenLinkerSpecSectionPad=0
        sdata2 (vLinkGenLinkerConstSection): vLinkGenLinkerConstSectionName=sdata2, vLinkGenLinkerConstSectionFast=true
        sdata2_all (vLinkGenLinkerSpecSection): vLinkGenLinkerSpecSectionValue=.sdata2.*, vLinkGenLinkerSpecSectionPad=0
        data (vLinkGenLinkerVarSection): vLinkGenLinkerVarSectionName=data, vLinkGenLinkerVarSectionFast=false
        data_all (vLinkGenLinkerSpecSection): vLinkGenLinkerSpecSectionValue=.data.*, vLinkGenLinkerSpecSectionPad=0
        zdata (vLinkGenLinkerVarSection): vLinkGenLinkerVarSectionName=zdata, vLinkGenLinkerVarSectionFast=true
        zdata_all (vLinkGenLinkerSpecSection): vLinkGenLinkerSpecSectionValue=.zdata.*, vLinkGenLinkerSpecSectionPad=0
        sdata (vLinkGenLinkerVarSection): vLinkGenLinkerVarSectionName=sdata, vLinkGenLinkerVarSectionFast=true
        sdata_all (vLinkGenLinkerSpecSection): vLinkGenLinkerSpecSectionValue=.sdata.*, vLinkGenLinkerSpecSectionPad=0
        bss (vLinkGenLinkerVarSection): vLinkGenLinkerVarSectionName=bss, vLinkGenLinkerVarSectionFast=false
        bss_all (vLinkGenLinkerSpecSection): vLinkGenLinkerSpecSectionValue=.bss.*, vLinkGenLinkerSpecSectionPad=0
        sbss (vLinkGenLinkerVarSection): vLinkGenLinkerVarSectionName=sbss, vLinkGenLinkerVarSectionFast=true
        sbss_all (vLinkGenLinkerSpecSection): vLinkGenLinkerSpecSectionValue=.sbss.*, vLinkGenLinkerSpecSectionPad=0
        zbss (vLinkGenLinkerVarSection): vLinkGenLinkerVarSectionName=zbss, vLinkGenLinkerVarSectionFast=true
        zbss_all (vLinkGenLinkerSpecSection): vLinkGenLinkerSpecSectionValue=.zbss.*, vLinkGenLinkerSpecSectionPad=0
        COMMON (vLinkGenLinkerSpecSection): vLinkGenLinkerSpecSectionValue=COMMON, vLinkGenLinkerSpecSectionPad=0
        traptab (vLinkGenLinkerConstSection): vLinkGenLinkerConstSectionName=traptab, vLinkGenLinkerConstSectionFast=false
        brsResetLabel (vLinkGenLinkerCodeSection): vLinkGenLinkerCodeSectionName=brsResetLabel, vLinkGenLinkerCodeSectionFast=false, vLinkGenLinkerCodeSectionAlignment=0
        3 x vLinkGenLinkerConstSection, all with vLinkGenLinkerConstSectionFast=false:
          SlpHeaderSection: vLinkGenLinkerConstSectionName=SlpHeaderSection
          SlpConstSection: vLinkGenLinkerConstSectionName=SlpConstSection
          PseudoFlashDrvSection: vLinkGenLinkerConstSectionName=PseudoFlashDrvSection
      8 x vLinkGenMemoryRegion, all with vLinkGenMemoryRegionAvailable=true:
        Ram_DefaultRamArea: vLinkGenMemoryRegionAddrOffset=52288, vLinkGenMemoryRegionSize=109304, vLinkGenMemoryRegionAddress=1879100480, vLinkGenMemoryRegionHwRegion=vBaseEnvGeneral/DSPR0
          DefaultRamArea (vLinkGenMemoryRegionBlock):
            vLinkGenMemoryRegionBlockCore = 0
            vLinkGenMemoryRegionBlockPosition = 0
            vLinkGenMemoryRegionBlockSize = 73728
            vLinkGenMemoryRegionBlockAddress = 1879100480
            vLinkGenMemoryRegionBlockBoundary = LOWER
            vLinkGenMemoryRegionBlockInitStage = NONE
            vLinkGenMemoryRegionBlockContentType = GLOBAL_DATA
            vLinkGenMemoryRegionBlockContentType = LOCAL_DATA
            vLinkGenMemoryRegionBlockContentType = RAM_CODE_COPY
            vLinkGenMemoryRegionBlockContentType = RAM_CONST_COPY
            vLinkGenMemoryRegionBlockContentType = RETENTION_DATA
            vLinkGenMemoryRegionBlockContentType = STACKS
        Rom_BmMemoryArea: vLinkGenMemoryRegionAddrOffset=0, vLinkGenMemoryRegionSize=131072, vLinkGenMemoryRegionAddress=2684354560, vLinkGenMemoryRegionHwRegion=vBaseEnvGeneral/PFlash0_NonCached
          3 x vLinkGenMemoryRegionBlock, all with vLinkGenMemoryRegionBlockInitStage=NONE:
            BmRom_Startup: vLinkGenMemoryRegionBlockSize=768, vLinkGenMemoryRegionBlockPosition=0, vLinkGenMemoryRegionBlockAddress=2684354560, vLinkGenMemoryRegionBlockBoundary=LOWER, vLinkGenMemoryRegionBlockContentType=STARTUP_CODE
            BmRomArea: vLinkGenMemoryRegionBlockPosition=1, vLinkGenMemoryRegionBlockSize=129760, vLinkGenMemoryRegionBlockAddress=2684355328, vLinkGenMemoryRegionBlockBoundary=LOWER, vLinkGenMemoryRegionBlockContentType=LOCAL_EXCVEC_CODE, vLinkGenMemoryRegionBlockContentType=LOCAL_EXCVEC_CONST, vLinkGenMemoryRegionBlockContentType=LOCAL_INTVEC_CODE, vLinkGenMemoryRegionBlockContentType=LOCAL_INTVEC_CONST, vLinkGenMemoryRegionBlockContentType=GLOBAL_INTVEC_CODE, vLinkGenMemoryRegionBlockContentType=GLOBAL_INTVEC_CONST, vLinkGenMemoryRegionBlockContentType=GLOBAL_CODE, vLinkGenMemoryRegionBlockContentType=GLOBAL_CONST, vLinkGenMemoryRegionBlockContentType=LOCAL_CODE, vLinkGenMemoryRegionBlockContentType=LOCAL_CONST, vLinkGenMemoryRegionBlockContentType=RAM_CODE, vLinkGenMemoryRegionBlockContentType=RAM_CONST
            BmHeader: vLinkGenMemoryRegionBlockPosition=0, vLinkGenMemoryRegionBlockSize=32, vLinkGenMemoryRegionBlockAddress=2684485600, vLinkGenMemoryRegionBlockBoundary=UPPER
        Var_EepDummyArea: vLinkGenMemoryRegionSize=256, vLinkGenMemoryRegionAddrOffset=7168, vLinkGenMemoryRegionAddress=1879055360, vLinkGenMemoryRegionHwRegion=vBaseEnvGeneral/DSPR0
          EepDummy (vLinkGenMemoryRegionBlock):
            vLinkGenMemoryRegionBlockPosition = 0
            vLinkGenMemoryRegionBlockSize = 256
            vLinkGenMemoryRegionBlockBoundary = LOWER
            vLinkGenMemoryRegionBlockInitStage = NONE
            vLinkGenMemoryRegionBlockAddress = 1879055360
        Ram_MagicFlagArea: vLinkGenMemoryRegionSize=8, vLinkGenMemoryRegionAddrOffset=15360, vLinkGenMemoryRegionAddress=1879063552, vLinkGenMemoryRegionHwRegion=vBaseEnvGeneral/DSPR0
          MagicFlag (vLinkGenMemoryRegionBlock):
            vLinkGenMemoryRegionBlockSize = 8
            vLinkGenMemoryRegionBlockBoundary = LOWER
            vLinkGenMemoryRegionBlockInitStage = NONE
            vLinkGenMemoryRegionBlockPosition = 0
            vLinkGenMemoryRegionBlockAddress = 1879063552
        Rom_FblMemoryArea: vLinkGenMemoryRegionAddrOffset=131072, vLinkGenMemoryRegionSize=393216, vLinkGenMemoryRegionAddress=2684485632, vLinkGenMemoryRegionHwRegion=vBaseEnvGeneral/PFlash0_NonCached
          6 x vLinkGenMemoryRegionBlock, all with vLinkGenMemoryRegionBlockInitStage=NONE:
            FblHeader: vLinkGenMemoryRegionBlockPosition=0, vLinkGenMemoryRegionBlockSize=32, vLinkGenMemoryRegionBlockBoundary=LOWER, vLinkGenMemoryRegionBlockAddress=2684485632
            FblBmHdrHeader: vLinkGenMemoryRegionBlockBoundary=LOWER, vLinkGenMemoryRegionBlockPosition=1, vLinkGenMemoryRegionBlockSize=32, vLinkGenMemoryRegionBlockAddress=2684485664
            FblRomArea: vLinkGenMemoryRegionBlockPosition=3, vLinkGenMemoryRegionBlockBoundary=LOWER, vLinkGenMemoryRegionBlockSize=388032, vLinkGenMemoryRegionBlockAddress=2684486720
            FblReserved: vLinkGenMemoryRegionBlockPosition=0, vLinkGenMemoryRegionBlockBoundary=UPPER, vLinkGenMemoryRegionBlockSize=4032, vLinkGenMemoryRegionBlockAddress=2684874752
            FblBlockValPresencePattern: vLinkGenMemoryRegionBlockPosition=1, vLinkGenMemoryRegionBlockBoundary=UPPER, vLinkGenMemoryRegionBlockSize=64, vLinkGenMemoryRegionBlockAddress=2684878784
            FblRomStartup: vLinkGenMemoryRegionBlockPosition=2, vLinkGenMemoryRegionBlockSize=1024, vLinkGenMemoryRegionBlockAddress=2684485696, vLinkGenMemoryRegionBlockBoundary=LOWER
        Rom_ApplMemoryArea: vLinkGenMemoryRegionAddrOffset=524288, vLinkGenMemoryRegionSize=524288, vLinkGenMemoryRegionAddress=2684878848, vLinkGenMemoryRegionHwRegion=vBaseEnvGeneral/PFlash0_NonCached
          7 x vLinkGenMemoryRegionBlock, all with vLinkGenMemoryRegionBlockInitStage=NONE:
            ApplStartupCode_FirstExecInst: vLinkGenMemoryRegionBlockBoundary=LOWER, vLinkGenMemoryRegionBlockPosition=3, vLinkGenMemoryRegionBlockSize=1280, vLinkGenMemoryRegionBlockAddress=2684879616
            ApplCoreExceptions_FirstExecInst: vLinkGenMemoryRegionBlockBoundary=LOWER, vLinkGenMemoryRegionBlockPosition=2, vLinkGenMemoryRegionBlockSize=512, vLinkGenMemoryRegionBlockAddress=2684879104
            ApplVect: vLinkGenMemoryRegionBlockBoundary=LOWER, vLinkGenMemoryRegionBlockPosition=0, vLinkGenMemoryRegionBlockSize=8, vLinkGenMemoryRegionBlockAddress=2684878848
            ApplRomArea: vLinkGenMemoryRegionBlockBoundary=LOWER, vLinkGenMemoryRegionBlockPosition=4, vLinkGenMemoryRegionBlockSize=520960, vLinkGenMemoryRegionBlockAddress=2684880896
            ApplBmHdrHeader: vLinkGenMemoryRegionBlockBoundary=UPPER, vLinkGenMemoryRegionBlockPosition=0, vLinkGenMemoryRegionBlockSize=32, vLinkGenMemoryRegionBlockAddress=2685401856
            ApplReserved: vLinkGenMemoryRegionBlockBoundary=UPPER, vLinkGenMemoryRegionBlockPosition=1, vLinkGenMemoryRegionBlockSize=1248, vLinkGenMemoryRegionBlockAddress=2685401888
            ApplReserved_Alignment: vLinkGenMemoryRegionBlockPosition=1, vLinkGenMemoryRegionBlockSize=248, vLinkGenMemoryRegionBlockAddress=2684878856, vLinkGenMemoryRegionBlockBoundary=LOWER
        Ram_FlashDriverArea: vLinkGenMemoryRegionAddrOffset=0, vLinkGenMemoryRegionSize=3072, vLinkGenMemoryRegionAddress=1879048192, vLinkGenMemoryRegionHwRegion=vBaseEnvGeneral/DSPR0
          FlashDrvArea (vLinkGenMemoryRegionBlock):
            vLinkGenMemoryRegionBlockPosition = 0
            vLinkGenMemoryRegionBlockInitCore = 0
            vLinkGenMemoryRegionBlockBoundary = LOWER
            vLinkGenMemoryRegionBlockInitStage = ONE
            vLinkGenMemoryRegionBlockSize = 3072
            vLinkGenMemoryRegionBlockAddress = 1879048192
        Ram_StackC0: vLinkGenMemoryRegionAddrOffset=15424, vLinkGenMemoryRegionSize=36864, vLinkGenMemoryRegionAddress=1879063616, vLinkGenMemoryRegionHwRegion=vBaseEnvGeneral/DSPR0
          Ram_StackC0 (vLinkGenMemoryRegionBlock):
            vLinkGenMemoryRegionBlockCore = 0
            vLinkGenMemoryRegionBlockPosition = 0
            vLinkGenMemoryRegionBlockSize = 36864
            vLinkGenMemoryRegionBlockAddress = 1879063616
            vLinkGenMemoryRegionBlockBoundary = LOWER
            vLinkGenMemoryRegionBlockInitStage = NONE
            vLinkGenMemoryRegionBlockContentType = STACKS
      7 x vLinkGenLogicalVarGroup:
        Brs_Shared_Var: vLinkGenVarGroupPosition=5, vLinkGenVarGroupInitCore=0, vLinkGenVarGroupContentType=SHARED_DATA, vLinkGenVarGroupRegion=DefaultRamArea
          Brs_Shared_Var (vLinkGenVarSectionGroup):
            vLinkGenVarSectionGroupPosition = 0
            vLinkGenVarSectionGroupInit = NONE
            vLinkGenVarSectionGroupInitStage = ONE
            vLinkGenVarSectionGroupAlignment = 16
            vLinkGenVarSectionGroupRef = brsSharedVar
        Data_Default: vLinkGenVarGroupPosition=1000, vLinkGenVarGroupInitCore=0, vLinkGenVarGroupVariant=vLinkGenVariantHandling/DemoFbl, vLinkGenVarGroupVariant=DemoBm, vLinkGenVarGroupVariant=vLinkGenVariantHandling/DemoAppl, vLinkGenVarGroupContentType=GLOBAL_DATA, vLinkGenVarGroupRomRegion=BmRomArea, vLinkGenVarGroupRegion=DefaultRamArea, vLinkGenVarGroupVariant=vLinkGenVariantHandling/DemoAppl
          vLinkGenVarGroupVariantHandling
            DemoFbl (vLinkGenVarGroupVariantSpecifics): vLinkGenVarGroupSpecificRomRegion=FblRomArea, vLinkGenVarGroupSpecificVariant=vLinkGenVariantHandling/DemoFbl
            DemoAppl (vLinkGenVarGroupVariantSpecifics): vLinkGenVarGroupSpecificRomRegion=ApplRomArea, vLinkGenVarGroupSpecificVariant=vLinkGenVariantHandling/DemoAppl
          6 x vLinkGenVarSectionGroup, all with vLinkGenVarSectionGroupPosition=0, vLinkGenVarSectionGroupInitStage=ONE, vLinkGenVarSectionGroupAlignment=16, vLinkGenVarSectionGroupEndAlignment=4, vLinkGenVarSectionGroupFlag=vLinkGenVarGroupFlags/WRITE:
            data: vLinkGenVarSectionGroupInit=INIT, vLinkGenVarSectionGroupFlag=LOADABLE, vLinkGenVarSectionGroupRef=vLinkGenLinkerSections/data, vLinkGenVarSectionGroupRef=data_all
            sdata: vLinkGenVarSectionGroupInit=INIT, vLinkGenVarSectionGroupFlag=vLinkGenVarGroupFlags/SMALL_ADDRESSING, vLinkGenVarSectionGroupFlag=LOADABLE, vLinkGenVarSectionGroupRef=vLinkGenLinkerSections/sdata, vLinkGenVarSectionGroupRef=sdata_all
            zdata: vLinkGenVarSectionGroupInit=INIT, vLinkGenVarSectionGroupFlag=vLinkGenVarGroupFlags/ABSOLUTE_ADDRESSING, vLinkGenVarSectionGroupFlag=LOADABLE, vLinkGenVarSectionGroupRef=vLinkGenLinkerSections/zdata, vLinkGenVarSectionGroupRef=zdata_all
            bss: vLinkGenVarSectionGroupInit=ZERO_INIT, vLinkGenVarSectionGroupRef=vLinkGenLinkerSections/bss, vLinkGenVarSectionGroupRef=bss_all, vLinkGenVarSectionGroupRef=COMMON
            sbss: vLinkGenVarSectionGroupInit=ZERO_INIT, vLinkGenVarSectionGroupFlag=vLinkGenVarGroupFlags/SMALL_ADDRESSING, vLinkGenVarSectionGroupRef=vLinkGenLinkerSections/sbss, vLinkGenVarSectionGroupRef=sbss_all
            zbss: vLinkGenVarSectionGroupInit=ZERO_INIT, vLinkGenVarSectionGroupFlag=vLinkGenVarGroupFlags/ABSOLUTE_ADDRESSING, vLinkGenVarSectionGroupRef=vLinkGenLinkerSections/zbss, vLinkGenVarSectionGroupRef=zbss_all
        FlashDrvGroup: vLinkGenVarGroupPosition=250, vLinkGenVarGroupRegion=FlashDrvArea, vLinkGenVarGroupVariant=FlashDrv
          FlashDrv_DataGroup (vLinkGenVarSectionGroup):
            vLinkGenVarSectionGroupPosition = 0
            vLinkGenVarSectionGroupInit = NONE
            vLinkGenVarSectionGroupInitStage = ONE
            vLinkGenVarSectionGroupAlignment = 16
            vLinkGenVarSectionGroupRef = vLinkGenLinkerSections/data
            vLinkGenVarSectionGroupRef = vLinkGenLinkerSections/sdata
            vLinkGenVarSectionGroupRef = sdata_all
            vLinkGenVarSectionGroupRef = vLinkGenLinkerSections/zbss
            vLinkGenVarSectionGroupRef = vLinkGenLinkerSections/zdata
            vLinkGenVarSectionGroupRef = zdata_all
            vLinkGenVarSectionGroupRef = data_all
            vLinkGenVarSectionGroupRef = COMMON
            vLinkGenVarSectionGroupRef = vLinkGenLinkerSections/bss
            vLinkGenVarSectionGroupRef = bss_all
        STACK_C0: vLinkGenVarGroupPosition=5, vLinkGenVarGroupCore=0, vLinkGenVarGroupRegion=Ram_StackC0/Ram_StackC0, vLinkGenVarGroupContentType=STARTUP_STACK, vLinkGenVarGroupModule=vBRS
          STACK_C0 (vLinkGenVarSectionGroup):
            vLinkGenVarSectionGroupPosition = 0
            vLinkGenVarSectionGroupInit = NONE
            vLinkGenVarSectionGroupInitStage = ONE
            vLinkGenVarSectionGroupAlignment = 64
            vLinkGenVarSectionGroupEndAlignment = 4
            vLinkGenVarSectionGroupSize = 36864
        MagicFlagGroup: vLinkGenVarGroupPosition=5, vLinkGenVarGroupInitCore=0, vLinkGenVarGroupRegion=MagicFlag, vLinkGenVarGroupVariant=vLinkGenVariantHandling/DemoFbl, vLinkGenVarGroupVariant=DemoBm, vLinkGenVarGroupVariant=vLinkGenVariantHandling/DemoAppl
          MagicFlagGroup (vLinkGenVarSectionGroup):
            vLinkGenVarSectionGroupPosition = 0
            vLinkGenVarSectionGroupInit = ZERO_INIT
            vLinkGenVarSectionGroupInitStage = HARD_RESET_ONLY
            vLinkGenVarSectionGroupAlignment = 16
            vLinkGenVarSectionGroupEndAlignment = 4
            vLinkGenVarSectionGroupRef = MagicFlagSection
        FlashDrvSectionGroup: vLinkGenVarGroupPosition=5, vLinkGenVarGroupRegion=FlashDrvArea, vLinkGenVarGroupVariant=vLinkGenVariantHandling/DemoFbl, vLinkGenVarGroupVariant=DemoBm, vLinkGenVarGroupVariant=vLinkGenVariantHandling/DemoAppl
          FlashDrvSectionGroup (vLinkGenVarSectionGroup):
            vLinkGenVarSectionGroupPosition = 0
            vLinkGenVarSectionGroupInit = NONE
            vLinkGenVarSectionGroupInitStage = ONE
            vLinkGenVarSectionGroupAlignment = 16
            vLinkGenVarSectionGroupRef = FblFlashDrvSection
        EepDummyVarGroup: vLinkGenVarGroupPosition=5, vLinkGenVarGroupInitCore=0, vLinkGenVarGroupRegion=EepDummy
          EepDummyVarGroup (vLinkGenVarSectionGroup):
            vLinkGenVarSectionGroupPosition = 0
            vLinkGenVarSectionGroupInit = ZERO_INIT
            vLinkGenVarSectionGroupInitStage = HARD_RESET_ONLY
            vLinkGenVarSectionGroupAlignment = 16
            vLinkGenVarSectionGroupEndAlignment = 4
            vLinkGenVarSectionGroupRef = EepDummySection
      ApplVectSymbols (vLinkGenLogicalSymbolGroup):
        vLinkGenSymbolGroupPosition = 5
        vLinkGenSymbolGroupVariant = vLinkGenVariantHandling/DemoAppl
        vLinkGenSymbolGroupVariant = DemoBm
        vLinkGenSymbolGroupVariant = vLinkGenVariantHandling/DemoFbl
        RESETVECT_1 (vLinkGenLinkerSymbol): vLinkGenLinkerSymbolName=_start, vLinkGenLinkerSymbolValue=Brs_ApplicationEntry, vLinkGenLinkerSymbolPosition=0
        RESETVECT (vLinkGenLinkerSymbol): vLinkGenLinkerSymbolPosition=0, vLinkGenLinkerSymbolName=RESETVECT, vLinkGenLinkerSymbolValue=Brs_ApplicationEntry
    vLinkGenContentTypes
      vHsmGlobalRamBuffer (vLinkGenVarContentType): vLinkGenVarContentTypeLocal=false, vLinkGenVarContentTypeCopyRef=GLOBAL_CONST
      vHsmIpcMemory (vLinkGenVarContentType): vLinkGenVarContentTypeLocal=false, vLinkGenVarContentTypeCopyRef=GLOBAL_CONST
      RAM_CODE (vLinkGenConstContentType): vLinkGenConstContentTypeLocal=false, vLinkGenConstContentTypeCopyRef=RAM_CODE_COPY
      RAM_CONST (vLinkGenConstContentType): vLinkGenConstContentTypeLocal=false, vLinkGenConstContentTypeCopyRef=RAM_CONST_COPY
      3 x vLinkGenVarContentType:
        GLOBAL_DATA: vLinkGenVarContentTypeLocal=false, vLinkGenVarContentTypeCopyRef=GLOBAL_CONST
        LOCAL_DATA: vLinkGenVarContentTypeLocal=true, vLinkGenVarContentTypeCopyRef=LOCAL_CONST
        RETENTION_DATA: vLinkGenVarContentTypeLocal=false, vLinkGenVarContentTypeCopyRef=GLOBAL_CONST
      13 x vLinkGenConstContentType:
        GLOBAL_CODE: vLinkGenConstContentTypeLocal=false
        LOCAL_CODE: vLinkGenConstContentTypeLocal=true
        GLOBAL_CONST: vLinkGenConstContentTypeLocal=false
        LOCAL_CONST: vLinkGenConstContentTypeLocal=true
        GLOBAL_EXCVEC_CODE: vLinkGenConstContentTypeLocal=false
        LOCAL_EXCVEC_CODE: vLinkGenConstContentTypeLocal=true
        GLOBAL_EXCVEC_CONST: vLinkGenConstContentTypeLocal=true
        LOCAL_EXCVEC_CONST: vLinkGenConstContentTypeLocal=true
        GLOBAL_INTVEC_CODE: vLinkGenConstContentTypeLocal=false
        LOCAL_INTVEC_CODE: vLinkGenConstContentTypeLocal=true
        GLOBAL_INTVEC_CONST: vLinkGenConstContentTypeLocal=false
        LOCAL_INTVEC_CONST: vLinkGenConstContentTypeLocal=true
        STARTUP_CODE: vLinkGenConstContentTypeLocal=false
      5 x vLinkGenVarContentType:
        STARTUP_STACK: vLinkGenVarContentTypeLocal=true
        STACKS: vLinkGenVarContentTypeLocal=true
        RAM_CODE_COPY: vLinkGenVarContentTypeLocal=false
        RAM_CONST_COPY: vLinkGenVarContentTypeLocal=false
        SHARED_DATA: vLinkGenVarContentTypeLocal=false
      APPLICATION_ENTRY (vLinkGenConstContentType): vLinkGenConstContentTypeLocal=false
    vLinkGenPublishedInformation: vLinkGenDefaultVarGroupAlignment=16, vLinkGenGeneration=2, vLinkGenDuplicatedLabels=false
      vLinkGenConstGroupFlags
        7 x vLinkGenConstGroupFlag:
          EXECUTE
          READ
          VLE_CODE
          PCP_CODE
          SMALL_ADDRESSING
          ABSOLUTE_ADDRESSING
          NOLOAD
      vLinkGenVarGroupFlags
        7 x vLinkGenVarGroupFlag:
          EXECUTE
          READ
          WRITE
          LOADABLE
          SMALL_ADDRESSING
          ABSOLUTE_ADDRESSING
          NOLOAD
      vLinkGenRegionBlockFlags
        6 x vLinkGenRegionBlockFlag:
          EXECUTE
          READ
          WRITE
          ALLOCATE
          INIT
          INVERT
      vLinkGenConstSectionFlags
        KEEP (vLinkGenConstSectionFlag)
      vLinkGenVarSectionFlags
        KEEP (vLinkGenVarSectionFlag)
    vLinkGenGeneral: vLinkGenFileGeneration=ONE_FILE_PER_VARIANT
    vLinkGenVariantHandling
      4 x vLinkGenVariant:
        DemoBm
        DemoFbl
        DemoAppl
        FlashDrv
  module config vSecPrim: implementation-config-variant=VARIANT-PRE-COMPILE, module-description=vSecPrim_Impl
    vSecPrimGeneral:
      vSecPrimWatchdogLevel = WD_LEVEL_3
      vSecPrimRSAMaxKeySize = RSA_MAX_KEY_SIZE_2048
      vSecPrimECPMaxKeySize = ECP_MAX_KEY_SIZE_256
      vSecPrimClearWorkspaceEnabled = false
      vSecPrimSupportUInt64 = true
      vSecPrimUseVstdLib = true
      vSecPrimSizeOfEsltLength = SIZE_UINT32
      vSecPrimCTRDRBGAES128SecurityStrength = SECURITY_STRENGTH_128
      vSecPrimDrbgReseedInterval = 4294967295
      vSecPrimSPAKE2pMaxAADSize = 16
      vSecPrimSPAKE2pPreambleOKMLength = 64
    vSecPrimAsymmetricAlgorithms
      vSecPrimSignature:
        vSecPrimRSA_PSS_SHA1Enabled = true
        vSecPrimRSA_PSS_SHA2_256Enabled = true
        vSecPrimRSA_PSS_RIPEMD160Enabled = false
        vSecPrimRSA_V15_RIPEMD160Enabled = false
        vSecPrimRSA_V15_SHA1Enabled = false
        vSecPrimRSA_V15_SHA2_256Enabled = false
        vSecPrimECDSA_25519Enabled = false
        vSecPrimECDSA_GenericEnabled = false
      vSecPrimKeyExchange: vSecPrimECDH_25519Enabled=false, vSecPrimECDH_GenericEnabled=false, vSecPrimECBD_GenericEnabled=false, vSecPrimSPAKE2pEnabled=false
      vSecPrimKeyDerivation:
        vSecPrimPKCS5Enabled = false
        vSecPrimANSI_X963Enabled = false
        vSecPrimANSI_X963_SHA256Enabled = false
        vSecPrimPKCS5HMacSHA256Enabled = false
        vSecPrimANSI_X963_SHA512Enabled = false
        vSecPrimHKDF_HMAC_SHA256Enabled = false
        vSecPrimHKDF_HMAC_SHA384Enabled = false
        vSecPrimHKDF_SHA2_256_OnestepEnabled = false
      vSecPrimCipher: vSecPrimRSA_OAEP_SHA1Enabled=false, vSecPrimRSA_OAEP_SHA2_256Enabled=false, vSecPrimRSA_V15Enabled=false
      vSecPrimKeyGeneration: vSecPrimECCEnabled=false
    vSecPrimBasicAlgorithms
      vSecPrimHash:
        vSecPrimSHA2_256Enabled = true
        vSecPrimSHA1Enabled = false
        vSecPrimRIPEMD160Enabled = false
        vSecPrimSHA2_512Enabled = false
        vSecPrimSHA3Enabled = false
        vSecPrimMD5Enabled = false
      vSecPrimRandomNumberGeneration: vSecPrimCtrDrbgEnabled=true, vSecPrimFIPS186Enabled=false, vSecPrimHashDrbgEnabled=false
    vSecPrimSymmetricAlgorithms
      vSecPrimCipher:
        vSecPrimAes128Enabled = false
        vSecPrimAes192Enabled = false
        vSecPrimAes256Enabled = false
        vSecPrimGcmEnabled = false
        vSecPrimAesCcmEnabled = false
        vSecPrimDesEnabled = false
        vSecPrimRC2Enabled = false
        vSecPrimTDesEnabled = false
        vSecPrimChaCha20Enabled = false
        vSecPrimAeadChaCha20Poly1305Enabled = false
      vSecPrimMac:
        vSecPrimSipHashEnabled = false
        vSecPrimCmacEnabled = false
        vSecPrimHMacSHA1Enabled = false
        vSecPrimHMacRMD160Enabled = false
        vSecPrimHMacSHA2_256Enabled = false
        vSecPrimGMacEnabled = false
        vSecPrimPoly1305Enabled = false
        vSecPrimHMacSHA2_384Enabled = false
    vSecPrimOptimization:
      vSecPrimAesSpeedUp = SPEED_UP_LEVEL_3
      vSecPrimSha1SpeedUp = SPEED_UP_LEVEL_1
      vSecPrimSha256SpeedUp = SPEED_UP_LEVEL_0
      vSecPrimSha512SpeedUp = SPEED_UP_LEVEL_0
      vSecPrimChaCha20SpeedUp = SPEED_UP_LEVEL_1
  module config vSet: implementation-config-variant=VARIANT-PRE-COMPILE, module-description=vSet_Impl
    vSetCalibration
    vSetGeneral: vSetDummyStatementKind=None
    vSetPlatform:
      vSetBitOrder = LSB_to_MSB
      vSetSizeOfInt = Size32Bit
      vSetCPUType = CPU32Bit
      vSetSizeOfEnum = Size32Bit
      vSetByteOrder = LITTLE_ENDIAN
      vSetSizeOfRAMPointer = Size32Bit
      vSetSizeOfROMPointer = Size32Bit
    vSetBswInitialization
      30 x vSetInitFunction:
        CanIf_InitMemory: vSetHeader=CanIf.h, vSetModuleRef=CanIf  # /ActiveEcuC/CanIf PLAIN_TEXT InitMemory function description of CanIf in UnfilteredViewInInvariantProject (UnfilteredInvariantProjectModelView) .
          vSetInitFunctionInstance: vSetInitPhase=INIT_MEMORY
        CanIf_Init: vSetHeader=CanIf.h, vSetConfigType=CanIf_ConfigType, vSetConfigPtrClass=CANIF_INIT_DATA, vSetModuleRef=CanIf  # /ActiveEcuC/CanIf PLAIN_TEXT Init function description of CanIf in UnfilteredViewInInvariantProject (UnfilteredInvariantProjectModelView) .
          vSetInitFunctionInstance: vSetInitPhase=INIT_TWO_IF, vSetConfigPtrName=CanIf_Config_Ptr
        CanTp_Init: vSetHeader=CanTp.h, vSetConfigType=CanTp_ConfigType, vSetConfigPtrClass=CANTP_INIT_DATA, vSetModuleRef=CanTp  # /ActiveEcuC/CanTp PLAIN_TEXT Init function description of CanTp in UnfilteredViewInInvariantProject (UnfilteredInvariantProjectModelView) .
          vSetInitFunctionInstance: vSetInitPhase=INIT_TWO_TP, vSetConfigPtrName=CanTp_Config_Ptr
        CanTp_InitMemory: vSetHeader=CanTp.h, vSetModuleRef=CanTp  # /ActiveEcuC/CanTp PLAIN_TEXT InitMemory function description of CanTp in UnfilteredViewInInvariantProject (UnfilteredInvariantProjectModelView) .
          vSetInitFunctionInstance: vSetInitPhase=INIT_MEMORY
        Can_Init: vSetHeader=Can.h, vSetConfigType=Can_ConfigType, vSetConfigPtrClass=CAN_INIT_DATA, vSetModuleRef=Can  # /ActiveEcuC/Can PLAIN_TEXT Init function description of Can in UnfilteredViewInInvariantProject (UnfilteredInvariantProjectModelView) .
          vSetInitFunctionInstance: vSetInitPhase=INIT_TWO_DRV, vSetConfigPtrName=Can_Config_Ptr
        Can_InitMemory: vSetHeader=Can.h, vSetModuleRef=Can  # /ActiveEcuC/Can PLAIN_TEXT InitMemory function description of Can in UnfilteredViewInInvariantProject (UnfilteredInvariantProjectModelView) .
          vSetInitFunctionInstance: vSetInitPhase=INIT_MEMORY
        FblCw_Init: vSetHeader=fbl_inc.h, vSetConfigType=FblCw_ConfigType, vSetConfigPtrClass=FBLCW_INIT_DATA, vSetModuleRef=Dcm  # /ActiveEcuC/Dcm PLAIN_TEXT Init function description of FblCw in UnfilteredViewInInvariantProject (UnfilteredInvariantProjectModelView) .
          vSetInitFunctionInstance: vSetInitPhase=INIT_THREE, vSetConfigPtrName=FblCw_Config_Ptr
        FblCw_InitMemory: vSetHeader=fbl_inc.h, vSetModuleRef=Dcm  # /ActiveEcuC/Dcm PLAIN_TEXT InitMemory function description of FblCw in UnfilteredViewInInvariantProject (UnfilteredInvariantProjectModelView) .
          vSetInitFunctionInstance: vSetInitPhase=INIT_MEMORY
        Det_InitMemory: vSetHeader=Det.h, vSetModuleRef=Det  # /ActiveEcuC/Det PLAIN_TEXT InitMemory function description of Det in UnfilteredViewInInvariantProject (UnfilteredInvariantProjectModelView) .
          vSetInitFunctionInstance: vSetInitPhase=INIT_MEMORY
        Det_Init: vSetHeader=Det.h, vSetConfigType=Det_ConfigType, vSetConfigPtrClass=DET_INIT_DATA, vSetModuleRef=Det  # /ActiveEcuC/Det PLAIN_TEXT Init function description of Det in UnfilteredViewInInvariantProject (UnfilteredInvariantProjectModelView) .
          vSetInitFunctionInstance: vSetInitPhase=INIT_ZERO, vSetConfigPtrName=Det_Config_Ptr
        PduR_InitMemory: vSetHeader=PduR.h, vSetModuleRef=PduR  # /ActiveEcuC/PduR PLAIN_TEXT InitMemory function description of PduR in UnfilteredViewInInvariantProject (UnfilteredInvariantProjectModelView) .
          vSetInitFunctionInstance: vSetInitPhase=INIT_MEMORY
        PduR_PreInit: vSetHeader=PduR.h, vSetConfigType=PduR_PBConfigType, vSetConfigPtrClass=PDUR_INIT_DATA, vSetModuleRef=PduR  # /ActiveEcuC/PduR PLAIN_TEXT PreInit function description of PduR in UnfilteredViewInInvariantProject (UnfilteredInvariantProjectModelView) .
          vSetInitFunctionInstance: vSetInitPhase=INIT_ONE, vSetConfigPtrName=PduR_Config_Ptr
        PduR_Init: vSetHeader=PduR.h, vSetConfigType=PduR_PBConfigType, vSetConfigPtrClass=PDUR_INIT_DATA, vSetModuleRef=PduR  # /ActiveEcuC/PduR PLAIN_TEXT Init function description of PduR in UnfilteredViewInInvariantProject (UnfilteredInvariantProjectModelView) .
          vSetInitFunctionInstance: vSetInitPhase=INIT_TWO_COM, vSetConfigPtrName=PduR_Config_Ptr
        Brs_Init: vSetHeader=, vSetModuleRef=vBRS  # /ActiveEcuC/vBRS PLAIN_TEXT Automatically generated by BswInitFctConfigurationService.
          vSetInitFunctionInstance: vSetInitPhase=NO_INIT
        vBaseEnv_Init: vSetHeader=, vSetModuleRef=vBaseEnv  # /ActiveEcuC/vBaseEnv PLAIN_TEXT Created vBaseEnv_Init by Extended Init XML Service
          vSetInitFunctionInstance: vSetInitPhase=NO_INIT
        vMemAccM_InitMemory: vSetHeader=vMemAccM.h, vSetModuleRef=vMemAccM  # /ActiveEcuC/vMemAccM PLAIN_TEXT Initializes all *_INIT_* section variables within the vMemAccM.
          vSetInitFunctionInstance: vSetInitPhase=INIT_MEMORY
        vMemAccM_Init: vSetHeader=vMemAccM.h, vSetModuleRef=vMemAccM  # /ActiveEcuC/vMemAccM PLAIN_TEXT Initializes the vMemAccM.
          vSetInitFunctionInstance: vSetInitPhase=INIT_TWO_DRV
        Csm_InitMemory: vSetHeader=Csm.h, vSetModuleRef=Csm  # /ActiveEcuC/Csm PLAIN_TEXT Initializes variables of the Crypto Service Manager
          vSetInitFunctionInstance: vSetInitPhase=INIT_MEMORY
        Csm_Init: vSetHeader=Csm.h, vSetModuleRef=Csm  # /ActiveEcuC/Csm PLAIN_TEXT Initializes the Crypto Service Manager
          vSetInitFunctionInstance: vSetInitPhase=INIT_TWO_SYS
        CryIf_InitMemory: vSetHeader=CryIf.h, vSetModuleRef=CryIf  # /ActiveEcuC/CryIf PLAIN_TEXT Initializes variables of the Crypto Interface
          vSetInitFunctionInstance: vSetInitPhase=INIT_MEMORY
        CryIf_Init: vSetHeader=CryIf.h, vSetModuleRef=CryIf  # /ActiveEcuC/CryIf PLAIN_TEXT Initializes the Crypto Interface
          vSetInitFunctionInstance: vSetInitPhase=INIT_TWO_IF
        Crypto_30_LibCv_InitMemory: vSetHeader=Crypto_30_LibCv.h, vSetModuleRef=Crypto  # /ActiveEcuC/Crypto PLAIN_TEXT Initializes variables of the Crypto Driver
          vSetInitFunctionInstance: vSetInitPhase=INIT_MEMORY
        Crypto_30_LibCv_Init: vSetHeader=Crypto_30_LibCv.h, vSetModuleRef=Crypto  # /ActiveEcuC/Crypto PLAIN_TEXT Initializes the Crypto Driver
          vSetInitFunctionInstance: vSetInitPhase=INIT_TWO_DRV
        Xcp_Init: vSetHeader=Xcp.h, vSetModuleRef=Xcp  # /ActiveEcuC/Xcp PLAIN_TEXT Module Initialization function of module Xcp.
          vSetInitFunctionInstance: vSetInitPhase=INIT_TWO_TP
        Xcp_InitMemory: vSetHeader=Xcp.h, vSetModuleRef=Xcp  # /ActiveEcuC/Xcp PLAIN_TEXT Memory Initialization function of module Xcp.
          vSetInitFunctionInstance: vSetInitPhase=INIT_MEMORY
        CanXcp_InitMemory: vSetHeader=CanXcp.h, vSetModuleRef=Xcp  # /ActiveEcuC/Xcp PLAIN_TEXT Memory Initialization function of module CanXcp.
          vSetInitFunctionInstance: vSetInitPhase=INIT_MEMORY
        CanXcp_Init: vSetHeader=CanXcp.h, vSetConfigType=CanXcp_ConfigType, vSetConfigPtrClass=CANXCP_CONST, vSetModuleRef=Xcp  # /ActiveEcuC/Xcp PLAIN_TEXT Module Initialization function of module CanXcp.
          vSetInitFunctionInstance: vSetInitPhase=INIT_TWO_TP, vSetConfigPtrName=NULL_PTR
        SecM_Init: vSetHeader=Sec.h, vSetModuleRef=Smh  # /ActiveEcuC/Smh PLAIN_TEXT SecM_Init function description
          vSetInitFunctionInstance: vSetInitPhase=INIT_TWO_SYS
        WrapNv_Init: vSetHeader=WrapNv.h, vSetModuleRef=WrapNv  # /ActiveEcuC/WrapNv PLAIN_TEXT WrapNv_Init function description
          vSetInitFunctionInstance: vSetInitPhase=INIT_TWO_SYS
        vLinkGen_Init: vSetHeader=vLinkGen_Lcfg.h, vSetModuleRef=vLinkGen  # /ActiveEcuC/vLinkGen PLAIN_TEXT Dummy initialization of the vLinkGen
          vSetInitFunctionInstance: vSetInitPhase=NO_INIT

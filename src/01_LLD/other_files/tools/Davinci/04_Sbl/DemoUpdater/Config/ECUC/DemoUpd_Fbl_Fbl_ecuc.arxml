AUTOSAR XML (schema 00050)
package /ActiveEcuC
  module config Fbl: implementation-config-variant=VARIANT-LINK-TIME, module-description=Fbl_Impl
    FblFlashBlockTable
      15 x FblFlashBlock:
        FblFlashBlock_1: FblFbStartAddress=2150170624, FblFbEndAddress=2150268927, FblFbDescription=PF0 PS0: 16KB Block1 - bm, FblFbMemoryDeviceRef=Flash, FblFbLogicalBlockRef=Updater
        FblFlashBlock_2: FblFbStartAddress=2150268928, FblFbEndAddress=2150301695, FblFbDescription=PF0 PS0: 32KB Block2 - bm, FblFbMemoryDeviceRef=Flash, FblFbLogicalBlockRef=Updater
        FblFlashBlock_3: FblFbStartAddress=2150301696, FblFbEndAddress=2150367231, FblFbDescription=PF0 PS0: 64KB Block3 - bm, FblFbMemoryDeviceRef=Flash, FblFbLogicalBlockRef=Updater
        FblFlashBlock_4: FblFbStartAddress=2150367232, FblFbEndAddress=2150629375, FblFbDescription=PF0 PS0: 256KB Block4 - fbl, FblFbMemoryDeviceRef=Flash, FblFbLogicalBlockRef=Updater
        FblFlashBlock_5: FblFbStartAddress=2152726528, FblFbEndAddress=2152857599, FblFbDescription=PF1 PS0: 512KB Block5 - fbl, FblFbMemoryDeviceRef=Flash
        FblFlashBlock_6: FblFbStartAddress=2152857600, FblFbEndAddress=2152988671, FblFbDescription=PF1 PS0: 512KB Block6 - fbl, FblFbMemoryDeviceRef=Flash
        FblFlashBlock_7: FblFbStartAddress=2152988672, FblFbEndAddress=2153119743, FblFbDescription=PF1 PS0: 512KB Block7 - appl, FblFbMemoryDeviceRef=Flash
        FblFlashBlock_8: FblFbStartAddress=2153119744, FblFbEndAddress=2153250815, FblFbDescription=PF1 PS0: 512KB Block8 - cal, FblFbMemoryDeviceRef=Flash
        FblFlashBlock_9: FblFbStartAddress=2153250816, FblFbEndAddress=2153381887, FblFbDescription=PF1 PS0: 512KB Block9 - cal, FblFbMemoryDeviceRef=Flash
        FblFlashBlock_10: FblFbStartAddress=2153381888, FblFbEndAddress=2153512959, FblFbDescription=PF1 PS2: 128KB Block10, FblFbMemoryDeviceRef=Flash, FblFbLogicalBlockRef=Fbl
        FblFlashBlock_11: FblFbStartAddress=2153512960, FblFbEndAddress=2153644031, FblFbDescription=PF1 PS2: 128KB Block11, FblFbMemoryDeviceRef=Flash, FblFbLogicalBlockRef=Fbl
        FblFlashBlock_12: FblFbStartAddress=2153644032, FblFbEndAddress=2153709567, FblFbDescription=PF1 PS2: 64KB Block12, FblFbMemoryDeviceRef=Flash, FblFbLogicalBlockRef=Fbl
        FblFlashBlock_13: FblFbStartAddress=2153709568, FblFbEndAddress=2153742335, FblFbDescription=PF1 PS2: 32KB Block13, FblFbMemoryDeviceRef=Flash
        FblFlashBlock_14: FblFbStartAddress=2153742336, FblFbEndAddress=2153775103, FblFbDescription=PF1 PS1: 32KB Block14, FblFbMemoryDeviceRef=Flash
        SblRamBlock_0: FblFbStartAddress=1879048192, FblFbEndAddress=1879051263, FblFbDescription=3KB RAMBlock0 - sbl, FblFbLogicalBlockRef=SBL, FblFbMemoryDeviceRef=Ram
    FblMemoryDeviceTable
      Ram (FblMemoryDevice):
        FblMdErasedValue = 255
        FblMdSegmentSize = 1
        FblMdIndex = 1
        FblMdInitHook = false
        FblMdDeinitHook = false
        FblMdReadHook = false
        FblMdEraseHook = false
        FblMdWriteHook = false
        FblMdVerifyHook = false
      Flash (FblMemoryDevice):
        FblMdSegmentSize = 32
        FblMdErasedValue = 0
        FblMdIndex = 0
        FblMdInitHook = false
        FblMdDeinitHook = false
        FblMdReadHook = false
        FblMdEraseHook = false
        FblMdWriteHook = false
        FblMdVerifyHook = false
    FblGeneral:
      FblApplicationStateTask = false
      FblStayInBoot = true
      FblPresencePattern = true
      FblCompressionMode = true
      FblCommonData = true
      FblWriteSegmentation = 256
      FblWatchdogService = true
      FblVerificationSegmentation = 256
      FblUnalignedDataTransfer = true
      FblStartFunction = true
      FblPipelinedProgramming = true
      FblPipelinedVerification = true
      FblMaximumNumberOfSegments = 16
      FblInternalMemoryCopy = true
      FblDiagnosticBufferSize = 2050
      FblDataProcessingBufferSize = 256
      FblVerificationFunction = false
      FblUserConfigFile = $(DpaProjectFolder)\Config\Fbl_Usr.cfg
      FblGapFilling = false
      FblAdaptiveDataTransferRcrrp = false
      FblGatewaySupport = false
      FblInputVerification = false
      FblOta = false
      FblHardwareSwap = false
      FblP2Server = 25
      FblS3ServerExtendedSession = 0
      FblResponseAfterReset = false
      FblSuspendDriverOperation = false
      FblSleepMode = false
      FblSleepTime = 0
      FblProcessedVerification = false
      FblOneStepUpdater = false
      FblOutputVerification = true
      FblEncryptionMode = false
      FblFlashDriverUsage = DOWNLOAD_DRIVER
      FblReprogrammableLbt = false
      FblProjectState = INTEGRATION
      FblApplicationTimerTask = true
      FblHeaderAddress = 2153381888
      FblP2StarServer = 5000
      FblS3ServerProgrammingSession = 5000
      FblFillCode = 255
      FblUserSubfunction = false
      FblUserService = false
      FblUserRoutine = false
      FblWatchdogTriggerCycle = 1
      FblMaximumAmountOfLogicalBlocks = 3
      FblBlockStartAddress = 2153381888
      FblBlockLength = 327680
      FblXcpSupport = false
    FblLogicalBlockTable
      3 x FblLogicalBlock, all with FblLbOutputVerification=SecM_Default, FblLbDescription=:
        Fbl: FblLbBlockType=APPLICATION, FblLbDisposability=MANDATORY, FblLbBlockIndex=1, FblLbStartAddress=2153381888, FblLbEndAddress=2153709567, FblLbHeaderAddress=2153381888, FblLbBmHeaderAddress=2153381920
        Updater: FblLbBlockType=APPLICATION, FblLbDisposability=MANDATORY, FblLbBlockIndex=0, FblLbStartAddress=2150170624, FblLbEndAddress=2150629375, FblLbHeaderAddress=2150628608, FblLbBmHeaderAddress=2150516768
        SBL: FblLbBlockType=SBL, FblLbDisposability=OPTIONAL, FblLbBlockIndex=2, FblLbStartAddress=1879048192, FblLbEndAddress=1879051263, FblLbHeaderAddress=1879050752, FblLbBmHeaderAddress=1879048192
    FblFord:
      FblValidationStructure = false
      FblSigningSolutionKey = SINGLE_KEY
      FblWriteDataByIdentifierService = true
      FblRequestUploadService = true
      FblValidationStructureBeginTag = 1961616914
      FblValidationStructureEndTag = 4046069293
      FblFlashErasedDetection = false
      FblFlashErasedDetectionPatternSize = 16
      FblSeedKeyModule = true
      FblSecretKey = FFFFFFFFFFFFFFFFFFFFFFFF
      FblSecretKeyUpdate = false
      FblMaximumReadableDataIdentifiers = 5
      FblKeyExpLength = 256
      FblTokenDownloadHandling = true

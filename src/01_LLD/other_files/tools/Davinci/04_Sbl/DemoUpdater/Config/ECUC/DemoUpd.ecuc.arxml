AUTOSAR XML (schema 00050)
package /ActiveEcuC
  ecuc value collection ActiveEcuC: ecuc-values=[EcuC, FblBmHdr, FblBm, FblHal, Fbl, MemMap, vBRS, vBaseEnv, vLinkGen, vSet, Mcu]

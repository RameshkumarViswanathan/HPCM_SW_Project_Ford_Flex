AUTOSAR XML (schema 00050)
package /ActiveEcuC
  module config Mcu: implementation-config-variant=VARIANT-PRE-COMPILE
    McuModuleConfiguration: McuClockSrcFailureNotification=DISABLED, McuNumberOfMcuModes=1, McuRamSectors=1
      McuClockSettingConfig: McuClockSettingId=1
        McuClockReferencePoint_FblTimer (McuClockReferencePoint): McuClockReferencePointFrequency=100000000
        McuClockReferencePoint_Can (McuClockReferencePoint): McuClockReferencePointFrequency=80000000
      McuModeSettingConf: McuMode=1
    McuGeneralConfiguration: McuDevErrorDetect=false, McuGetRamStateApi=false, McuInitClock=true, McuNoPll=true, McuPerformResetApi=false, McuVersionInfoApi=false
    McuPublishedInformation
      McuResetReasonConf: McuResetReason=0

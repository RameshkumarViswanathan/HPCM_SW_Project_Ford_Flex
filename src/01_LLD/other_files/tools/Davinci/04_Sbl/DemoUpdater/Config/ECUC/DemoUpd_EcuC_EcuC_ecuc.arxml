AUTOSAR XML (schema 00050)
package /ActiveEcuC
  module config EcuC: implementation-config-variant=VARIANT-PRE-COMPILE, module-description=EcuC_Impl
    EcucPduCollection: PduIdTypeEnum=UINT8, PduLengthTypeEnum=UINT16
      18 x Pdu, all with J1939Requestable=false:
        Diag_Demo_Response_Message_Tp_oDemoFBL_Ford_CANFD_9a3b189a_Tx: DynamicLength=false, PduLength=64, SysTPduToFrameMappingRef=Diag_Demo_Response_Message_Tp
        Diag_Demo_Request_Message_Tp_oDemoFBL_Ford_CANFD_20_03eb2b50_Rx: DynamicLength=false, PduLength=8, SysTPduToFrameMappingRef=Diag_Demo_Request_Message_Tp
        Diag_Demo_Response_Message_oDemoFBL_Ford_CANFD_20_af8657d4_Tx: DynamicLength=true, PduLength=8
        Diag_Demo_Response_Message_oDemoFBL_Ford_CANFD_20_ee4ec61c_Tx: DynamicLength=true, PduLength=8
        Diag_Demo_Request_Message_oDemoFBL_Ford_CANFD_20_0a455198_Rx: DynamicLength=true, PduLength=8
        Diag_Functional_Request_Message_oDemoFBL_Ford_CANFD_20_b3c5bf5e_Rx: DynamicLength=true, PduLength=7
        Diag_Demo_Request_Message_Tp_oDemoFBL_Ford_CANFD_7e308f1e_Rx: DynamicLength=false, PduLength=64, SysTPduToFrameMappingRef=Diag_Demo_Request_Message_Tp
        Diag_Functional_Request_Message_Tp_oDemoFBL_Ford_CANFD_b5d38b6f_Rx: DynamicLength=false, PduLength=64, SysTPduToFrameMappingRef=Diag_Functional_Request_Message_Tp
        Diag_Functional_Request_Message_oDemoFBL_Ford_CANFD_20_c1a655e9_Rx: DynamicLength=true, PduLength=7
        Diag_Demo_Response_Message_oDemoFBL_Ford_CANFD_d48e43f7_Tx: DynamicLength=true, PduLength=64
        Diag_Demo_Request_Message_oDemoFBL_Ford_CANFD_645d95ca_Rx: DynamicLength=true, PduLength=64
        Diag_Demo_Response_Message_Tp_oDemoFBL_Ford_CANFD_20_4c055dbd_Tx: DynamicLength=false, PduLength=8, SysTPduToFrameMappingRef=Diag_Demo_Response_Message_Tp
        Diag_Functional_Request_Message_oDemoFBL_Ford_CANFD_f0d52d28_Rx: DynamicLength=true, PduLength=62
        Diag_Functional_Request_Message_Tp_oDemoFBL_Ford_CANFD_20_0bb75f3a_Rx: DynamicLength=false, PduLength=8, SysTPduToFrameMappingRef=Diag_Functional_Request_Message_Tp
        Diag_Functional_Request_Message_oDemoFBL_Ford_CANFD_bd4dd5f9_Rx: DynamicLength=true, PduLength=62
        Diag_Demo_Request_Message_oDemoFBL_Ford_CANFD_937daa12_Rx: DynamicLength=true, PduLength=64
        Diag_Demo_Request_Message_oDemoFBL_Ford_CANFD_20_36f6fa2d_Rx: DynamicLength=true, PduLength=8
        Diag_Demo_Response_Message_oDemoFBL_Ford_CANFD_075f1067_Tx: DynamicLength=true, PduLength=64
    EcucGeneral:
      DummyFunction = false
      DummyStatement = true
      StructAlignment = Auto
      ArrayAlignment = Align8Bit
      StructInArrayAlignment = Auto
      SizeOfEnum = Size32Bit
      SizeOfROMPointer = Size32Bit
      SizeOfRAMPointer = Size32Bit
      AtomicBitAccessInBitfield = false
      AtomicVariableAccess = Atomic32BitAccess
      CPUType = CPU32Bit
      SizeOfInt = Size32Bit
      ByteOrder = LITTLE_ENDIAN
      BitOrder = LSB_to_MSB
      BitFieldDataType = INT
      DummyStatementKind = None
      ConditionalGenerating = false
      EcucBswImplementationCodeType = EcuCSourceCode
      EcuCUseStdReturnTypeForRte = false
      PostbuildLoadable: AlignmentFillPattern=255, PBROMStartAddress=0, PBRAMStartAddress=0, PBROMEndAddress=0, PBRAMEndAddress=0
      BswInitialization
        3 x InitFunction, all with InitPhase=NO_INIT:
          Brs_Init: Header=, ModuleRef=vBRS  # /ActiveEcuC/vBRS PLAIN_TEXT Automatically generated by BswInitFctConfigurationService.
          vBaseEnv_Init: Header=, ModuleRef=vBaseEnv  # /ActiveEcuC/vBaseEnv PLAIN_TEXT Created vBaseEnv_Init by Extended Init XML Service
          vLinkGen_Init: Header=vLinkGen_Lcfg.h, ModuleRef=vLinkGen  # /ActiveEcuC/vLinkGen PLAIN_TEXT Dummy initialization of the vLinkGen

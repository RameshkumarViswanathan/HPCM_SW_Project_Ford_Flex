AUTOSAR XML (schema 00050)
package /ActiveEcuC
  module config FblBmHdr: implementation-config-variant=VARIANT-PRE-COMPILE, module-description=FblBmHdr_Impl
    FblBmHdrGeneral: FblBmHdrMaxVerificationEntries=1, FblBmHdrSbVerificationList=false
    Appl (FblBmHdrTarget): FblBmHdrTargetId=2
    Data (FblBmHdrTarget): FblBmHdrTargetId=3
    FblBmHdrHeader:
      FblBmHdrEntryAddressInclude = BrsMain.h
      FblBmHdrEntryAddress = Brs_ApplicationEntry
      FblBmHdrBlockStartAddress = 2150170624
      FblBmHdrBlockLength = 458752
      FblBmHdrTargetRef = FblUpdater
      FblBmHdrVariant
        FblBmHdrAuthenticationHeader: FblBmHdrAuthenticationHeaderAddress=2150170624
    Fbl (FblBmHdrTarget): FblBmHdrTargetId=0
    FblUpdater (FblBmHdrTarget): FblBmHdrTargetId=1

AUTOSAR XML (schema 00050)
package /ActiveEcuC
  module config FblBm: implementation-config-variant=VARIANT-PRE-COMPILE, module-description=FblBm_Impl
    FblBmGeneral:
      FblBmFailsafeUpdater = false
      FblBmIncludeHardwareConfiguration = false
      FblBmIncludeOemConfiguration = false
      FblBmInitializeKeys = false
      FblBmInitializeMacOfBootloader = false
      FblBmSecureBoot = false
      FblBmHeaderAddress = 2147516384
      FblBmStandaloneMode = true
      FblBmExecutionInstance = FlashBootloaderUpdater

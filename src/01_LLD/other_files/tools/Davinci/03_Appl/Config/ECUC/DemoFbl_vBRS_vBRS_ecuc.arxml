AUTOSAR XML (schema 00050)
package /ActiveEcuC
  module config vBRS: implementation-config-variant=VARIANT-PRE-COMPILE, module-description=vBRS_Impl
    vBRSGeneral:
      vBRSEnableEcuMStubGeneration = true
      vBRSEnableSchmStubGeneration = true
      vBRSExecutionInstance = FBL
      vBRSEnableCoreSpecificVLinkGenConfig = true
      vBRSEnableSupportLEDs = false
      vBRSEnableSafeContextSupport = false
      vBRSEnableMultiCoreSupport = false
      vBRSEnableSupportToggleWdPin = false
      vBRSEnableSupportToggleCustomPin = false
      vBRSDisableSetupSupport = false
      vBRSEnableSchmStubSupportDrvCanAN = true
      vBRSEnableSchmStubEmptyExclusiveAreaHandling = false
      vBRSFirstInstance = false
      vBRSFblSupportEcuMInit = true
      vBRSFblSupportExceptionTableInRam = true
    vBRSHwConfig:
      vBRSEnablePLLClocksHandling = true
      vBRSEnablePortHandling = true
      vBRSEnableWatchdogHandling = true
      vBRSPreferPLLWatchdogInit = true
      vBRSOscClock = 20000000
      vBRSPeriphClock = 12500000
      vBRSTimebaseClock = 100000000
      vBRSPeriphClockDescription = Initial value for Peripheral Clock: 100MHz GPT=100MHz/8 =12.5MHz
      vBRSProjectName = DemoFbl
      vBRSEvaluationBoard = CUSTOMER_HARDWARE
      3 x vBRSEvalBoardInfo:
        TRIBOARD_TC3x7: vBRSEvalBoard=TRIBOARD_TC3x7, vBRSEvalBoardDescription=Toggle Port Group 33 Port 4 for LED support, vBRSEvalBoardOscClock=20000000
        TRIBOARD_TC3x9: vBRSEvalBoard=TRIBOARD_TC3x9, vBRSEvalBoardDescription=Toggle Port Group 33 Port 4 for LED support, vBRSEvalBoardOscClock=20000000
        CUSTOMER_HARDWARE: vBRSEvalBoard=CUSTOMER_HARDWARE, vBRSEvalBoardDescription=This Eval board is used for customer hardware. All pin configuration have to be specify manually in the BrsHw_Ports.h.
      vBRSDriverHandlingCAN:
        vBRSEnableDriverHandlingCAN = true
        vBRSDriverHandlingCAN_channel0 = false
        vBRSDriverHandlingCAN_channel1 = true
        vBRSDriverHandlingCAN_channel{2..9} = false
        vBRSDriverHandlingCAN_PeripheralClock = true
        vBRSDriverHandlingCAN_channel{10..19} = false
    vBRSMemoryInit: vBRSInitPatternBlocks=0, vBRSInitPatternHardResetBlocks=0, vBRSInitPatternAreas=0, vBRSInitPatternHardResetAreas=0

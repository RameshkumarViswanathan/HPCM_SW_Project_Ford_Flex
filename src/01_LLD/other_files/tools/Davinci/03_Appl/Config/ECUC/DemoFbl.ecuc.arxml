AUTOSAR XML (schema 00050)
package /ActiveEcuC
  ecuc value collection ActiveEcuC
    ecuc-values:
      Os
      MemMap
      Det
      EcuC
      Fbl
      FblHal
      Smh
      WrapNv
      vSecPrim
      Csm
      CryIf
      Crypto
      FblBmHdr
      FblBm
      vBaseEnv
      vBRS
      CanIf
      CanTp
      Can
      Dcm
      PduR
      vSet
      vLinkGen
      Mcu

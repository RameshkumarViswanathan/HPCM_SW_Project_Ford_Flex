AUTOSAR XML (schema 00050)
package /ActiveEcuC
  module config vLinkGen: implementation-config-variant=VARIANT-PRE-COMPILE, module-description=vLinkGen_Impl
    vLinkGenMemLayout
      8 x vLinkGenMemoryRegion, all with vLinkGenMemoryRegionAvailable=true:
        Rom_PresensePattern: vLinkGenMemoryRegionAddrOffset=3145600, vLinkGenMemoryRegionSize=128, vLinkGenMemoryRegionAddress=2150629248, vLinkGenMemoryRegionHwRegion=PFlash0_Cached
          Rom_PresencePattern1 (vLinkGenMemoryRegionBlock):
            vLinkGenMemoryRegionBlockPosition = 0
            vLinkGenMemoryRegionBlockSize = 64
            vLinkGenMemoryRegionBlockAddress = 2150629248
            vLinkGenMemoryRegionBlockBoundary = LOWER
            vLinkGenMemoryRegionBlockInitStage = NONE
          Rom_PresencePattern2 (vLinkGenMemoryRegionBlock):
            vLinkGenMemoryRegionBlockPosition = 1
            vLinkGenMemoryRegionBlockSize = 64
            vLinkGenMemoryRegionBlockAddress = 2150629312
            vLinkGenMemoryRegionBlockBoundary = LOWER
            vLinkGenMemoryRegionBlockInitStage = NONE
        Rom_ApplMemoryArea: vLinkGenMemoryRegionAddrOffset=2686976, vLinkGenMemoryRegionSize=385024, vLinkGenMemoryRegionAddress=2150170624, vLinkGenMemoryRegionHwRegion=PFlash0_Cached
          9 x vLinkGenMemoryRegionBlock, all with vLinkGenMemoryRegionBlockBoundary=LOWER, vLinkGenMemoryRegionBlockInitStage=NONE:
            ApplRom_ApplVect: vLinkGenMemoryRegionBlockPosition=0, vLinkGenMemoryRegionBlockSize=32, vLinkGenMemoryRegionBlockAddress=2150170624
            ApplRom_Startup: vLinkGenMemoryRegionBlockPosition=1, vLinkGenMemoryRegionBlockSize=2048, vLinkGenMemoryRegionBlockAddress=2150170656
            ApplRomArea: vLinkGenMemoryRegionBlockPosition=2, vLinkGenMemoryRegionBlockSize=344064, vLinkGenMemoryRegionBlockAddress=2150172704
            ApplBmHdrHeader: vLinkGenMemoryRegionBlockPosition=3, vLinkGenMemoryRegionBlockSize=256, vLinkGenMemoryRegionBlockAddress=2150516768
            Os_IntVect: vLinkGenMemoryRegionBlockPosition=4, vLinkGenMemoryRegionBlockSize=32768, vLinkGenMemoryRegionBlockAddress=2150517024
            Region_etk_pageswitch_mbox: vLinkGenMemoryRegionBlockPosition=5, vLinkGenMemoryRegionBlockSize=512, vLinkGenMemoryRegionBlockAddress=2150549792
            Region_etkDisTab_MemClass: vLinkGenMemoryRegionBlockPosition=6, vLinkGenMemoryRegionBlockSize=512, vLinkGenMemoryRegionBlockAddress=2150550304
            RegionBlock_BMHD0: vLinkGenMemoryRegionBlockPosition=7, vLinkGenMemoryRegionBlockSize=512, vLinkGenMemoryRegionBlockAddress=2150550816
            SwIDBlock_HPCM: vLinkGenMemoryRegionBlockPosition=8, vLinkGenMemoryRegionBlockSize=512, vLinkGenMemoryRegionBlockAddress=2150551328
        RamDsprCpu1_FordAppl_IStack: vLinkGenMemoryRegionAddrOffset=154624, vLinkGenMemoryRegionSize=29696, vLinkGenMemoryRegionAddress=1610767360, vLinkGenMemoryRegionHwRegion=DSPR1
          RamDsprCpu1_FordAppl_IStack (vLinkGenMemoryRegionBlock):
            vLinkGenMemoryRegionBlockPosition = 0
            vLinkGenMemoryRegionBlockSize = 29696
            vLinkGenMemoryRegionBlockAddress = 1610767360
            vLinkGenMemoryRegionBlockBoundary = LOWER
            vLinkGenMemoryRegionBlockInitStage = NONE
        RamDsprCpu2_FordAppl_IStack: vLinkGenMemoryRegionAddrOffset=39936, vLinkGenMemoryRegionSize=13312, vLinkGenMemoryRegionAddress=1342217216, vLinkGenMemoryRegionHwRegion=DSPR2
          RamDsprCpu2_FordAppl_IStack (vLinkGenMemoryRegionBlock):
            vLinkGenMemoryRegionBlockPosition = 0
            vLinkGenMemoryRegionBlockSize = 13312
            vLinkGenMemoryRegionBlockAddress = 1342217216
            vLinkGenMemoryRegionBlockBoundary = LOWER
            vLinkGenMemoryRegionBlockInitStage = NONE
        RamDsprCpu0_LLDAppl_Csa: vLinkGenMemoryRegionAddrOffset=229376, vLinkGenMemoryRegionSize=15344, vLinkGenMemoryRegionAddress=1879277568, vLinkGenMemoryRegionHwRegion=DSPR0
          RamDsprCpu0_LLDAppl_Csa (vLinkGenMemoryRegionBlock):
            vLinkGenMemoryRegionBlockPosition = 0
            vLinkGenMemoryRegionBlockSize = 15344
            vLinkGenMemoryRegionBlockAddress = 1879277568
            vLinkGenMemoryRegionBlockBoundary = LOWER
            vLinkGenMemoryRegionBlockInitStage = NONE
        RamDsprCpu0_IPC_ResetSafe: vLinkGenMemoryRegionAddrOffset=124736, vLinkGenMemoryRegionSize=64, vLinkGenMemoryRegionAddress=1879172928, vLinkGenMemoryRegionHwRegion=DSPR0
          RamDsprCpu0_IPC_ResetSafe (vLinkGenMemoryRegionBlock):
            vLinkGenMemoryRegionBlockPosition = 0
            vLinkGenMemoryRegionBlockSize = 64
            vLinkGenMemoryRegionBlockAddress = 1879172928
            vLinkGenMemoryRegionBlockBoundary = LOWER
            vLinkGenMemoryRegionBlockInitStage = NONE
        RamDsprCpu0_IPC: vLinkGenMemoryRegionAddrOffset=92032, vLinkGenMemoryRegionSize=32704, vLinkGenMemoryRegionAddress=1879140224, vLinkGenMemoryRegionHwRegion=DSPR0
          RamDsprCpu0_IPC (vLinkGenMemoryRegionBlock):
            vLinkGenMemoryRegionBlockPosition = 0
            vLinkGenMemoryRegionBlockSize = 32704
            vLinkGenMemoryRegionBlockAddress = 1879140224
            vLinkGenMemoryRegionBlockBoundary = LOWER
            vLinkGenMemoryRegionBlockInitStage = NONE
        RamDsprCpu0_KernelErLog_MR: vLinkGenMemoryRegionAddrOffset=8256, vLinkGenMemoryRegionSize=1856, vLinkGenMemoryRegionAddress=1879056448, vLinkGenMemoryRegionHwRegion=DSPR0
          RamDsprCpu0_KernelErLog_MR (vLinkGenMemoryRegionBlock):
            vLinkGenMemoryRegionBlockPosition = 0
            vLinkGenMemoryRegionBlockSize = 1856
            vLinkGenMemoryRegionBlockAddress = 1879056448
            vLinkGenMemoryRegionBlockBoundary = LOWER
            vLinkGenMemoryRegionBlockInitStage = NONE
      4 x vLinkGenLogicalSymbolGroup:
        HEAPWORKAROUNDLABEL: vLinkGenSymbolGroupPosition=5
          HeapWorkaroundLabel (vLinkGenLinkerSymbol): vLinkGenLinkerSymbolName=__HEAP, vLinkGenLinkerSymbolValue=8, vLinkGenLinkerSymbolPosition=0
          HeapWorkaroundLabelEnd (vLinkGenLinkerSymbol): vLinkGenLinkerSymbolName=__HEAP_END, vLinkGenLinkerSymbolValue=8, vLinkGenLinkerSymbolPosition=0
        FlashDrvSymbols: vLinkGenSymbolGroupPosition=4096, vLinkGenSymbolGroupVariant=FlashDrv
          StartupEntry (vLinkGenLinkerSymbol): vLinkGenLinkerSymbolPosition=0, vLinkGenLinkerSymbolName=brsStartupEntry, vLinkGenLinkerSymbolValue=0
        TargetCompilerSpecificOptions_FlashDrv: vLinkGenSymbolGroupPosition=4096, vLinkGenSymbolGroupVariant=FlashDrv
          StartupEntry (vLinkGenLinkerSymbol): vLinkGenLinkerSymbolPosition=0, vLinkGenLinkerSymbolName=brsStartupEntry, vLinkGenLinkerSymbolValue=0
        Startup_Labels: vLinkGenSymbolGroupPosition=5, vLinkGenSymbolGroupVariant=DemoBm, vLinkGenSymbolGroupVariant=vLinkGenVariantHandling/DemoFbl, vLinkGenSymbolGroupVariant=vLinkGenVariantHandling/DemoAppl
          7 x vLinkGenLinkerSymbol, all with vLinkGenLinkerSymbolValue=Brs_ApplicationEntry, vLinkGenLinkerSymbolPosition=0:
            Startup_Labels1: vLinkGenLinkerSymbolName=StartupEntry
            Startup_Labels2: vLinkGenLinkerSymbolName=_start_tc0
            Startup_Labels3: vLinkGenLinkerSymbolName=_start_tc1
            Startup_Labels4: vLinkGenLinkerSymbolName=_start_tc2
            Startup_Labels5: vLinkGenLinkerSymbolName=_start_tc3
            Startup_Labels6: vLinkGenLinkerSymbolName=_start_tc4
            Startup_Labels7: vLinkGenLinkerSymbolName=_start_tc5
      19 x vLinkGenLogicalConstGroup:
        FblRamCode: vLinkGenConstGroupPosition=1, vLinkGenConstGroupInitCore=0, vLinkGenConstGroupVariant=vLinkGenVariantHandling/DemoFbl, vLinkGenConstGroupVariant=DemoBm, vLinkGenConstGroupContentType=RAM_CODE, vLinkGenConstGroupRegion=BmRomArea, vLinkGenConstGroupRamRegion=RamDsprCpu0_LLDAppl_Data_Bss/RamDsprCpu0_LLDAppl_Data_Bss, vLinkGenConstGroupVariant=vLinkGenVariantHandling/DemoAppl
          RamCodeSection (vLinkGenConstSectionGroup):
            vLinkGenConstSectionGroupPosition = 0
            vLinkGenConstSectionGroupInit = COPY_TO_RAM
            vLinkGenConstSectionGroupInitStage = ONE
            vLinkGenConstSectionGroupAlignment = 4
            vLinkGenConstSectionGroupEndAlignment = 4
            vLinkGenConstSectionGroupRef = RamCodeCoreSection
          vLinkGenConstGroupVariantHandling
            DemoFbl (vLinkGenConstGroupVariantSpecifics): vLinkGenConstGroupSpecificRegion=FblRomArea, vLinkGenConstGroupSpecificVariant=vLinkGenVariantHandling/DemoFbl
            DemoAppl (vLinkGenConstGroupVariantSpecifics): vLinkGenConstGroupSpecificRegion=ApplRomArea, vLinkGenConstGroupSpecificVariant=vLinkGenVariantHandling/DemoAppl
        FblRamConst: vLinkGenConstGroupPosition=0, vLinkGenConstGroupInitCore=0, vLinkGenConstGroupVariant=vLinkGenVariantHandling/DemoFbl, vLinkGenConstGroupVariant=DemoBm, vLinkGenConstGroupContentType=RAM_CONST, vLinkGenConstGroupRegion=BmRomArea, vLinkGenConstGroupRamRegion=RamDsprCpu0_LLDAppl_Data_Bss/RamDsprCpu0_LLDAppl_Data_Bss, vLinkGenConstGroupVariant=vLinkGenVariantHandling/DemoAppl
          RamConstSection (vLinkGenConstSectionGroup):
            vLinkGenConstSectionGroupPosition = 0
            vLinkGenConstSectionGroupInit = COPY_TO_RAM
            vLinkGenConstSectionGroupInitStage = ONE
            vLinkGenConstSectionGroupAlignment = 4
            vLinkGenConstSectionGroupEndAlignment = 4
            vLinkGenConstSectionGroupRef = vLinkGenLinkerSections/RamConstSection
          vLinkGenConstGroupVariantHandling
            DemoFbl (vLinkGenConstGroupVariantSpecifics): vLinkGenConstGroupSpecificRegion=FblRomArea, vLinkGenConstGroupSpecificVariant=vLinkGenVariantHandling/DemoFbl
            DemoAppl (vLinkGenConstGroupVariantSpecifics): vLinkGenConstGroupSpecificRegion=ApplRomArea, vLinkGenConstGroupSpecificVariant=vLinkGenVariantHandling/DemoAppl
        MSR_CODE: vLinkGenConstGroupPosition=50, vLinkGenConstGroupContentType=GLOBAL_CODE, vLinkGenConstGroupVariant=vLinkGenVariantHandling/DemoFbl, vLinkGenConstGroupVariant=DemoBm, vLinkGenConstGroupVariant=vLinkGenVariantHandling/DemoAppl, vLinkGenConstGroupRegion=BmRomArea
          MSR_CODE (vLinkGenConstSectionGroup):
            vLinkGenConstSectionGroupPosition = 0
            vLinkGenConstSectionGroupInit = NONE
            vLinkGenConstSectionGroupInitStage = ONE
            vLinkGenConstSectionGroupRef = vLinkGenLinkerSections/MSR_CODE
          vLinkGenConstGroupVariantHandling
            DemoFbl (vLinkGenConstGroupVariantSpecifics): vLinkGenConstGroupSpecificRegion=FblRomArea, vLinkGenConstGroupSpecificVariant=vLinkGenVariantHandling/DemoFbl
            DemoAppl (vLinkGenConstGroupVariantSpecifics): vLinkGenConstGroupSpecificRegion=ApplRomArea, vLinkGenConstGroupSpecificVariant=vLinkGenVariantHandling/DemoAppl
        MSR_CONST: vLinkGenConstGroupPosition=50, vLinkGenConstGroupContentType=GLOBAL_CONST, vLinkGenConstGroupVariant=vLinkGenVariantHandling/DemoFbl, vLinkGenConstGroupVariant=DemoBm, vLinkGenConstGroupVariant=vLinkGenVariantHandling/DemoAppl, vLinkGenConstGroupRegion=BmRomArea
          MSR_CONST (vLinkGenConstSectionGroup):
            vLinkGenConstSectionGroupPosition = 0
            vLinkGenConstSectionGroupInit = NONE
            vLinkGenConstSectionGroupInitStage = ONE
            vLinkGenConstSectionGroupRef = vLinkGenLinkerSections/MSR_CONST
            vLinkGenConstSectionGroupRef = MSR_CONST_FAST
          vLinkGenConstGroupVariantHandling
            DemoFbl (vLinkGenConstGroupVariantSpecifics): vLinkGenConstGroupSpecificRegion=FblRomArea, vLinkGenConstGroupSpecificVariant=vLinkGenVariantHandling/DemoFbl
            DemoAppl (vLinkGenConstGroupVariantSpecifics): vLinkGenConstGroupSpecificRegion=ApplRomArea, vLinkGenConstGroupSpecificVariant=vLinkGenVariantHandling/DemoAppl
        MSR_PBCFG_CONST: vLinkGenConstGroupPosition=50, vLinkGenConstGroupContentType=GLOBAL_CONST, vLinkGenConstGroupVariant=vLinkGenVariantHandling/DemoFbl, vLinkGenConstGroupVariant=DemoBm, vLinkGenConstGroupVariant=vLinkGenVariantHandling/DemoAppl, vLinkGenConstGroupRegion=BmRomArea
          MSR_PBCFG_CONST (vLinkGenConstSectionGroup):
            vLinkGenConstSectionGroupPosition = 0
            vLinkGenConstSectionGroupInit = NONE
            vLinkGenConstSectionGroupInitStage = ONE
            vLinkGenConstSectionGroupRef = vLinkGenLinkerSections/MSR_PBCFG_CONST
            vLinkGenConstSectionGroupRef = MSR_PBCFG_CONST_FAST
          vLinkGenConstGroupVariantHandling
            DemoFbl (vLinkGenConstGroupVariantSpecifics): vLinkGenConstGroupSpecificRegion=FblRomArea, vLinkGenConstGroupSpecificVariant=vLinkGenVariantHandling/DemoFbl
            DemoAppl (vLinkGenConstGroupVariantSpecifics): vLinkGenConstGroupSpecificRegion=ApplRomArea, vLinkGenConstGroupSpecificVariant=vLinkGenVariantHandling/DemoAppl
        Brs_ExcVectRam: vLinkGenConstGroupInitCore=0, vLinkGenConstGroupPosition=5, vLinkGenConstGroupContentType=RAM_CONST, vLinkGenConstGroupRegion=BmRomArea, vLinkGenConstGroupRamRegion=RamDsprCpu0_LLDAppl_Data_Bss/RamDsprCpu0_LLDAppl_Data_Bss, vLinkGenConstGroupVariant=vLinkGenVariantHandling/DemoFbl, vLinkGenConstGroupVariant=vLinkGenVariantHandling/DemoAppl
          Brs_ExcVectRam (vLinkGenConstSectionGroup):
            vLinkGenConstSectionGroupAlignment = 256
            vLinkGenConstSectionGroupEndAlignment = 8
            vLinkGenConstSectionGroupGapSize = 16
            vLinkGenConstSectionGroupInit = COPY_TO_RAM
            vLinkGenConstSectionGroupInitStage = ONE
            vLinkGenConstSectionGroupPosition = 0
            vLinkGenConstSectionGroupRef = brsExcVectRam
          vLinkGenConstGroupVariantHandling
            DemoFbl (vLinkGenConstGroupVariantSpecifics): vLinkGenConstGroupSpecificRegion=FblRomArea, vLinkGenConstGroupSpecificVariant=vLinkGenVariantHandling/DemoFbl
            DemoAppl (vLinkGenConstGroupVariantSpecifics): vLinkGenConstGroupSpecificRegion=ApplRomArea, vLinkGenConstGroupSpecificVariant=vLinkGenVariantHandling/DemoAppl
        Brs_ExcVect: vLinkGenConstGroupPosition=2, vLinkGenConstGroupContentType=GLOBAL_EXCVEC_CONST, vLinkGenConstGroupVariant=DemoBm, vLinkGenConstGroupRegion=BmRom_Startup
          Brs_ExcVect (vLinkGenConstSectionGroup):
            vLinkGenConstSectionGroupAlignment = 256
            vLinkGenConstSectionGroupEndAlignment = 8
            vLinkGenConstSectionGroupGapSize = 16
            vLinkGenConstSectionGroupPosition = 0
            vLinkGenConstSectionGroupInit = NONE
            vLinkGenConstSectionGroupInitStage = ONE
            vLinkGenConstSectionGroupRef = brsExcVect
            vLinkGenConstSectionGroupRef = brsExcVectConst
        Brs_Startup_Code: vLinkGenConstGroupPosition=1, vLinkGenConstGroupContentType=STARTUP_CODE, vLinkGenConstGroupVariant=DemoBm, vLinkGenConstGroupRegion=BmRom_Startup, vLinkGenConstGroupVariant=vLinkGenVariantHandling/DemoFbl, vLinkGenConstGroupVariant=vLinkGenVariantHandling/DemoAppl
          Brs_Startup_Code (vLinkGenConstSectionGroup):
            vLinkGenConstSectionGroupPosition = 0
            vLinkGenConstSectionGroupInit = NONE
            vLinkGenConstSectionGroupInitStage = ONE
            vLinkGenConstSectionGroupRef = brsStartup
          BrsMain_Startup_Code (vLinkGenConstSectionGroup):
            vLinkGenConstSectionGroupPosition = 0
            vLinkGenConstSectionGroupInit = NONE
            vLinkGenConstSectionGroupInitStage = ONE
            vLinkGenConstSectionGroupRef = brsMainStartup
          vLinkGenConstGroupVariantHandling
            DemoAppl (vLinkGenConstGroupVariantSpecifics): vLinkGenConstGroupSpecificRegion=ApplRom_Startup, vLinkGenConstGroupSpecificVariant=vLinkGenVariantHandling/DemoAppl
            DemoFbl (vLinkGenConstGroupVariantSpecifics): vLinkGenConstGroupSpecificRegion=FblRomStartup, vLinkGenConstGroupSpecificVariant=vLinkGenVariantHandling/DemoFbl
        Brs_Shared_Const: vLinkGenConstGroupPosition=5, vLinkGenConstGroupContentType=GLOBAL_CONST, vLinkGenConstGroupVariant=DemoBm, vLinkGenConstGroupVariant=vLinkGenVariantHandling/DemoFbl, vLinkGenConstGroupVariant=vLinkGenVariantHandling/DemoAppl, vLinkGenConstGroupRegion=BmRomArea
          Brs_Shared_Const (vLinkGenConstSectionGroup):
            vLinkGenConstSectionGroupPosition = 0
            vLinkGenConstSectionGroupInit = NONE
            vLinkGenConstSectionGroupInitStage = ONE
            vLinkGenConstSectionGroupRef = brsSharedConst
          vLinkGenConstGroupVariantHandling
            DemoAppl (vLinkGenConstGroupVariantSpecifics): vLinkGenConstGroupSpecificVariant=vLinkGenVariantHandling/DemoAppl, vLinkGenConstGroupSpecificRegion=ApplRomArea
        Const_Default: vLinkGenConstGroupPosition=1000, vLinkGenConstGroupRegion=BmRomArea, vLinkGenConstGroupVariant=vLinkGenVariantHandling/DemoFbl, vLinkGenConstGroupVariant=DemoBm, vLinkGenConstGroupVariant=vLinkGenVariantHandling/DemoAppl, vLinkGenConstGroupContentType=GLOBAL_CONST
          vLinkGenConstGroupVariantHandling
            DemoFbl (vLinkGenConstGroupVariantSpecifics): vLinkGenConstGroupSpecificRegion=FblRomArea, vLinkGenConstGroupSpecificVariant=vLinkGenVariantHandling/DemoFbl
            DemoAppl (vLinkGenConstGroupVariantSpecifics): vLinkGenConstGroupSpecificRegion=ApplRomArea, vLinkGenConstGroupSpecificVariant=vLinkGenVariantHandling/DemoAppl
          6 x vLinkGenConstSectionGroup, all with vLinkGenConstSectionGroupPosition=0, vLinkGenConstSectionGroupInit=NONE, vLinkGenConstSectionGroupInitStage=ONE:
            text: vLinkGenConstSectionGroupFlag=vLinkGenConstGroupFlags/EXECUTE, vLinkGenConstSectionGroupRef=vLinkGenLinkerSections/text, vLinkGenConstSectionGroupRef=text_all
            text_vle: vLinkGenConstSectionGroupFlag=vLinkGenConstGroupFlags/EXECUTE, vLinkGenConstSectionGroupFlag=VLE_CODE, vLinkGenConstSectionGroupRef=vLinkGenLinkerSections/text_vle, vLinkGenConstSectionGroupRef=text_vle_all
            rodata: vLinkGenConstSectionGroupFlag=vLinkGenConstGroupFlags/READ, vLinkGenConstSectionGroupRef=vLinkGenLinkerSections/rodata, vLinkGenConstSectionGroupRef=rodata_all
            srodata: vLinkGenConstSectionGroupFlag=vLinkGenConstGroupFlags/READ, vLinkGenConstSectionGroupFlag=vLinkGenConstGroupFlags/SMALL_ADDRESSING, vLinkGenConstSectionGroupRef=vLinkGenLinkerSections/srodata, vLinkGenConstSectionGroupRef=srodata_all
            zrodata: vLinkGenConstSectionGroupFlag=vLinkGenConstGroupFlags/READ, vLinkGenConstSectionGroupFlag=vLinkGenConstGroupFlags/ABSOLUTE_ADDRESSING, vLinkGenConstSectionGroupRef=vLinkGenLinkerSections/zrodata, vLinkGenConstSectionGroupRef=zrodata_all
            sdata2: vLinkGenConstSectionGroupFlag=vLinkGenConstGroupFlags/READ, vLinkGenConstSectionGroupFlag=vLinkGenConstGroupFlags/SMALL_ADDRESSING, vLinkGenConstSectionGroupRef=vLinkGenLinkerSections/sdata2, vLinkGenConstSectionGroupRef=sdata2_all
        Fbl_FblHeader: vLinkGenConstGroupPosition=0, vLinkGenConstGroupRegion=FblBmHdrHeader, vLinkGenConstGroupVariant=vLinkGenVariantHandling/DemoFbl
          FblHeaderSectionGroup (vLinkGenConstSectionGroup):
            vLinkGenConstSectionGroupPosition = 0
            vLinkGenConstSectionGroupInit = NONE
            vLinkGenConstSectionGroupInitStage = ONE
            vLinkGenConstSectionGroupRef = FblHeaderSection
        FblAppl_BmHdrHeader: vLinkGenConstGroupPosition=0, vLinkGenConstGroupRegion=FblHeader, vLinkGenConstGroupVariant=vLinkGenVariantHandling/DemoFbl, vLinkGenConstGroupVariant=vLinkGenVariantHandling/DemoAppl
          FblBmHdrHeaderGroup (vLinkGenConstSectionGroup):
            vLinkGenConstSectionGroupPosition = 0
            vLinkGenConstSectionGroupInit = NONE
            vLinkGenConstSectionGroupInitStage = ONE
            vLinkGenConstSectionGroupRef = BmHdrHeaderSection
          vLinkGenConstGroupVariantHandling
            DemoFbl (vLinkGenConstGroupVariantSpecifics): vLinkGenConstGroupSpecificRegion=FblHeader, vLinkGenConstGroupSpecificVariant=vLinkGenVariantHandling/DemoFbl
            DemoAppl (vLinkGenConstGroupVariantSpecifics): vLinkGenConstGroupSpecificRegion=ApplBmHdrHeader, vLinkGenConstGroupSpecificVariant=vLinkGenVariantHandling/DemoAppl
        Fbl_PresencePattern: vLinkGenConstGroupPosition=0, vLinkGenConstGroupRegion=FblBlockValPresencePattern, vLinkGenConstGroupVariant=vLinkGenVariantHandling/DemoFbl
          Fbl_PP (vLinkGenConstSectionGroup):
            vLinkGenConstSectionGroupPosition = 0
            vLinkGenConstSectionGroupInit = NONE
            vLinkGenConstSectionGroupInitStage = HARD_RESET_ONLY
            vLinkGenConstSectionGroupRef = FblPresencePatternSection
        Appl_ApplVect: vLinkGenConstGroupPosition=5, vLinkGenConstGroupRegion=ApplRom_ApplVect, vLinkGenConstGroupVariant=vLinkGenVariantHandling/DemoFbl, vLinkGenConstGroupVariant=vLinkGenVariantHandling/DemoAppl
          APPLVECT (vLinkGenConstSectionGroup):
            vLinkGenConstSectionGroupSize = 8
            vLinkGenConstSectionGroupAlignment = 4
            vLinkGenConstSectionGroupPosition = 0
            vLinkGenConstSectionGroupInit = NONE
            vLinkGenConstSectionGroupInitStage = ONE
            vLinkGenConstSectionGroupRef = ApplVectSection
        Bm_BmHeader: vLinkGenConstGroupPosition=0, vLinkGenConstGroupRegion=BmHeader, vLinkGenConstGroupVariant=DemoBm
          BmHeaderSectionGroup (vLinkGenConstSectionGroup):
            vLinkGenConstSectionGroupPosition = 0
            vLinkGenConstSectionGroupInit = NONE
            vLinkGenConstSectionGroupInitStage = ONE
            vLinkGenConstSectionGroupRef = BmHeaderSection
        FlashDrv_Header: vLinkGenConstGroupPosition=0, vLinkGenConstGroupVariant=FlashDrv, vLinkGenConstGroupRegion=RamDsprCpu0_FlashDrvArea
          FlashDrvHeaderSectionGroup (vLinkGenConstSectionGroup):
            vLinkGenConstSectionGroupPosition = 0
            vLinkGenConstSectionGroupInit = NONE
            vLinkGenConstSectionGroupInitStage = ONE
            vLinkGenConstSectionGroupRef = FlashDrvHeaderSection
        FlashDrv_Code: vLinkGenConstGroupPosition=500, vLinkGenConstGroupRegion=RamDsprCpu0_FlashDrvArea, vLinkGenConstGroupVariant=FlashDrv
          FlashDrv_CodeGroup (vLinkGenConstSectionGroup):
            vLinkGenConstSectionGroupPosition = 0
            vLinkGenConstSectionGroupInit = NONE
            vLinkGenConstSectionGroupInitStage = ONE
            vLinkGenConstSectionGroupRef = vLinkGenLinkerSections/text
            vLinkGenConstSectionGroupRef = text_all
            vLinkGenConstSectionGroupRef = vLinkGenLinkerSections/text_vle
            vLinkGenConstSectionGroupRef = text_vle_all
            vLinkGenConstSectionGroupFlag = vLinkGenConstGroupFlags/EXECUTE
        FlashDrv_Const: vLinkGenConstGroupPosition=500, vLinkGenConstGroupRegion=RamDsprCpu0_FlashDrvArea, vLinkGenConstGroupVariant=FlashDrv
          FlashDrv_ConstGroup (vLinkGenConstSectionGroup):
            vLinkGenConstSectionGroupPosition = 0
            vLinkGenConstSectionGroupInit = NONE
            vLinkGenConstSectionGroupInitStage = ONE
            vLinkGenConstSectionGroupRef = vLinkGenLinkerSections/rodata
            vLinkGenConstSectionGroupRef = rodata_all
            vLinkGenConstSectionGroupRef = vLinkGenLinkerSections/srodata
            vLinkGenConstSectionGroupRef = srodata_all
            vLinkGenConstSectionGroupRef = vLinkGenLinkerSections/zrodata
            vLinkGenConstSectionGroupRef = zrodata_all
            vLinkGenConstSectionGroupRef = vLinkGenLinkerSections/sdata2
            vLinkGenConstSectionGroupRef = sdata2_all
        FlashDrv_SpecialCode: vLinkGenConstGroupPosition=500, vLinkGenConstGroupRegion=RamDsprCpu0_FlashDrvArea, vLinkGenConstGroupVariant=FlashDrv
          FlashDrv_SpecialCodeGroup (vLinkGenConstSectionGroup):
            vLinkGenConstSectionGroupPosition = 0
            vLinkGenConstSectionGroupInit = NONE
            vLinkGenConstSectionGroupInitStage = ONE
            vLinkGenConstSectionGroupFlag = vLinkGenConstGroupFlags/EXECUTE
            vLinkGenConstSectionGroupRef = traptab
      vLinkGenLinkerSections
        MSR_CODE (vLinkGenLinkerCodeSection): vLinkGenLinkerCodeSectionName=MSR_CODE, vLinkGenLinkerCodeSectionFast=false
        5 x vLinkGenLinkerConstSection:
          MSR_CONST: vLinkGenLinkerConstSectionName=MSR_CONST, vLinkGenLinkerConstSectionFast=false
          MSR_PBCFG_CONST: vLinkGenLinkerConstSectionName=MSR_PBCFG_CONST, vLinkGenLinkerConstSectionFast=false
          MSR_CONST_FAST: vLinkGenLinkerConstSectionFast=true, vLinkGenLinkerConstSectionName=MSR_CONST_FAST
          MSR_PBCFG_CONST_FAST: vLinkGenLinkerConstSectionFast=true, vLinkGenLinkerConstSectionName=MSR_PBCFG_CONST_FAST
          BMHD0: vLinkGenLinkerConstSectionName=BMHD0, vLinkGenLinkerConstSectionAlignment=32, vLinkGenLinkerConstSectionFast=false, vLinkGenLinkerConstSectionFlag=vLinkGenConstSectionFlags/KEEP
        3 x vLinkGenLinkerCodeSection, all with vLinkGenLinkerCodeSectionFast=false, vLinkGenLinkerCodeSectionFlag=vLinkGenConstSectionFlags/KEEP:
          brsStartup: vLinkGenLinkerCodeSectionName=brsStartup, vLinkGenLinkerCodeSectionAlignment=8
          brsExcVect: vLinkGenLinkerCodeSectionName=brsExcVect
          brsSharedConst: vLinkGenLinkerCodeSectionName=brsSharedConst
        brsExcVectConst (vLinkGenLinkerConstSection):
          vLinkGenLinkerConstSectionName = brsExcVectConst
          vLinkGenLinkerConstSectionFast = false
          vLinkGenLinkerConstSectionFlag = vLinkGenConstSectionFlags/KEEP
        brsExcVectRam (vLinkGenLinkerCodeSection): vLinkGenLinkerCodeSectionName=brsExcVectRam, vLinkGenLinkerCodeSectionFast=false, vLinkGenLinkerCodeSectionFlag=vLinkGenConstSectionFlags/KEEP
        brsMainStartup (vLinkGenLinkerCodeSection): vLinkGenLinkerCodeSectionName=brsMainStartup, vLinkGenLinkerCodeSectionFast=false
        brsSharedVar (vLinkGenLinkerVarSection): vLinkGenLinkerVarSectionName=brsSharedVar, vLinkGenLinkerVarSectionFast=false
        RamCodeCoreSection (vLinkGenLinkerCodeSection): vLinkGenLinkerCodeSectionName=RamCodeCoreSection, vLinkGenLinkerCodeSectionFast=false, vLinkGenLinkerCodeSectionAlignment=0
        EepDummySection (vLinkGenLinkerVarSection): vLinkGenLinkerVarSectionName=EepDummySection, vLinkGenLinkerVarSectionFast=false, vLinkGenLinkerVarSectionAlignment=0
        4 x vLinkGenLinkerConstSection, all with vLinkGenLinkerConstSectionFast=false, vLinkGenLinkerConstSectionAlignment=0:
          BmHeaderSection: vLinkGenLinkerConstSectionName=BmHeaderSection
          RamConstSection: vLinkGenLinkerConstSectionName=RamConstSection
          FblHeaderSection: vLinkGenLinkerConstSectionName=FblHeaderSection
          BmHdrHeaderSection: vLinkGenLinkerConstSectionName=BmHdrHeaderSection, vLinkGenLinkerConstSectionFlag=vLinkGenConstSectionFlags/KEEP
        MagicFlagSection (vLinkGenLinkerVarSection): vLinkGenLinkerVarSectionName=MagicFlagSection, vLinkGenLinkerVarSectionFast=false, vLinkGenLinkerVarSectionAlignment=0
        3 x vLinkGenLinkerConstSection, all with vLinkGenLinkerConstSectionFast=false:
          FblPresencePatternSection: vLinkGenLinkerConstSectionName=FblPresencePatternSection, vLinkGenLinkerConstSectionFlag=vLinkGenConstSectionFlags/KEEP
          ApplVectSection: vLinkGenLinkerConstSectionName=ApplVectSection, vLinkGenLinkerConstSectionFlag=vLinkGenConstSectionFlags/KEEP
          FblManualConstSection: vLinkGenLinkerConstSectionName=rodata, vLinkGenLinkerConstSectionFiles=fbl_diag_oem
        FblFlashDrvSection (vLinkGenLinkerVarSection): vLinkGenLinkerVarSectionName=FblFlashDrvSection, vLinkGenLinkerVarSectionFast=false, vLinkGenLinkerVarSectionAlignment=0
        FlashDrvHeaderSection (vLinkGenLinkerConstSection): vLinkGenLinkerConstSectionName=FlashDrvHeaderSection, vLinkGenLinkerConstSectionFast=false
        text (vLinkGenLinkerCodeSection): vLinkGenLinkerCodeSectionName=text, vLinkGenLinkerCodeSectionFast=false
        text_all (vLinkGenLinkerSpecSection): vLinkGenLinkerSpecSectionValue=.text.*, vLinkGenLinkerSpecSectionPad=0
        text_vle (vLinkGenLinkerCodeSection): vLinkGenLinkerCodeSectionName=text_vle, vLinkGenLinkerCodeSectionFast=false
        text_vle_all (vLinkGenLinkerSpecSection): vLinkGenLinkerSpecSectionValue=.text_vle.*, vLinkGenLinkerSpecSectionPad=0
        rodata (vLinkGenLinkerConstSection): vLinkGenLinkerConstSectionName=rodata, vLinkGenLinkerConstSectionFast=false
        rodata_all (vLinkGenLinkerSpecSection): vLinkGenLinkerSpecSectionValue=.rodata.*, vLinkGenLinkerSpecSectionPad=0
        srodata (vLinkGenLinkerConstSection): vLinkGenLinkerConstSectionName=srodata, vLinkGenLinkerConstSectionFast=true
        srodata_all (vLinkGenLinkerSpecSection): vLinkGenLinkerSpecSectionValue=.srodata.*, vLinkGenLinkerSpecSectionPad=0
        zrodata (vLinkGenLinkerConstSection): vLinkGenLinkerConstSectionName=zrodata, vLinkGenLinkerConstSectionFast=true
        zrodata_all (vLinkGenLinkerSpecSection): vLinkGenLinkerSpecSectionValue=.zrodata.*, vLinkGenLinkerSpecSectionPad=0
        sdata2 (vLinkGenLinkerConstSection): vLinkGenLinkerConstSectionName=sdata2, vLinkGenLinkerConstSectionFast=true
        sdata2_all (vLinkGenLinkerSpecSection): vLinkGenLinkerSpecSectionValue=.sdata2.*, vLinkGenLinkerSpecSectionPad=0
        data (vLinkGenLinkerVarSection): vLinkGenLinkerVarSectionName=data, vLinkGenLinkerVarSectionFast=false
        data_all (vLinkGenLinkerSpecSection): vLinkGenLinkerSpecSectionValue=.data.*, vLinkGenLinkerSpecSectionPad=0
        zdata (vLinkGenLinkerVarSection): vLinkGenLinkerVarSectionName=zdata, vLinkGenLinkerVarSectionFast=true
        zdata_all (vLinkGenLinkerSpecSection): vLinkGenLinkerSpecSectionValue=.zdata.*, vLinkGenLinkerSpecSectionPad=0
        sdata (vLinkGenLinkerVarSection): vLinkGenLinkerVarSectionName=sdata, vLinkGenLinkerVarSectionFast=true
        sdata_all (vLinkGenLinkerSpecSection): vLinkGenLinkerSpecSectionValue=.sdata.*, vLinkGenLinkerSpecSectionPad=0
        bss (vLinkGenLinkerVarSection): vLinkGenLinkerVarSectionName=bss, vLinkGenLinkerVarSectionFast=false
        bss_all (vLinkGenLinkerSpecSection): vLinkGenLinkerSpecSectionValue=.bss.*, vLinkGenLinkerSpecSectionPad=0
        sbss (vLinkGenLinkerVarSection): vLinkGenLinkerVarSectionName=sbss, vLinkGenLinkerVarSectionFast=true
        sbss_all (vLinkGenLinkerSpecSection): vLinkGenLinkerSpecSectionValue=.sbss.*, vLinkGenLinkerSpecSectionPad=0
        zbss (vLinkGenLinkerVarSection): vLinkGenLinkerVarSectionName=zbss, vLinkGenLinkerVarSectionFast=true
        zbss_all (vLinkGenLinkerSpecSection): vLinkGenLinkerSpecSectionValue=.zbss.*, vLinkGenLinkerSpecSectionPad=0
        COMMON (vLinkGenLinkerSpecSection): vLinkGenLinkerSpecSectionValue=COMMON, vLinkGenLinkerSpecSectionPad=0
        traptab (vLinkGenLinkerConstSection): vLinkGenLinkerConstSectionName=traptab, vLinkGenLinkerConstSectionFast=false
        brsResetLabel (vLinkGenLinkerCodeSection): vLinkGenLinkerCodeSectionName=brsResetLabel, vLinkGenLinkerCodeSectionFast=false, vLinkGenLinkerCodeSectionAlignment=0
        3 x vLinkGenLinkerConstSection, all with vLinkGenLinkerConstSectionFast=false:
          SlpHeaderSection: vLinkGenLinkerConstSectionName=SlpHeaderSection
          SlpConstSection: vLinkGenLinkerConstSectionName=SlpConstSection
          PseudoFlashDrvSection: vLinkGenLinkerConstSectionName=PseudoFlashDrvSection
        29 x vLinkGenLinkerVarSection, all with vLinkGenLinkerVarSectionFast=false:
          RamDcsram_CPU2_Section: vLinkGenLinkerVarSectionName=RamDcsram_CPU2_Section
          RamDcsram_CPU0_Section: vLinkGenLinkerVarSectionName=RamDcsram_CPU0_Section
          RamDcsram_CPU1_Section: vLinkGenLinkerVarSectionName=RamDcsram_CPU1_Section
          RamDctagsramCPU{0..2}_Section: vLinkGenLinkerVarSectionName=RamDctagsramCPU0_Section
          RamPcsramCPU0_Section: vLinkGenLinkerVarSectionName=RamPcsramCPU0_Section
          RamPcsramCPU2_Section: vLinkGenLinkerVarSectionName=RamPcsramCPU2_Section
          RamPcsramCPU1_Section: vLinkGenLinkerVarSectionName=RamPcsramCPU1_Section
          RamPctagsramCPU{0..2}_Section: vLinkGenLinkerVarSectionName=RamPctagsramCPU{0..2}_Section
          RamPcpsramCPU{0..2}_Section: vLinkGenLinkerVarSectionName=RamPcpsramCPU{0..2}_Section
          RamDlmuCPU1_Section: vLinkGenLinkerVarSectionName=RamDlmuCPU1_Section
          RamDlmuCPU0_Section: vLinkGenLinkerVarSectionName=RamDlmuCPU0_Section
          RamDlmuCPU2_Section: vLinkGenLinkerVarSectionName=RamDlmuCPU2_Section
          RamDsprCpu0SysKAM_Section: vLinkGenLinkerVarSectionName=RamDsprCpu0SysKAM_Section
          RamDsprCpu0KernelErLogMR_Section: vLinkGenLinkerVarSectionName=RamDsprCpu0KernelErLogMR_Section
          RamDsprCpu0CalibShadowTbl_Section: vLinkGenLinkerVarSectionName=RamDsprCpu0CalibShadowTbl_Section
          RamDsprCpu0FDApppDataShadow_Section: vLinkGenLinkerVarSectionName=RamDsprCpu0FDApppDataShadow_Section
          RamDsprCpu0NVRamSdataSbss_Section: vLinkGenLinkerVarSectionName=RamDsprCpu0NVRamSdataSbss_Section
          RamDsprCpu0IPC_Section: vLinkGenLinkerVarSectionName=RamDsprCpu0IPC_Section
          RamDsprCpu2FordApplSdata_Section: vLinkGenLinkerVarSectionName=RamDsprCpu2FordApplSdata_Section
          RamDsprCpu2FordApplBssData_Section: vLinkGenLinkerVarSectionName=RamDsprCpu2FordApplBssData_Section
          RamDsprCpu1FordAppl_Sdata_Section: vLinkGenLinkerVarSectionName=RamDsprCpu1FordAppl_Sdata_Section
          RamDsprCpu1FordApplBssdata_Section: vLinkGenLinkerVarSectionName=RamDsprCpu1FordApplBssdata_Section
          RamDsprCpu0XHBuffer_Section: vLinkGenLinkerVarSectionName=RamDsprCpu0XHBuffer_Section
        10 x vLinkGenLinkerCodeSection, all with vLinkGenLinkerCodeSectionFast=false:
          Appl_RomFblPP1_Section: vLinkGenLinkerCodeSectionName=Appl_RomFblPP1_Section, vLinkGenLinkerCodeSectionAlignment=8, vLinkGenLinkerCodeSectionFlag=vLinkGenConstSectionFlags/KEEP
          Appl_RomFblPP2_Section: vLinkGenLinkerCodeSectionName=Appl_RomFblPP2_Section, vLinkGenLinkerCodeSectionAlignment=8, vLinkGenLinkerCodeSectionFlag=vLinkGenConstSectionFlags/KEEP
          SID_Block_Section: vLinkGenLinkerCodeSectionName=SID_Block_Section, vLinkGenLinkerCodeSectionFlag=vLinkGenConstSectionFlags/KEEP
          Etk_Pageswitch_Mbox_Section: vLinkGenLinkerCodeSectionName=Etk_Pageswitch_Mbox_Section, vLinkGenLinkerCodeSectionFlag=vLinkGenConstSectionFlags/KEEP
          Etk_DisTab_MemClass_Section: vLinkGenLinkerCodeSectionName=Etk_DisTab_MemClass_Section, vLinkGenLinkerCodeSectionFlag=vLinkGenConstSectionFlags/KEEP
          INTVECT: vLinkGenLinkerCodeSectionName=INTVECT, vLinkGenLinkerCodeSectionAlignment=8, vLinkGenLinkerCodeSectionFlag=vLinkGenConstSectionFlags/KEEP
          inttab_osinterrupts: vLinkGenLinkerCodeSectionName=inttab.osinterrupts, vLinkGenLinkerCodeSectionAlignment=8, vLinkGenLinkerCodeSectionFlag=vLinkGenConstSectionFlags/KEEP
          os_interrupt_code_ostraps: vLinkGenLinkerCodeSectionName=os_interrupt_code.ostraps, vLinkGenLinkerCodeSectionAlignment=8, vLinkGenLinkerCodeSectionFlag=vLinkGenConstSectionFlags/KEEP
          OS_INTVEC_CORE0_CODE_START: vLinkGenLinkerCodeSectionName=_OS_INTVEC_CORE0_CODE_START, vLinkGenLinkerCodeSectionAlignment=8
          Os_Interrupt_Code_OsInterrupts: vLinkGenLinkerCodeSectionName=os_interrupt_code.osinterrupts, vLinkGenLinkerCodeSectionAlignment=8
      7 x vLinkGenMemoryRegion, all with vLinkGenMemoryRegionAvailable=true:
        RamDsprCpu0_LLDAppl_Data_Bss: vLinkGenMemoryRegionAddrOffset=124800, vLinkGenMemoryRegionSize=91264, vLinkGenMemoryRegionAddress=1879172992, vLinkGenMemoryRegionHwRegion=DSPR0
          RamDsprCpu0_LLDAppl_Data_Bss (vLinkGenMemoryRegionBlock):
            vLinkGenMemoryRegionBlockCore = 0
            vLinkGenMemoryRegionBlockPosition = 0
            vLinkGenMemoryRegionBlockSize = 91264
            vLinkGenMemoryRegionBlockAddress = 1879172992
            vLinkGenMemoryRegionBlockBoundary = LOWER
            vLinkGenMemoryRegionBlockInitStage = NONE
            vLinkGenMemoryRegionBlockContentType = GLOBAL_DATA
            vLinkGenMemoryRegionBlockContentType = LOCAL_DATA
            vLinkGenMemoryRegionBlockContentType = RAM_CODE_COPY
            vLinkGenMemoryRegionBlockContentType = RAM_CONST_COPY
            vLinkGenMemoryRegionBlockContentType = RETENTION_DATA
            vLinkGenMemoryRegionBlockContentType = STACKS
        Rom_BmMemoryArea: vLinkGenMemoryRegionAddrOffset=0, vLinkGenMemoryRegionSize=32768, vLinkGenMemoryRegionAddress=2147483648, vLinkGenMemoryRegionHwRegion=PFlash0_Cached
          3 x vLinkGenMemoryRegionBlock, all with vLinkGenMemoryRegionBlockInitStage=NONE:
            BmRom_Startup: vLinkGenMemoryRegionBlockSize=768, vLinkGenMemoryRegionBlockPosition=0, vLinkGenMemoryRegionBlockAddress=2147483648, vLinkGenMemoryRegionBlockBoundary=LOWER, vLinkGenMemoryRegionBlockContentType=STARTUP_CODE
            BmRomArea: vLinkGenMemoryRegionBlockPosition=1, vLinkGenMemoryRegionBlockSize=31966, vLinkGenMemoryRegionBlockAddress=2147484416, vLinkGenMemoryRegionBlockBoundary=LOWER, vLinkGenMemoryRegionBlockContentType=LOCAL_EXCVEC_CODE, vLinkGenMemoryRegionBlockContentType=LOCAL_EXCVEC_CONST, vLinkGenMemoryRegionBlockContentType=LOCAL_INTVEC_CODE, vLinkGenMemoryRegionBlockContentType=LOCAL_INTVEC_CONST, vLinkGenMemoryRegionBlockContentType=GLOBAL_INTVEC_CODE, vLinkGenMemoryRegionBlockContentType=GLOBAL_INTVEC_CONST, vLinkGenMemoryRegionBlockContentType=GLOBAL_CODE, vLinkGenMemoryRegionBlockContentType=GLOBAL_CONST, vLinkGenMemoryRegionBlockContentType=LOCAL_CODE, vLinkGenMemoryRegionBlockContentType=LOCAL_CONST, vLinkGenMemoryRegionBlockContentType=RAM_CODE, vLinkGenMemoryRegionBlockContentType=RAM_CONST
            BmHeader: vLinkGenMemoryRegionBlockPosition=0, vLinkGenMemoryRegionBlockSize=32, vLinkGenMemoryRegionBlockAddress=2147516384, vLinkGenMemoryRegionBlockBoundary=UPPER
        RamDsprCpu0_Var_Eep_DummyArea: vLinkGenMemoryRegionSize=1024, vLinkGenMemoryRegionAddrOffset=244720, vLinkGenMemoryRegionAddress=1879292912, vLinkGenMemoryRegionHwRegion=DSPR0
          RamDsprCpu0_Var_Eep_DummyArea (vLinkGenMemoryRegionBlock):
            vLinkGenMemoryRegionBlockPosition = 0
            vLinkGenMemoryRegionBlockSize = 1024
            vLinkGenMemoryRegionBlockBoundary = LOWER
            vLinkGenMemoryRegionBlockInitStage = NONE
            vLinkGenMemoryRegionBlockAddress = 1879292912
        RamDsprCpu0_MagicFlagArea: vLinkGenMemoryRegionSize=16, vLinkGenMemoryRegionAddrOffset=245744, vLinkGenMemoryRegionAddress=1879293936, vLinkGenMemoryRegionHwRegion=DSPR0
          RamDsprCpu0_MagicFlagArea (vLinkGenMemoryRegionBlock):
            vLinkGenMemoryRegionBlockSize = 16
            vLinkGenMemoryRegionBlockBoundary = LOWER
            vLinkGenMemoryRegionBlockInitStage = NONE
            vLinkGenMemoryRegionBlockPosition = 0
            vLinkGenMemoryRegionBlockAddress = 1879293936
        Rom_FblMemoryArea: vLinkGenMemoryRegionAddrOffset=2752512, vLinkGenMemoryRegionSize=327680, vLinkGenMemoryRegionAddress=2153381888, vLinkGenMemoryRegionHwRegion=PFlash1_Cached
          6 x vLinkGenMemoryRegionBlock, all with vLinkGenMemoryRegionBlockInitStage=NONE:
            FblBmHdrHeader: vLinkGenMemoryRegionBlockPosition=1, vLinkGenMemoryRegionBlockSize=32, vLinkGenMemoryRegionBlockBoundary=LOWER, vLinkGenMemoryRegionBlockAddress=2153381920
            FblHeader: vLinkGenMemoryRegionBlockBoundary=LOWER, vLinkGenMemoryRegionBlockPosition=0, vLinkGenMemoryRegionBlockSize=32, vLinkGenMemoryRegionBlockAddress=2153381888
            FblRomArea: vLinkGenMemoryRegionBlockPosition=2, vLinkGenMemoryRegionBlockBoundary=LOWER, vLinkGenMemoryRegionBlockSize=322432, vLinkGenMemoryRegionBlockAddress=2153381952
            FblReserved: vLinkGenMemoryRegionBlockPosition=0, vLinkGenMemoryRegionBlockBoundary=UPPER, vLinkGenMemoryRegionBlockSize=4032, vLinkGenMemoryRegionBlockAddress=2153705408
            FblRomStartup: vLinkGenMemoryRegionBlockPosition=3, vLinkGenMemoryRegionBlockSize=1024, vLinkGenMemoryRegionBlockAddress=2153704384, vLinkGenMemoryRegionBlockBoundary=LOWER
            FblBlockValPresencePattern: vLinkGenMemoryRegionBlockPosition=1, vLinkGenMemoryRegionBlockSize=128, vLinkGenMemoryRegionBlockAddress=2153709440, vLinkGenMemoryRegionBlockBoundary=UPPER
        RamDsprCpu0_FlashDriverArea: vLinkGenMemoryRegionAddrOffset=0, vLinkGenMemoryRegionSize=3072, vLinkGenMemoryRegionAddress=1879048192, vLinkGenMemoryRegionHwRegion=DSPR0
          RamDsprCpu0_FlashDrvArea (vLinkGenMemoryRegionBlock):
            vLinkGenMemoryRegionBlockPosition = 0
            vLinkGenMemoryRegionBlockInitCore = 0
            vLinkGenMemoryRegionBlockBoundary = LOWER
            vLinkGenMemoryRegionBlockInitStage = ONE
            vLinkGenMemoryRegionBlockSize = 3072
            vLinkGenMemoryRegionBlockAddress = 1879048192
        RamDsprCpu0_LLDAppl_Stack: vLinkGenMemoryRegionAddrOffset=220160, vLinkGenMemoryRegionSize=5120, vLinkGenMemoryRegionAddress=1879268352, vLinkGenMemoryRegionHwRegion=DSPR0
          RamDsprCpu0_LLDAppl_Stack (vLinkGenMemoryRegionBlock):
            vLinkGenMemoryRegionBlockCore = 0
            vLinkGenMemoryRegionBlockPosition = 0
            vLinkGenMemoryRegionBlockSize = 5120
            vLinkGenMemoryRegionBlockAddress = 1879268352
            vLinkGenMemoryRegionBlockBoundary = LOWER
            vLinkGenMemoryRegionBlockInitStage = NONE
            vLinkGenMemoryRegionBlockContentType = STACKS
      7 x vLinkGenLogicalVarGroup:
        Brs_Shared_Var: vLinkGenVarGroupPosition=5, vLinkGenVarGroupInitCore=0, vLinkGenVarGroupContentType=SHARED_DATA, vLinkGenVarGroupRegion=RamDsprCpu0_LLDAppl_Data_Bss/RamDsprCpu0_LLDAppl_Data_Bss
          Brs_Shared_Var (vLinkGenVarSectionGroup):
            vLinkGenVarSectionGroupPosition = 0
            vLinkGenVarSectionGroupInit = NONE
            vLinkGenVarSectionGroupInitStage = ONE
            vLinkGenVarSectionGroupAlignment = 16
            vLinkGenVarSectionGroupRef = brsSharedVar
        Data_Default: vLinkGenVarGroupPosition=1000, vLinkGenVarGroupInitCore=0, vLinkGenVarGroupVariant=vLinkGenVariantHandling/DemoFbl, vLinkGenVarGroupVariant=DemoBm, vLinkGenVarGroupVariant=vLinkGenVariantHandling/DemoAppl, vLinkGenVarGroupContentType=GLOBAL_DATA, vLinkGenVarGroupRomRegion=BmRomArea, vLinkGenVarGroupRegion=RamDsprCpu0_LLDAppl_Data_Bss/RamDsprCpu0_LLDAppl_Data_Bss, vLinkGenVarGroupVariant=vLinkGenVariantHandling/DemoAppl
          vLinkGenVarGroupVariantHandling
            DemoFbl (vLinkGenVarGroupVariantSpecifics): vLinkGenVarGroupSpecificRomRegion=FblRomArea, vLinkGenVarGroupSpecificVariant=vLinkGenVariantHandling/DemoFbl
            DemoAppl (vLinkGenVarGroupVariantSpecifics): vLinkGenVarGroupSpecificRomRegion=ApplRomArea, vLinkGenVarGroupSpecificVariant=vLinkGenVariantHandling/DemoAppl
          6 x vLinkGenVarSectionGroup, all with vLinkGenVarSectionGroupPosition=0, vLinkGenVarSectionGroupInitStage=ONE, vLinkGenVarSectionGroupAlignment=16, vLinkGenVarSectionGroupEndAlignment=4, vLinkGenVarSectionGroupFlag=vLinkGenVarGroupFlags/WRITE:
            data: vLinkGenVarSectionGroupInit=INIT, vLinkGenVarSectionGroupFlag=LOADABLE, vLinkGenVarSectionGroupRef=vLinkGenLinkerSections/data, vLinkGenVarSectionGroupRef=data_all
            sdata: vLinkGenVarSectionGroupInit=INIT, vLinkGenVarSectionGroupFlag=vLinkGenVarGroupFlags/SMALL_ADDRESSING, vLinkGenVarSectionGroupFlag=LOADABLE, vLinkGenVarSectionGroupRef=vLinkGenLinkerSections/sdata, vLinkGenVarSectionGroupRef=sdata_all
            zdata: vLinkGenVarSectionGroupInit=INIT, vLinkGenVarSectionGroupFlag=vLinkGenVarGroupFlags/ABSOLUTE_ADDRESSING, vLinkGenVarSectionGroupFlag=LOADABLE, vLinkGenVarSectionGroupRef=vLinkGenLinkerSections/zdata, vLinkGenVarSectionGroupRef=zdata_all
            bss: vLinkGenVarSectionGroupInit=ZERO_INIT, vLinkGenVarSectionGroupRef=vLinkGenLinkerSections/bss, vLinkGenVarSectionGroupRef=bss_all, vLinkGenVarSectionGroupRef=COMMON
            sbss: vLinkGenVarSectionGroupInit=ZERO_INIT, vLinkGenVarSectionGroupFlag=vLinkGenVarGroupFlags/SMALL_ADDRESSING, vLinkGenVarSectionGroupRef=vLinkGenLinkerSections/sbss, vLinkGenVarSectionGroupRef=sbss_all
            zbss: vLinkGenVarSectionGroupInit=ZERO_INIT, vLinkGenVarSectionGroupFlag=vLinkGenVarGroupFlags/ABSOLUTE_ADDRESSING, vLinkGenVarSectionGroupRef=vLinkGenLinkerSections/zbss, vLinkGenVarSectionGroupRef=zbss_all
        FlashDrvGroup: vLinkGenVarGroupPosition=250, vLinkGenVarGroupRegion=RamDsprCpu0_FlashDrvArea, vLinkGenVarGroupVariant=FlashDrv
          FlashDrv_DataGroup (vLinkGenVarSectionGroup):
            vLinkGenVarSectionGroupPosition = 0
            vLinkGenVarSectionGroupInit = NONE
            vLinkGenVarSectionGroupInitStage = ONE
            vLinkGenVarSectionGroupAlignment = 16
            vLinkGenVarSectionGroupRef = vLinkGenLinkerSections/data
            vLinkGenVarSectionGroupRef = vLinkGenLinkerSections/sdata
            vLinkGenVarSectionGroupRef = sdata_all
            vLinkGenVarSectionGroupRef = vLinkGenLinkerSections/zbss
            vLinkGenVarSectionGroupRef = vLinkGenLinkerSections/zdata
            vLinkGenVarSectionGroupRef = zdata_all
            vLinkGenVarSectionGroupRef = data_all
            vLinkGenVarSectionGroupRef = COMMON
            vLinkGenVarSectionGroupRef = vLinkGenLinkerSections/bss
            vLinkGenVarSectionGroupRef = bss_all
        STACK_C0: vLinkGenVarGroupPosition=5, vLinkGenVarGroupCore=0, vLinkGenVarGroupRegion=RamDsprCpu0_LLDAppl_Stack/RamDsprCpu0_LLDAppl_Stack, vLinkGenVarGroupContentType=STARTUP_STACK, vLinkGenVarGroupModule=vBRS
          STACK_C0 (vLinkGenVarSectionGroup):
            vLinkGenVarSectionGroupPosition = 0
            vLinkGenVarSectionGroupInit = NONE
            vLinkGenVarSectionGroupInitStage = ONE
            vLinkGenVarSectionGroupAlignment = 64
            vLinkGenVarSectionGroupEndAlignment = 4
            vLinkGenVarSectionGroupSize = 5120
        MagicFlagGroup: vLinkGenVarGroupPosition=5, vLinkGenVarGroupInitCore=0, vLinkGenVarGroupRegion=RamDsprCpu0_MagicFlagArea/RamDsprCpu0_MagicFlagArea, vLinkGenVarGroupVariant=vLinkGenVariantHandling/DemoFbl, vLinkGenVarGroupVariant=DemoBm, vLinkGenVarGroupVariant=vLinkGenVariantHandling/DemoAppl
          MagicFlagGroup (vLinkGenVarSectionGroup):
            vLinkGenVarSectionGroupPosition = 0
            vLinkGenVarSectionGroupInit = ZERO_INIT
            vLinkGenVarSectionGroupInitStage = HARD_RESET_ONLY
            vLinkGenVarSectionGroupAlignment = 16
            vLinkGenVarSectionGroupEndAlignment = 4
            vLinkGenVarSectionGroupRef = MagicFlagSection
        FlashDrvSectionGroup: vLinkGenVarGroupPosition=5, vLinkGenVarGroupRegion=RamDsprCpu0_FlashDrvArea, vLinkGenVarGroupVariant=vLinkGenVariantHandling/DemoFbl, vLinkGenVarGroupVariant=DemoBm, vLinkGenVarGroupVariant=vLinkGenVariantHandling/DemoAppl
          FlashDrvSectionGroup (vLinkGenVarSectionGroup):
            vLinkGenVarSectionGroupPosition = 0
            vLinkGenVarSectionGroupInit = NONE
            vLinkGenVarSectionGroupInitStage = ONE
            vLinkGenVarSectionGroupAlignment = 16
            vLinkGenVarSectionGroupRef = FblFlashDrvSection
        EepDummyVarGroup: vLinkGenVarGroupPosition=5, vLinkGenVarGroupInitCore=0, vLinkGenVarGroupRegion=RamDsprCpu0_Var_Eep_DummyArea/RamDsprCpu0_Var_Eep_DummyArea
          EepDummyVarGroup (vLinkGenVarSectionGroup):
            vLinkGenVarSectionGroupPosition = 0
            vLinkGenVarSectionGroupInit = ZERO_INIT
            vLinkGenVarSectionGroupInitStage = HARD_RESET_ONLY
            vLinkGenVarSectionGroupAlignment = 16
            vLinkGenVarSectionGroupEndAlignment = 4
            vLinkGenVarSectionGroupRef = EepDummySection
      ApplVectSymbols (vLinkGenLogicalSymbolGroup):
        vLinkGenSymbolGroupPosition = 5
        vLinkGenSymbolGroupVariant = vLinkGenVariantHandling/DemoAppl
        vLinkGenSymbolGroupVariant = DemoBm
        vLinkGenSymbolGroupVariant = vLinkGenVariantHandling/DemoFbl
        RESETVECT_1 (vLinkGenLinkerSymbol): vLinkGenLinkerSymbolName=_start, vLinkGenLinkerSymbolValue=Brs_ApplicationEntry, vLinkGenLinkerSymbolPosition=0
        RESETVECT (vLinkGenLinkerSymbol): vLinkGenLinkerSymbolPosition=0, vLinkGenLinkerSymbolName=RESETVECT, vLinkGenLinkerSymbolValue=Brs_ApplicationEntry
      34 x vLinkGenMemoryRegion, all with vLinkGenMemoryRegionAvailable=true:
        RamDsprCpu2_FordAppl_Stack: vLinkGenMemoryRegionAddrOffset=26624, vLinkGenMemoryRegionSize=13312, vLinkGenMemoryRegionAddress=1342203904, vLinkGenMemoryRegionHwRegion=DSPR2
          RamDsprCpu2_FordAppl_Stack (vLinkGenMemoryRegionBlock):
            vLinkGenMemoryRegionBlockPosition = 0
            vLinkGenMemoryRegionBlockSize = 12288
            vLinkGenMemoryRegionBlockAddress = 1342203904
            vLinkGenMemoryRegionBlockBoundary = LOWER
            vLinkGenMemoryRegionBlockInitStage = NONE
        RamPcpsram_CPU2: vLinkGenMemoryRegionAddrOffset=0, vLinkGenMemoryRegionSize=65536, vLinkGenMemoryRegionAddress=1343225856, vLinkGenMemoryRegionHwRegion=PSPR2
          RamPcpsram_CPU2 (vLinkGenMemoryRegionBlock):
            vLinkGenMemoryRegionBlockPosition = 0
            vLinkGenMemoryRegionBlockSize = 65536
            vLinkGenMemoryRegionBlockAddress = 1343225856
            vLinkGenMemoryRegionBlockBoundary = LOWER
            vLinkGenMemoryRegionBlockInitStage = NONE
        RamPcpsram_CPU1: vLinkGenMemoryRegionAddrOffset=0, vLinkGenMemoryRegionSize=65536, vLinkGenMemoryRegionAddress=1611661312, vLinkGenMemoryRegionHwRegion=PSPR1
          RamPcpsram_CPU1 (vLinkGenMemoryRegionBlock):
            vLinkGenMemoryRegionBlockPosition = 0
            vLinkGenMemoryRegionBlockSize = 65536
            vLinkGenMemoryRegionBlockAddress = 1611661312
            vLinkGenMemoryRegionBlockBoundary = LOWER
            vLinkGenMemoryRegionBlockInitStage = NONE
        RamDsprCpu0_NVRamSdata_Sbss: vLinkGenMemoryRegionAddrOffset=83840, vLinkGenMemoryRegionSize=8192, vLinkGenMemoryRegionAddress=1879132032, vLinkGenMemoryRegionHwRegion=DSPR0
          RamDsprCpu0_NVRamSdata_Sbss (vLinkGenMemoryRegionBlock):
            vLinkGenMemoryRegionBlockPosition = 0
            vLinkGenMemoryRegionBlockSize = 8192
            vLinkGenMemoryRegionBlockAddress = 1879132032
            vLinkGenMemoryRegionBlockBoundary = LOWER
            vLinkGenMemoryRegionBlockInitStage = NONE
        RamDsprCpu0_FDAppl_DataShadow: vLinkGenMemoryRegionAddrOffset=75648, vLinkGenMemoryRegionSize=8192, vLinkGenMemoryRegionAddress=1879123840, vLinkGenMemoryRegionHwRegion=DSPR0
          RamDsprCpu0_FDAppl_DataShadow (vLinkGenMemoryRegionBlock):
            vLinkGenMemoryRegionBlockPosition = 0
            vLinkGenMemoryRegionBlockSize = 8192
            vLinkGenMemoryRegionBlockAddress = 1879123840
            vLinkGenMemoryRegionBlockBoundary = LOWER
            vLinkGenMemoryRegionBlockInitStage = NONE
        RamDsprCpu0_CalibShadow_Tbl: vLinkGenMemoryRegionAddrOffset=10112, vLinkGenMemoryRegionSize=65536, vLinkGenMemoryRegionAddress=1879058304, vLinkGenMemoryRegionHwRegion=DSPR0
          RamDsprCpu0_CalibShadow_Tbl (vLinkGenMemoryRegionBlock):
            vLinkGenMemoryRegionBlockPosition = 0
            vLinkGenMemoryRegionBlockSize = 65536
            vLinkGenMemoryRegionBlockAddress = 1879058304
            vLinkGenMemoryRegionBlockBoundary = LOWER
            vLinkGenMemoryRegionBlockInitStage = NONE
        RamDsprCpu0_Sys_KAM: vLinkGenMemoryRegionAddrOffset=8192, vLinkGenMemoryRegionSize=64, vLinkGenMemoryRegionAddress=1879056384, vLinkGenMemoryRegionHwRegion=DSPR0
          RamDsprCpu0_Sys_KAM (vLinkGenMemoryRegionBlock):
            vLinkGenMemoryRegionBlockPosition = 0
            vLinkGenMemoryRegionBlockSize = 64
            vLinkGenMemoryRegionBlockAddress = 1879056384
            vLinkGenMemoryRegionBlockBoundary = LOWER
            vLinkGenMemoryRegionBlockInitStage = NONE
        RamDsprCpu0_XH_Buffer: vLinkGenMemoryRegionAddrOffset=3072, vLinkGenMemoryRegionSize=5120, vLinkGenMemoryRegionAddress=1879051264, vLinkGenMemoryRegionHwRegion=DSPR0
          RamDsprCpu0_XH_Buffer (vLinkGenMemoryRegionBlock):
            vLinkGenMemoryRegionBlockPosition = 0
            vLinkGenMemoryRegionBlockSize = 5120
            vLinkGenMemoryRegionBlockAddress = 1879051264
            vLinkGenMemoryRegionBlockBoundary = LOWER
            vLinkGenMemoryRegionBlockInitStage = NONE
        RamDsprCpu2_FordAppl_Bss_Data: vLinkGenMemoryRegionAddrOffset=12288, vLinkGenMemoryRegionSize=14336, vLinkGenMemoryRegionAddress=1342189568, vLinkGenMemoryRegionHwRegion=DSPR2
          RamDsprCpu2_FordAppl_Bss_Data (vLinkGenMemoryRegionBlock):
            vLinkGenMemoryRegionBlockPosition = 0
            vLinkGenMemoryRegionBlockSize = 14336
            vLinkGenMemoryRegionBlockAddress = 1342189568
            vLinkGenMemoryRegionBlockBoundary = LOWER
            vLinkGenMemoryRegionBlockInitStage = NONE
        RamDsprCpu2_FordAppl_Csa: vLinkGenMemoryRegionAddrOffset=53248, vLinkGenMemoryRegionSize=45056, vLinkGenMemoryRegionAddress=1342230528, vLinkGenMemoryRegionHwRegion=DSPR2
          RamDsprCpu2_FordAppl_Csa (vLinkGenMemoryRegionBlock):
            vLinkGenMemoryRegionBlockPosition = 0
            vLinkGenMemoryRegionBlockSize = 45056
            vLinkGenMemoryRegionBlockAddress = 1342230528
            vLinkGenMemoryRegionBlockBoundary = LOWER
            vLinkGenMemoryRegionBlockInitStage = NONE
        RamDsprCpu2_FordAppl_Sdata: vLinkGenMemoryRegionAddrOffset=0, vLinkGenMemoryRegionSize=12288, vLinkGenMemoryRegionAddress=1342177280, vLinkGenMemoryRegionHwRegion=DSPR2
          RamDsprCpu2_FordAppl_Sdata (vLinkGenMemoryRegionBlock):
            vLinkGenMemoryRegionBlockPosition = 0
            vLinkGenMemoryRegionBlockSize = 12288
            vLinkGenMemoryRegionBlockAddress = 1342177280
            vLinkGenMemoryRegionBlockBoundary = LOWER
            vLinkGenMemoryRegionBlockInitStage = NONE
        RamDsprCpu1_FordAppl_Sdata: vLinkGenMemoryRegionAddrOffset=0, vLinkGenMemoryRegionSize=61440, vLinkGenMemoryRegionAddress=1610612736, vLinkGenMemoryRegionHwRegion=DSPR1
          RamDsprCpu1_FordAppl_Sdata (vLinkGenMemoryRegionBlock):
            vLinkGenMemoryRegionBlockPosition = 0
            vLinkGenMemoryRegionBlockSize = 61440
            vLinkGenMemoryRegionBlockAddress = 1610612736
            vLinkGenMemoryRegionBlockBoundary = LOWER
            vLinkGenMemoryRegionBlockInitStage = NONE
        RamDsprCpu1_FordAppl_Bss_Data: vLinkGenMemoryRegionAddrOffset=61440, vLinkGenMemoryRegionSize=63488, vLinkGenMemoryRegionAddress=1610674176, vLinkGenMemoryRegionHwRegion=DSPR1
          RamDsprCpu1_FordAppl_Bss_data (vLinkGenMemoryRegionBlock):
            vLinkGenMemoryRegionBlockPosition = 0
            vLinkGenMemoryRegionBlockSize = 63488
            vLinkGenMemoryRegionBlockAddress = 1610674176
            vLinkGenMemoryRegionBlockBoundary = LOWER
            vLinkGenMemoryRegionBlockInitStage = NONE
        RamDsprCpu1_FordAppl_Stack: vLinkGenMemoryRegionAddrOffset=124928, vLinkGenMemoryRegionSize=29696, vLinkGenMemoryRegionAddress=1610737664, vLinkGenMemoryRegionHwRegion=DSPR1
          RamDsprCpu1_FordAppl_Stack (vLinkGenMemoryRegionBlock):
            vLinkGenMemoryRegionBlockPosition = 0
            vLinkGenMemoryRegionBlockSize = 29696
            vLinkGenMemoryRegionBlockAddress = 1610737664
            vLinkGenMemoryRegionBlockBoundary = LOWER
            vLinkGenMemoryRegionBlockInitStage = NONE
        RamDsprCpu1_FordAppl_Csa: vLinkGenMemoryRegionAddrOffset=184320, vLinkGenMemoryRegionSize=61440, vLinkGenMemoryRegionAddress=1610797056, vLinkGenMemoryRegionHwRegion=DSPR1
          RamDsprCpu1_FordAppl_Csa (vLinkGenMemoryRegionBlock):
            vLinkGenMemoryRegionBlockPosition = 0
            vLinkGenMemoryRegionBlockSize = 61440
            vLinkGenMemoryRegionBlockAddress = 1610797056
            vLinkGenMemoryRegionBlockBoundary = LOWER
            vLinkGenMemoryRegionBlockInitStage = NONE
        RamDsprCpu0_LLDAppl_RAMCODE: vLinkGenMemoryRegionAddrOffset=227328, vLinkGenMemoryRegionSize=2048, vLinkGenMemoryRegionAddress=1879275520, vLinkGenMemoryRegionHwRegion=DSPR0
          RamDsprCpu0_LLDAppl_RAMCODE (vLinkGenMemoryRegionBlock):
            vLinkGenMemoryRegionBlockPosition = 0
            vLinkGenMemoryRegionBlockSize = 2048
            vLinkGenMemoryRegionBlockAddress = 1879275520
            vLinkGenMemoryRegionBlockBoundary = LOWER
            vLinkGenMemoryRegionBlockInitStage = NONE
        RamDsprCpu0_LLDAppl_IStack: vLinkGenMemoryRegionAddrOffset=225280, vLinkGenMemoryRegionSize=2048, vLinkGenMemoryRegionAddress=1879273472, vLinkGenMemoryRegionHwRegion=DSPR0
          RamDsprCpu0_LLDAppl_IStack (vLinkGenMemoryRegionBlock):
            vLinkGenMemoryRegionBlockPosition = 0
            vLinkGenMemoryRegionBlockSize = 2048
            vLinkGenMemoryRegionBlockAddress = 1879273472
            vLinkGenMemoryRegionBlockBoundary = LOWER
            vLinkGenMemoryRegionBlockInitStage = NONE
        RamDsprCpu0_LLDAppl_RamConstSection: vLinkGenMemoryRegionAddrOffset=216064, vLinkGenMemoryRegionSize=4096, vLinkGenMemoryRegionAddress=1879264256, vLinkGenMemoryRegionHwRegion=DSPR0
          RamDsprCpu0_LLDAppl_RamConstSection (vLinkGenMemoryRegionBlock):
            vLinkGenMemoryRegionBlockPosition = 0
            vLinkGenMemoryRegionBlockSize = 4096
            vLinkGenMemoryRegionBlockAddress = 1879264256
            vLinkGenMemoryRegionBlockBoundary = LOWER
            vLinkGenMemoryRegionBlockInitStage = NONE
        RamDlmu_CPU0: vLinkGenMemoryRegionAddrOffset=0, vLinkGenMemoryRegionSize=65534, vLinkGenMemoryRegionAddress=2952790016, vLinkGenMemoryRegionHwRegion=DLMU0_NonCached
          RamDlmu_CPU1 (vLinkGenMemoryRegionBlock):
            vLinkGenMemoryRegionBlockPosition = 0
            vLinkGenMemoryRegionBlockSize = 65534
            vLinkGenMemoryRegionBlockAddress = 2952790016
            vLinkGenMemoryRegionBlockBoundary = LOWER
            vLinkGenMemoryRegionBlockInitStage = NONE
        RamDlmu_CPU1: vLinkGenMemoryRegionAddrOffset=0, vLinkGenMemoryRegionSize=65534, vLinkGenMemoryRegionAddress=2952855552, vLinkGenMemoryRegionHwRegion=DLMU1_NonCached
          RamDlmu_CPU0 (vLinkGenMemoryRegionBlock):
            vLinkGenMemoryRegionBlockPosition = 0
            vLinkGenMemoryRegionBlockSize = 65534
            vLinkGenMemoryRegionBlockAddress = 2952855552
            vLinkGenMemoryRegionBlockBoundary = LOWER
            vLinkGenMemoryRegionBlockInitStage = NONE
        RamDlmu_CPU2: vLinkGenMemoryRegionAddrOffset=0, vLinkGenMemoryRegionSize=65534, vLinkGenMemoryRegionAddress=2952921088, vLinkGenMemoryRegionHwRegion=DLMU2_NonCached
          RamDlmu_CPU2 (vLinkGenMemoryRegionBlock):
            vLinkGenMemoryRegionBlockPosition = 0
            vLinkGenMemoryRegionBlockSize = 65534
            vLinkGenMemoryRegionBlockAddress = 2952921088
            vLinkGenMemoryRegionBlockBoundary = LOWER
            vLinkGenMemoryRegionBlockInitStage = NONE
        RamDcsram_CPU0: vLinkGenMemoryRegionAddrOffset=0, vLinkGenMemoryRegionSize=16384, vLinkGenMemoryRegionAddress=1879293952, vLinkGenMemoryRegionHwRegion=DCSRAM0
          RamDcsram_CPU0 (vLinkGenMemoryRegionBlock):
            vLinkGenMemoryRegionBlockPosition = 0
            vLinkGenMemoryRegionBlockSize = 16384
            vLinkGenMemoryRegionBlockAddress = 1879293952
            vLinkGenMemoryRegionBlockBoundary = LOWER
            vLinkGenMemoryRegionBlockInitStage = NONE
        RamDctagsram_CPU0: vLinkGenMemoryRegionAddrOffset=0, vLinkGenMemoryRegionSize=6144, vLinkGenMemoryRegionAddress=1879834624, vLinkGenMemoryRegionHwRegion=DCTAGSRAM0
          RamDctagsram_CPU0 (vLinkGenMemoryRegionBlock):
            vLinkGenMemoryRegionBlockPosition = 0
            vLinkGenMemoryRegionBlockSize = 6144
            vLinkGenMemoryRegionBlockAddress = 1879834624
            vLinkGenMemoryRegionBlockBoundary = LOWER
            vLinkGenMemoryRegionBlockInitStage = NONE
        RamPcpsram_CPU0: vLinkGenMemoryRegionAddrOffset=0, vLinkGenMemoryRegionSize=65534, vLinkGenMemoryRegionAddress=1880096768, vLinkGenMemoryRegionHwRegion=PSPSRAM0
          RamPcpsram_CPU0 (vLinkGenMemoryRegionBlock):
            vLinkGenMemoryRegionBlockPosition = 0
            vLinkGenMemoryRegionBlockSize = 65534
            vLinkGenMemoryRegionBlockAddress = 1880096768
            vLinkGenMemoryRegionBlockBoundary = LOWER
            vLinkGenMemoryRegionBlockInitStage = NONE
        RamPcsram_CPU0: vLinkGenMemoryRegionAddrOffset=0, vLinkGenMemoryRegionSize=32768, vLinkGenMemoryRegionAddress=1880162304, vLinkGenMemoryRegionHwRegion=PCSRAM0
          RamPcsram_CPU0 (vLinkGenMemoryRegionBlock):
            vLinkGenMemoryRegionBlockPosition = 0
            vLinkGenMemoryRegionBlockSize = 32768
            vLinkGenMemoryRegionBlockAddress = 1880162304
            vLinkGenMemoryRegionBlockBoundary = LOWER
            vLinkGenMemoryRegionBlockInitStage = NONE
        RamPctagsram_CPU0: vLinkGenMemoryRegionAddrOffset=0, vLinkGenMemoryRegionSize=12288, vLinkGenMemoryRegionAddress=1880883200, vLinkGenMemoryRegionHwRegion=PCTAGSRAM0
          RamPctagsram_CPU0 (vLinkGenMemoryRegionBlock):
            vLinkGenMemoryRegionBlockPosition = 0
            vLinkGenMemoryRegionBlockSize = 12288
            vLinkGenMemoryRegionBlockAddress = 1880883200
            vLinkGenMemoryRegionBlockBoundary = LOWER
            vLinkGenMemoryRegionBlockInitStage = NONE
        RamDcsram_CPU1: vLinkGenMemoryRegionAddrOffset=0, vLinkGenMemoryRegionSize=16384, vLinkGenMemoryRegionAddress=1610858496, vLinkGenMemoryRegionHwRegion=DCSRAM1
          RamDcsram_CPU1 (vLinkGenMemoryRegionBlock):
            vLinkGenMemoryRegionBlockPosition = 0
            vLinkGenMemoryRegionBlockSize = 16384
            vLinkGenMemoryRegionBlockAddress = 1610858496
            vLinkGenMemoryRegionBlockBoundary = LOWER
            vLinkGenMemoryRegionBlockInitStage = NONE
        RamDcsram_CPU2: vLinkGenMemoryRegionAddrOffset=0, vLinkGenMemoryRegionSize=16384, vLinkGenMemoryRegionAddress=1342275584, vLinkGenMemoryRegionHwRegion=DCSRAM2
          RamDcsram_CPU2 (vLinkGenMemoryRegionBlock):
            vLinkGenMemoryRegionBlockPosition = 0
            vLinkGenMemoryRegionBlockSize = 16384
            vLinkGenMemoryRegionBlockAddress = 1342275584
            vLinkGenMemoryRegionBlockBoundary = LOWER
            vLinkGenMemoryRegionBlockInitStage = NONE
        RamDctagsram_CPU1: vLinkGenMemoryRegionAddrOffset=0, vLinkGenMemoryRegionSize=6144, vLinkGenMemoryRegionAddress=1611399168, vLinkGenMemoryRegionHwRegion=DCTAGSRAM1
          RamDctagsram_CPU1 (vLinkGenMemoryRegionBlock):
            vLinkGenMemoryRegionBlockPosition = 0
            vLinkGenMemoryRegionBlockSize = 6144
            vLinkGenMemoryRegionBlockAddress = 1611399168
            vLinkGenMemoryRegionBlockBoundary = LOWER
            vLinkGenMemoryRegionBlockInitStage = NONE
        RamDctagsram_CPU2: vLinkGenMemoryRegionAddrOffset=0, vLinkGenMemoryRegionSize=6144, vLinkGenMemoryRegionAddress=1342963712, vLinkGenMemoryRegionHwRegion=DCTAGSRAM2
          RamDctagsram_CPU2 (vLinkGenMemoryRegionBlock):
            vLinkGenMemoryRegionBlockPosition = 0
            vLinkGenMemoryRegionBlockSize = 6144
            vLinkGenMemoryRegionBlockAddress = 1342963712
            vLinkGenMemoryRegionBlockBoundary = LOWER
            vLinkGenMemoryRegionBlockInitStage = NONE
        RamPcsram_CPU1: vLinkGenMemoryRegionAddrOffset=0, vLinkGenMemoryRegionSize=32768, vLinkGenMemoryRegionAddress=1611726848, vLinkGenMemoryRegionHwRegion=PCSRAM1
          RamPcsram_CPU1 (vLinkGenMemoryRegionBlock):
            vLinkGenMemoryRegionBlockPosition = 0
            vLinkGenMemoryRegionBlockSize = 32768
            vLinkGenMemoryRegionBlockAddress = 1611726848
            vLinkGenMemoryRegionBlockBoundary = LOWER
            vLinkGenMemoryRegionBlockInitStage = NONE
        RamPcsram_CPU2: vLinkGenMemoryRegionAddrOffset=0, vLinkGenMemoryRegionSize=32768, vLinkGenMemoryRegionAddress=1343291392, vLinkGenMemoryRegionHwRegion=PCSRAM2
          RamPcsram_CPU2 (vLinkGenMemoryRegionBlock):
            vLinkGenMemoryRegionBlockPosition = 0
            vLinkGenMemoryRegionBlockSize = 32768
            vLinkGenMemoryRegionBlockAddress = 1343291392
            vLinkGenMemoryRegionBlockBoundary = LOWER
            vLinkGenMemoryRegionBlockInitStage = NONE
        RamPctagsram_CPU1: vLinkGenMemoryRegionAddrOffset=0, vLinkGenMemoryRegionSize=12288, vLinkGenMemoryRegionAddress=1612447744, vLinkGenMemoryRegionHwRegion=PCTAGSRAM1
          RamPctagsram_CPU1 (vLinkGenMemoryRegionBlock):
            vLinkGenMemoryRegionBlockPosition = 0
            vLinkGenMemoryRegionBlockSize = 12288
            vLinkGenMemoryRegionBlockAddress = 1612447744
            vLinkGenMemoryRegionBlockBoundary = LOWER
            vLinkGenMemoryRegionBlockInitStage = NONE
        RamPctagsram_CPU2: vLinkGenMemoryRegionAddrOffset=0, vLinkGenMemoryRegionSize=12288, vLinkGenMemoryRegionAddress=1344012288, vLinkGenMemoryRegionHwRegion=PCTAGSRAM2
          RamPctagsram_CPU2 (vLinkGenMemoryRegionBlock):
            vLinkGenMemoryRegionBlockPosition = 0
            vLinkGenMemoryRegionBlockSize = 12288
            vLinkGenMemoryRegionBlockAddress = 1344012288
            vLinkGenMemoryRegionBlockBoundary = LOWER
            vLinkGenMemoryRegionBlockInitStage = NONE
      29 x vLinkGenLogicalVarGroup:
        RamDcsram_CPU2_Var: vLinkGenVarGroupPosition=8, vLinkGenVarGroupRegion=RamDcsram_CPU2/RamDcsram_CPU2, vLinkGenVarGroupVariant=vLinkGenVariantHandling/DemoAppl
          RamDcsram_CPU2_Var (vLinkGenVarSectionGroup):
            vLinkGenVarSectionGroupPosition = 0
            vLinkGenVarSectionGroupInit = NONE
            vLinkGenVarSectionGroupInitStage = ONE
            vLinkGenVarSectionGroupAlignment = 16
            vLinkGenVarSectionGroupEndAlignment = 4
            vLinkGenVarSectionGroupRef = RamDcsram_CPU2_Section
        RamDcsram_CPU0_Var: vLinkGenVarGroupPosition=6, vLinkGenVarGroupRegion=RamDcsram_CPU0/RamDcsram_CPU0, vLinkGenVarGroupVariant=vLinkGenVariantHandling/DemoAppl
          RamDcsram_CPU0_Var (vLinkGenVarSectionGroup):
            vLinkGenVarSectionGroupPosition = 0
            vLinkGenVarSectionGroupInit = NONE
            vLinkGenVarSectionGroupInitStage = ONE
            vLinkGenVarSectionGroupAlignment = 16
            vLinkGenVarSectionGroupEndAlignment = 4
            vLinkGenVarSectionGroupRef = RamDcsram_CPU0_Section
        RamDcsram_CPU1_Var: vLinkGenVarGroupPosition=7, vLinkGenVarGroupRegion=RamDcsram_CPU1/RamDcsram_CPU1, vLinkGenVarGroupVariant=vLinkGenVariantHandling/DemoAppl
          RamDcsram_CPU1_Var (vLinkGenVarSectionGroup):
            vLinkGenVarSectionGroupPosition = 0
            vLinkGenVarSectionGroupInit = NONE
            vLinkGenVarSectionGroupInitStage = ONE
            vLinkGenVarSectionGroupAlignment = 16
            vLinkGenVarSectionGroupEndAlignment = 4
            vLinkGenVarSectionGroupRef = RamDcsram_CPU1_Section
        RamDctagsram_CPU0_Var: vLinkGenVarGroupPosition=9, vLinkGenVarGroupRegion=RamDctagsram_CPU0/RamDctagsram_CPU0, vLinkGenVarGroupVariant=vLinkGenVariantHandling/DemoAppl
          RamDctagsram_CPU0_Var (vLinkGenVarSectionGroup):
            vLinkGenVarSectionGroupPosition = 0
            vLinkGenVarSectionGroupInit = NONE
            vLinkGenVarSectionGroupInitStage = ONE
            vLinkGenVarSectionGroupAlignment = 16
            vLinkGenVarSectionGroupEndAlignment = 4
            vLinkGenVarSectionGroupRef = RamDctagsramCPU0_Section
        RamDctagsram_CPU1_Var: vLinkGenVarGroupPosition=10, vLinkGenVarGroupRegion=RamDctagsram_CPU1/RamDctagsram_CPU1, vLinkGenVarGroupVariant=vLinkGenVariantHandling/DemoAppl
          RamDctagsram_CPU1_Var (vLinkGenVarSectionGroup):
            vLinkGenVarSectionGroupPosition = 0
            vLinkGenVarSectionGroupInit = NONE
            vLinkGenVarSectionGroupInitStage = ONE
            vLinkGenVarSectionGroupAlignment = 16
            vLinkGenVarSectionGroupEndAlignment = 4
            vLinkGenVarSectionGroupRef = RamDctagsramCPU1_Section
        RamDctagsram_CPU2_Var: vLinkGenVarGroupPosition=11, vLinkGenVarGroupRegion=RamDctagsram_CPU2/RamDctagsram_CPU2, vLinkGenVarGroupVariant=vLinkGenVariantHandling/DemoAppl
          RamDctagsram_CPU2_Var (vLinkGenVarSectionGroup):
            vLinkGenVarSectionGroupPosition = 0
            vLinkGenVarSectionGroupInit = NONE
            vLinkGenVarSectionGroupInitStage = ONE
            vLinkGenVarSectionGroupAlignment = 16
            vLinkGenVarSectionGroupEndAlignment = 4
            vLinkGenVarSectionGroupRef = RamDctagsramCPU2_Section
        RamPcsram_CPU0_Var: vLinkGenVarGroupPosition=15, vLinkGenVarGroupRegion=RamPcsram_CPU0/RamPcsram_CPU0, vLinkGenVarGroupVariant=vLinkGenVariantHandling/DemoAppl
          RamPcsram_CPU0_Var (vLinkGenVarSectionGroup):
            vLinkGenVarSectionGroupPosition = 0
            vLinkGenVarSectionGroupInit = NONE
            vLinkGenVarSectionGroupInitStage = ONE
            vLinkGenVarSectionGroupAlignment = 16
            vLinkGenVarSectionGroupEndAlignment = 4
            vLinkGenVarSectionGroupRef = RamPcsramCPU0_Section
        RamPcsram_CPU1_Var: vLinkGenVarGroupPosition=16, vLinkGenVarGroupRegion=RamPcsram_CPU1/RamPcsram_CPU1, vLinkGenVarGroupVariant=vLinkGenVariantHandling/DemoAppl
          RamPcsram_CPU1_Var (vLinkGenVarSectionGroup):
            vLinkGenVarSectionGroupPosition = 0
            vLinkGenVarSectionGroupInit = NONE
            vLinkGenVarSectionGroupInitStage = ONE
            vLinkGenVarSectionGroupAlignment = 16
            vLinkGenVarSectionGroupEndAlignment = 4
            vLinkGenVarSectionGroupRef = RamPcsramCPU1_Section
        RamPcsram_CPU2_Var: vLinkGenVarGroupPosition=17, vLinkGenVarGroupRegion=RamPcsram_CPU2/RamPcsram_CPU2, vLinkGenVarGroupVariant=vLinkGenVariantHandling/DemoAppl
          RamPcsram_CPU2_Var (vLinkGenVarSectionGroup):
            vLinkGenVarSectionGroupPosition = 0
            vLinkGenVarSectionGroupInit = NONE
            vLinkGenVarSectionGroupInitStage = ONE
            vLinkGenVarSectionGroupAlignment = 16
            vLinkGenVarSectionGroupEndAlignment = 4
            vLinkGenVarSectionGroupRef = RamPcsramCPU2_Section
        RamPctagsram_CPU0_Var: vLinkGenVarGroupPosition=18, vLinkGenVarGroupRegion=RamPctagsram_CPU0/RamPctagsram_CPU0, vLinkGenVarGroupVariant=vLinkGenVariantHandling/DemoAppl
          RamPctagsram_CPU0_Var (vLinkGenVarSectionGroup):
            vLinkGenVarSectionGroupPosition = 0
            vLinkGenVarSectionGroupInit = NONE
            vLinkGenVarSectionGroupInitStage = ONE
            vLinkGenVarSectionGroupAlignment = 16
            vLinkGenVarSectionGroupEndAlignment = 4
            vLinkGenVarSectionGroupRef = RamPctagsramCPU0_Section
        RamPctagsram_CPU1_Var: vLinkGenVarGroupPosition=19, vLinkGenVarGroupRegion=RamPctagsram_CPU1/RamPctagsram_CPU1, vLinkGenVarGroupVariant=vLinkGenVariantHandling/DemoAppl
          RamPctagsram_CPU1_Var (vLinkGenVarSectionGroup):
            vLinkGenVarSectionGroupPosition = 0
            vLinkGenVarSectionGroupInit = NONE
            vLinkGenVarSectionGroupInitStage = ONE
            vLinkGenVarSectionGroupAlignment = 16
            vLinkGenVarSectionGroupEndAlignment = 4
            vLinkGenVarSectionGroupRef = RamPctagsramCPU1_Section
        RamPctagsram_CPU2_Var: vLinkGenVarGroupPosition=20, vLinkGenVarGroupRegion=RamPctagsram_CPU2/RamPctagsram_CPU2, vLinkGenVarGroupVariant=vLinkGenVariantHandling/DemoAppl
          RamPctagsram_CPU2_Var (vLinkGenVarSectionGroup):
            vLinkGenVarSectionGroupPosition = 0
            vLinkGenVarSectionGroupInit = NONE
            vLinkGenVarSectionGroupInitStage = ONE
            vLinkGenVarSectionGroupAlignment = 16
            vLinkGenVarSectionGroupEndAlignment = 4
            vLinkGenVarSectionGroupRef = RamPctagsramCPU2_Section
        RamPcpsram_CPU0_Var: vLinkGenVarGroupPosition=12, vLinkGenVarGroupRegion=RamPcpsram_CPU0/RamPcpsram_CPU0, vLinkGenVarGroupVariant=vLinkGenVariantHandling/DemoAppl
          RamPcpsram_CPU0_Var (vLinkGenVarSectionGroup):
            vLinkGenVarSectionGroupPosition = 0
            vLinkGenVarSectionGroupInit = NONE
            vLinkGenVarSectionGroupInitStage = ONE
            vLinkGenVarSectionGroupAlignment = 16
            vLinkGenVarSectionGroupEndAlignment = 4
            vLinkGenVarSectionGroupRef = RamPcpsramCPU0_Section
        RamPcpsram_CPU1_Var: vLinkGenVarGroupPosition=13, vLinkGenVarGroupRegion=RamPcpsram_CPU1/RamPcpsram_CPU1, vLinkGenVarGroupVariant=vLinkGenVariantHandling/DemoAppl
          RamPcpsram_CPU1_Var (vLinkGenVarSectionGroup):
            vLinkGenVarSectionGroupPosition = 0
            vLinkGenVarSectionGroupInit = NONE
            vLinkGenVarSectionGroupInitStage = ONE
            vLinkGenVarSectionGroupAlignment = 16
            vLinkGenVarSectionGroupEndAlignment = 4
            vLinkGenVarSectionGroupRef = RamPcpsramCPU1_Section
        RamPcpsram_CPU2_Var: vLinkGenVarGroupPosition=14, vLinkGenVarGroupRegion=RamPcpsram_CPU2/RamPcpsram_CPU2, vLinkGenVarGroupVariant=vLinkGenVariantHandling/DemoAppl
          RamPcpsram_CPU2_Var (vLinkGenVarSectionGroup):
            vLinkGenVarSectionGroupPosition = 0
            vLinkGenVarSectionGroupInit = NONE
            vLinkGenVarSectionGroupInitStage = ONE
            vLinkGenVarSectionGroupAlignment = 16
            vLinkGenVarSectionGroupEndAlignment = 4
            vLinkGenVarSectionGroupRef = RamPcpsramCPU2_Section
        RamDlmu_CPU0_Var: vLinkGenVarGroupPosition=21, vLinkGenVarGroupRegion=RamDlmu_CPU1/RamDlmu_CPU0, vLinkGenVarGroupVariant=vLinkGenVariantHandling/DemoAppl
          RamDlmu_CPU0_Var (vLinkGenVarSectionGroup):
            vLinkGenVarSectionGroupPosition = 0
            vLinkGenVarSectionGroupInit = NONE
            vLinkGenVarSectionGroupInitStage = ONE
            vLinkGenVarSectionGroupAlignment = 16
            vLinkGenVarSectionGroupEndAlignment = 4
            vLinkGenVarSectionGroupRef = RamDlmuCPU0_Section
        RamDlmu_CPU1_Var: vLinkGenVarGroupPosition=22, vLinkGenVarGroupRegion=RamDlmu_CPU0/RamDlmu_CPU1, vLinkGenVarGroupVariant=vLinkGenVariantHandling/DemoAppl
          RamDlmu_CPU1_Var (vLinkGenVarSectionGroup):
            vLinkGenVarSectionGroupPosition = 0
            vLinkGenVarSectionGroupInit = NONE
            vLinkGenVarSectionGroupInitStage = ONE
            vLinkGenVarSectionGroupAlignment = 16
            vLinkGenVarSectionGroupEndAlignment = 4
            vLinkGenVarSectionGroupRef = RamDlmuCPU1_Section
        RamDlmu_CPU2_Var: vLinkGenVarGroupPosition=23, vLinkGenVarGroupRegion=RamDlmu_CPU2/RamDlmu_CPU2, vLinkGenVarGroupVariant=vLinkGenVariantHandling/DemoAppl
          RamDlmu_CPU2_Var (vLinkGenVarSectionGroup):
            vLinkGenVarSectionGroupPosition = 0
            vLinkGenVarSectionGroupInit = NONE
            vLinkGenVarSectionGroupInitStage = ONE
            vLinkGenVarSectionGroupAlignment = 16
            vLinkGenVarSectionGroupEndAlignment = 4
            vLinkGenVarSectionGroupRef = RamDlmuCPU2_Section
        RamDsprCpu0KernelErLogMR_Section_Var: vLinkGenVarGroupPosition=27, vLinkGenVarGroupRegion=RamDsprCpu0_KernelErLog_MR/RamDsprCpu0_KernelErLog_MR, vLinkGenVarGroupVariant=vLinkGenVariantHandling/DemoAppl
          RamDsprCpu0KernelErLogMR_Section_Var (vLinkGenVarSectionGroup):
            vLinkGenVarSectionGroupPosition = 0
            vLinkGenVarSectionGroupInit = NONE
            vLinkGenVarSectionGroupInitStage = ONE
            vLinkGenVarSectionGroupAlignment = 16
            vLinkGenVarSectionGroupEndAlignment = 4
            vLinkGenVarSectionGroupRef = RamDsprCpu0KernelErLogMR_Section
        RamDsprCpu0SysKAM_Var: vLinkGenVarGroupPosition=29, vLinkGenVarGroupRegion=RamDsprCpu0_Sys_KAM/RamDsprCpu0_Sys_KAM, vLinkGenVarGroupVariant=vLinkGenVariantHandling/DemoAppl
          RamDsprCpu0SysKAM_Var (vLinkGenVarSectionGroup):
            vLinkGenVarSectionGroupPosition = 0
            vLinkGenVarSectionGroupInit = NONE
            vLinkGenVarSectionGroupInitStage = ONE
            vLinkGenVarSectionGroupAlignment = 16
            vLinkGenVarSectionGroupEndAlignment = 4
            vLinkGenVarSectionGroupRef = RamDsprCpu0SysKAM_Section
        RamDsprCpu0CalibShadowTbl_Var: vLinkGenVarGroupPosition=24, vLinkGenVarGroupRegion=RamDsprCpu0_CalibShadow_Tbl/RamDsprCpu0_CalibShadow_Tbl, vLinkGenVarGroupVariant=vLinkGenVariantHandling/DemoAppl
          RamDsprCpu0CalibShadowTbl_Var (vLinkGenVarSectionGroup):
            vLinkGenVarSectionGroupPosition = 0
            vLinkGenVarSectionGroupInit = NONE
            vLinkGenVarSectionGroupInitStage = ONE
            vLinkGenVarSectionGroupAlignment = 16
            vLinkGenVarSectionGroupEndAlignment = 4
            vLinkGenVarSectionGroupRef = RamDsprCpu0CalibShadowTbl_Section
        RamDsprCpu0FDApplDataShadow_Var: vLinkGenVarGroupPosition=25, vLinkGenVarGroupRegion=RamDsprCpu0_FDAppl_DataShadow/RamDsprCpu0_FDAppl_DataShadow, vLinkGenVarGroupVariant=vLinkGenVariantHandling/DemoAppl
          RamDsprCpu0FDApplDataShadow_Var (vLinkGenVarSectionGroup):
            vLinkGenVarSectionGroupPosition = 0
            vLinkGenVarSectionGroupInit = NONE
            vLinkGenVarSectionGroupInitStage = ONE
            vLinkGenVarSectionGroupAlignment = 16
            vLinkGenVarSectionGroupEndAlignment = 4
            vLinkGenVarSectionGroupRef = RamDsprCpu0FDApppDataShadow_Section
        RamDsprCpu0NVRamSdataSbss_Var: vLinkGenVarGroupPosition=28, vLinkGenVarGroupRegion=RamDsprCpu0_NVRamSdata_Sbss/RamDsprCpu0_NVRamSdata_Sbss, vLinkGenVarGroupVariant=vLinkGenVariantHandling/DemoAppl
          RamDsprCpu0NVRamSdataSbss_Var (vLinkGenVarSectionGroup):
            vLinkGenVarSectionGroupPosition = 0
            vLinkGenVarSectionGroupInit = NONE
            vLinkGenVarSectionGroupInitStage = ONE
            vLinkGenVarSectionGroupAlignment = 16
            vLinkGenVarSectionGroupEndAlignment = 4
            vLinkGenVarSectionGroupRef = RamDsprCpu0NVRamSdataSbss_Section
        RamDsprCpu0IPC_Var: vLinkGenVarGroupPosition=26, vLinkGenVarGroupRegion=RamDsprCpu0_IPC/RamDsprCpu0_IPC
          RamDsprCpu0IPC_Var (vLinkGenVarSectionGroup):
            vLinkGenVarSectionGroupPosition = 0
            vLinkGenVarSectionGroupInit = NONE
            vLinkGenVarSectionGroupInitStage = ONE
            vLinkGenVarSectionGroupAlignment = 16
            vLinkGenVarSectionGroupEndAlignment = 4
            vLinkGenVarSectionGroupRef = RamDsprCpu0IPC_Section
        RamDsprCpu2FordAppl_Sdata_Var: vLinkGenVarGroupPosition=33, vLinkGenVarGroupRegion=RamDsprCpu2_FordAppl_Sdata/RamDsprCpu2_FordAppl_Sdata, vLinkGenVarGroupVariant=vLinkGenVariantHandling/DemoAppl
          RamDsprCpu2FordAppl_Sdata_Var (vLinkGenVarSectionGroup):
            vLinkGenVarSectionGroupPosition = 0
            vLinkGenVarSectionGroupInit = NONE
            vLinkGenVarSectionGroupInitStage = ONE
            vLinkGenVarSectionGroupAlignment = 16
            vLinkGenVarSectionGroupEndAlignment = 4
            vLinkGenVarSectionGroupRef = RamDsprCpu2FordApplSdata_Section
        RamDsprCpu2FordAppl_BssData_Var: vLinkGenVarGroupPosition=32, vLinkGenVarGroupRegion=RamDsprCpu2_FordAppl_Bss_Data/RamDsprCpu2_FordAppl_Bss_Data, vLinkGenVarGroupVariant=vLinkGenVariantHandling/DemoAppl
          RamDsprCpu2FordAppl_BssData_Var (vLinkGenVarSectionGroup):
            vLinkGenVarSectionGroupPosition = 0
            vLinkGenVarSectionGroupInit = NONE
            vLinkGenVarSectionGroupInitStage = ONE
            vLinkGenVarSectionGroupAlignment = 16
            vLinkGenVarSectionGroupEndAlignment = 4
            vLinkGenVarSectionGroupRef = RamDsprCpu2FordApplBssData_Section
        RamDsprCpu1FordAppl_Sdata_Var: vLinkGenVarGroupPosition=31, vLinkGenVarGroupRegion=RamDsprCpu1_FordAppl_Sdata/RamDsprCpu1_FordAppl_Sdata, vLinkGenVarGroupVariant=vLinkGenVariantHandling/DemoAppl
          RamDsprCpu1FordAppl_Sdata_Var (vLinkGenVarSectionGroup):
            vLinkGenVarSectionGroupPosition = 0
            vLinkGenVarSectionGroupInit = NONE
            vLinkGenVarSectionGroupInitStage = ONE
            vLinkGenVarSectionGroupAlignment = 16
            vLinkGenVarSectionGroupEndAlignment = 4
            vLinkGenVarSectionGroupRef = RamDsprCpu1FordAppl_Sdata_Section
        RamDsprCpu1FordAppl_Bssdata_Var: vLinkGenVarGroupPosition=30, vLinkGenVarGroupRegion=RamDsprCpu1_FordAppl_Bss_data, vLinkGenVarGroupVariant=vLinkGenVariantHandling/DemoAppl
          RamDsprCpu1FordAppl_Bssdata_Var (vLinkGenVarSectionGroup):
            vLinkGenVarSectionGroupPosition = 0
            vLinkGenVarSectionGroupInit = NONE
            vLinkGenVarSectionGroupInitStage = ONE
            vLinkGenVarSectionGroupAlignment = 16
            vLinkGenVarSectionGroupEndAlignment = 4
            vLinkGenVarSectionGroupRef = RamDsprCpu1FordApplBssdata_Section
        RamDsprCpu0XHBuffer_Var: vLinkGenVarGroupPosition=35, vLinkGenVarGroupRegion=RamDsprCpu0_XH_Buffer/RamDsprCpu0_XH_Buffer, vLinkGenVarGroupVariant=vLinkGenVariantHandling/DemoAppl
          RamDsprCpu0XHBuffer_Var (vLinkGenVarSectionGroup):
            vLinkGenVarSectionGroupPosition = 0
            vLinkGenVarSectionGroupInit = NONE
            vLinkGenVarSectionGroupInitStage = ONE
            vLinkGenVarSectionGroupAlignment = 16
            vLinkGenVarSectionGroupEndAlignment = 4
            vLinkGenVarSectionGroupRef = RamDsprCpu0XHBuffer_Section
      Appl_RomFbl_PP1 (vLinkGenLogicalConstGroup): vLinkGenConstGroupPosition=2, vLinkGenConstGroupRegion=Rom_PresencePattern1, vLinkGenConstGroupVariant=vLinkGenVariantHandling/DemoAppl
        Appl_RomFbl_PP1 (vLinkGenConstSectionGroup):
          vLinkGenConstSectionGroupPosition = 0
          vLinkGenConstSectionGroupInit = NONE
          vLinkGenConstSectionGroupInitStage = ONE
          vLinkGenConstSectionGroupRef = Appl_RomFblPP1_Section
      Appl_RomFbl_PP2 (vLinkGenLogicalConstGroup): vLinkGenConstGroupPosition=2, vLinkGenConstGroupRegion=Rom_PresencePattern2, vLinkGenConstGroupVariant=vLinkGenVariantHandling/DemoAppl
        Appl_RomFbl_PP2 (vLinkGenConstSectionGroup):
          vLinkGenConstSectionGroupPosition = 0
          vLinkGenConstSectionGroupInit = NONE
          vLinkGenConstSectionGroupInitStage = ONE
          vLinkGenConstSectionGroupRef = Appl_RomFblPP2_Section
      5 x vLinkGenLogicalVarGroup, all with vLinkGenVarGroupPosition=5, vLinkGenVarGroupCore=0, vLinkGenVarGroupContentType=STARTUP_STACK, vLinkGenVarGroupModule=vBRS:
        STACK_C1: vLinkGenVarGroupRegion=RamDsprCpu1_FordAppl_Stack/RamDsprCpu1_FordAppl_Stack
          STACK_C1 (vLinkGenVarSectionGroup):
            vLinkGenVarSectionGroupPosition = 0
            vLinkGenVarSectionGroupInit = NONE
            vLinkGenVarSectionGroupInitStage = ONE
            vLinkGenVarSectionGroupAlignment = 4
            vLinkGenVarSectionGroupEndAlignment = 4
            vLinkGenVarSectionGroupSize = 1024
        STACK_C2: vLinkGenVarGroupRegion=RamDsprCpu2_FordAppl_Stack/RamDsprCpu2_FordAppl_Stack
          STACK_C2 (vLinkGenVarSectionGroup):
            vLinkGenVarSectionGroupPosition = 0
            vLinkGenVarSectionGroupInit = NONE
            vLinkGenVarSectionGroupInitStage = ONE
            vLinkGenVarSectionGroupAlignment = 4
            vLinkGenVarSectionGroupEndAlignment = 4
            vLinkGenVarSectionGroupSize = 1024
        ISTACK_C0: vLinkGenVarGroupRegion=RamDsprCpu0_LLDAppl_IStack/RamDsprCpu0_LLDAppl_IStack
          ISTACK_C0 (vLinkGenVarSectionGroup):
            vLinkGenVarSectionGroupPosition = 0
            vLinkGenVarSectionGroupInit = NONE
            vLinkGenVarSectionGroupInitStage = ONE
            vLinkGenVarSectionGroupAlignment = 4
            vLinkGenVarSectionGroupEndAlignment = 4
            vLinkGenVarSectionGroupSize = 1024
        ISTACK_C1: vLinkGenVarGroupRegion=RamDsprCpu1_FordAppl_IStack/RamDsprCpu1_FordAppl_IStack
          ISTACK_C1 (vLinkGenVarSectionGroup):
            vLinkGenVarSectionGroupPosition = 0
            vLinkGenVarSectionGroupInit = NONE
            vLinkGenVarSectionGroupInitStage = ONE
            vLinkGenVarSectionGroupAlignment = 4
            vLinkGenVarSectionGroupEndAlignment = 4
            vLinkGenVarSectionGroupSize = 1024
        ISTACK_C2: vLinkGenVarGroupRegion=RamDsprCpu2_FordAppl_IStack/RamDsprCpu2_FordAppl_IStack
          ISTACK_C2 (vLinkGenVarSectionGroup):
            vLinkGenVarSectionGroupPosition = 0
            vLinkGenVarSectionGroupInit = NONE
            vLinkGenVarSectionGroupInitStage = ONE
            vLinkGenVarSectionGroupAlignment = 4
            vLinkGenVarSectionGroupEndAlignment = 4
            vLinkGenVarSectionGroupSize = 1024
      3 x vLinkGenLogicalConstGroup, all with vLinkGenConstGroupPosition=2:
        SID_Block: vLinkGenConstGroupRegion=SwIDBlock_HPCM
          SID_Block (vLinkGenConstSectionGroup):
            vLinkGenConstSectionGroupPosition = 0
            vLinkGenConstSectionGroupInit = NONE
            vLinkGenConstSectionGroupInitStage = ONE
            vLinkGenConstSectionGroupRef = SID_Block_Section
        Etk_Pageswitch_Mbox_Var: vLinkGenConstGroupRegion=Region_etk_pageswitch_mbox
          Etk_Pageswitch_Mbox_Var (vLinkGenConstSectionGroup):
            vLinkGenConstSectionGroupPosition = 0
            vLinkGenConstSectionGroupInit = NONE
            vLinkGenConstSectionGroupInitStage = ONE
            vLinkGenConstSectionGroupAlignment = 4
            vLinkGenConstSectionGroupRef = Etk_Pageswitch_Mbox_Section
        Etk_DisTab_MemClass_Var: vLinkGenConstGroupRegion=Region_etkDisTab_MemClass
          Etk_DisTab_MemClass_Var (vLinkGenConstSectionGroup):
            vLinkGenConstSectionGroupPosition = 0
            vLinkGenConstSectionGroupInit = NONE
            vLinkGenConstSectionGroupInitStage = ONE
            vLinkGenConstSectionGroupAlignment = 4
            vLinkGenConstSectionGroupRef = Etk_DisTab_MemClass_Section
      3 x vLinkGenLogicalVarGroup, all with vLinkGenVarGroupPosition=5, vLinkGenVarGroupCore=0, vLinkGenVarGroupContentType=STARTUP_STACK, vLinkGenVarGroupModule=vBRS, vLinkGenVarGroupVariant=vLinkGenVariantHandling/DemoAppl:
        CSA_CORE0: vLinkGenVarGroupRegion=RamDsprCpu0_LLDAppl_Csa/RamDsprCpu0_LLDAppl_Csa
          CSA_CORE0 (vLinkGenVarSectionGroup):
            vLinkGenVarSectionGroupPosition = 0
            vLinkGenVarSectionGroupInit = NONE
            vLinkGenVarSectionGroupInitStage = ONE
            vLinkGenVarSectionGroupSize = 15344
            vLinkGenVarSectionGroupAlignment = 64
        CSA_CORE1: vLinkGenVarGroupRegion=RamDsprCpu1_FordAppl_Csa/RamDsprCpu1_FordAppl_Csa
          CSA_CORE1 (vLinkGenVarSectionGroup):
            vLinkGenVarSectionGroupPosition = 0
            vLinkGenVarSectionGroupInit = NONE
            vLinkGenVarSectionGroupInitStage = ONE
            vLinkGenVarSectionGroupSize = 32768
            vLinkGenVarSectionGroupAlignment = 64
        CSA_CORE2: vLinkGenVarGroupRegion=RamDsprCpu2_FordAppl_Csa/RamDsprCpu2_FordAppl_Csa
          CSA_CORE2 (vLinkGenVarSectionGroup):
            vLinkGenVarSectionGroupPosition = 0
            vLinkGenVarSectionGroupInit = NONE
            vLinkGenVarSectionGroupInitStage = ONE
            vLinkGenVarSectionGroupSize = 32768
            vLinkGenVarSectionGroupAlignment = 64
      INTVECT (vLinkGenLogicalConstGroup): vLinkGenConstGroupPosition=5, vLinkGenConstGroupRegion=Os_IntVect, vLinkGenConstGroupVariant=vLinkGenVariantHandling/DemoAppl
        INTVECT (vLinkGenConstSectionGroup):
          vLinkGenConstSectionGroupPosition = 0
          vLinkGenConstSectionGroupInit = NONE
          vLinkGenConstSectionGroupInitStage = ONE
          vLinkGenConstSectionGroupAlignment = 4
          vLinkGenConstSectionGroupRef = vLinkGenLinkerSections/INTVECT
          vLinkGenConstSectionGroupRef = inttab_osinterrupts
          vLinkGenConstSectionGroupRef = os_interrupt_code_ostraps
      OS_INTVEC_CORE0_CODE_START (vLinkGenLogicalConstGroup): vLinkGenConstGroupPosition=5, vLinkGenConstGroupRegion=Os_IntVect
        OS_INTVEC_CORE0_CODE_START (vLinkGenConstSectionGroup):
          vLinkGenConstSectionGroupPosition = 0
          vLinkGenConstSectionGroupInit = NONE
          vLinkGenConstSectionGroupInitStage = ONE
          vLinkGenConstSectionGroupAlignment = 4
          vLinkGenConstSectionGroupRef = vLinkGenLinkerSections/OS_INTVEC_CORE0_CODE_START
          vLinkGenConstSectionGroupRef = Os_Interrupt_Code_OsInterrupts
    vLinkGenContentTypes
      vHsmGlobalRamBuffer (vLinkGenVarContentType): vLinkGenVarContentTypeLocal=false, vLinkGenVarContentTypeCopyRef=GLOBAL_CONST
      vHsmIpcMemory (vLinkGenVarContentType): vLinkGenVarContentTypeLocal=false, vLinkGenVarContentTypeCopyRef=GLOBAL_CONST
      RAM_CODE (vLinkGenConstContentType): vLinkGenConstContentTypeLocal=false, vLinkGenConstContentTypeCopyRef=RAM_CODE_COPY
      RAM_CONST (vLinkGenConstContentType): vLinkGenConstContentTypeLocal=false, vLinkGenConstContentTypeCopyRef=RAM_CONST_COPY
      3 x vLinkGenVarContentType:
        GLOBAL_DATA: vLinkGenVarContentTypeLocal=false, vLinkGenVarContentTypeCopyRef=GLOBAL_CONST
        LOCAL_DATA: vLinkGenVarContentTypeLocal=true, vLinkGenVarContentTypeCopyRef=LOCAL_CONST
        RETENTION_DATA: vLinkGenVarContentTypeLocal=false, vLinkGenVarContentTypeCopyRef=GLOBAL_CONST
      13 x vLinkGenConstContentType:
        GLOBAL_CODE: vLinkGenConstContentTypeLocal=false
        LOCAL_CODE: vLinkGenConstContentTypeLocal=true
        GLOBAL_CONST: vLinkGenConstContentTypeLocal=false
        LOCAL_CONST: vLinkGenConstContentTypeLocal=true
        GLOBAL_EXCVEC_CODE: vLinkGenConstContentTypeLocal=false
        LOCAL_EXCVEC_CODE: vLinkGenConstContentTypeLocal=true
        GLOBAL_EXCVEC_CONST: vLinkGenConstContentTypeLocal=true
        LOCAL_EXCVEC_CONST: vLinkGenConstContentTypeLocal=true
        GLOBAL_INTVEC_CODE: vLinkGenConstContentTypeLocal=false
        LOCAL_INTVEC_CODE: vLinkGenConstContentTypeLocal=true
        GLOBAL_INTVEC_CONST: vLinkGenConstContentTypeLocal=false
        LOCAL_INTVEC_CONST: vLinkGenConstContentTypeLocal=true
        STARTUP_CODE: vLinkGenConstContentTypeLocal=false
      5 x vLinkGenVarContentType:
        STARTUP_STACK: vLinkGenVarContentTypeLocal=true
        STACKS: vLinkGenVarContentTypeLocal=true
        RAM_CODE_COPY: vLinkGenVarContentTypeLocal=false
        RAM_CONST_COPY: vLinkGenVarContentTypeLocal=false
        SHARED_DATA: vLinkGenVarContentTypeLocal=false
      APPLICATION_ENTRY (vLinkGenConstContentType): vLinkGenConstContentTypeLocal=false
    vLinkGenPublishedInformation: vLinkGenDefaultVarGroupAlignment=16, vLinkGenGeneration=2, vLinkGenDuplicatedLabels=false
      vLinkGenConstGroupFlags
        7 x vLinkGenConstGroupFlag:
          EXECUTE
          READ
          VLE_CODE
          PCP_CODE
          SMALL_ADDRESSING
          ABSOLUTE_ADDRESSING
          NOLOAD
      vLinkGenVarGroupFlags
        7 x vLinkGenVarGroupFlag:
          EXECUTE
          READ
          WRITE
          LOADABLE
          SMALL_ADDRESSING
          ABSOLUTE_ADDRESSING
          NOLOAD
      vLinkGenRegionBlockFlags
        6 x vLinkGenRegionBlockFlag:
          EXECUTE
          READ
          WRITE
          ALLOCATE
          INIT
          INVERT
      vLinkGenConstSectionFlags
        KEEP (vLinkGenConstSectionFlag)
      vLinkGenVarSectionFlags
        KEEP (vLinkGenVarSectionFlag)
    vLinkGenGeneral: vLinkGenFileGeneration=ONE_FILE_PER_VARIANT
    vLinkGenVariantHandling
      4 x vLinkGenVariant:
        DemoBm
        DemoFbl
        DemoAppl
        FlashDrv

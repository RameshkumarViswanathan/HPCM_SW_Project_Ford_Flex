AUTOSAR XML (schema 00050)
package /ActiveEcuC
  module config CryIf: implementation-config-variant=VARIANT-PRE-COMPILE, module-description=CryIf_Impl
    CryIfChannel: CryIfChannelId=0, CryIfDriverObjectRef=Crypto_30_LibCv
    CryIfCryptoModule: CryIfCancelJobApiUsesJobType=true, CryIfSupportsKeyElementCopyPartial=false, CryIfCryptoModuleRef=Crypto
    3 x CryIfKey:
      CryIfKey_SmhKeyRSA: CryIfKeyId=1, CryIfKeyRef=SmhKeyRSA
      CryIfKey_Smh_Nist_800_90A: CryIfKeyId=2, CryIfKeyRef=Smh_CryptoKey_Nist_800_90A
      CryIfKeyDummy: CryIfKeyId=0, CryIfKeyRef=SmhCryptoKeyDummy
    CryIfGeneral:
      CryIfDevErrorDetect = true
      CryIfVersionInfoApi = false
      CryIfMaxNumberOfKeyElements = 10
      CryIfMaxSizeOfKeyElement = 32
      CryIfRedirection = false
      CryIfSafeBswChecks = false

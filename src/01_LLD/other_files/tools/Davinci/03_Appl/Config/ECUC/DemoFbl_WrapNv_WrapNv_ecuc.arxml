AUTOSAR XML (schema 00050)
package /ActiveEcuC
  module config WrapNv: implementation-config-variant=VARIANT-PRE-COMPILE, module-description=WrapNv_Impl
    WrapNvMemoryLayout
      LastServerMsgId (WrapNvDataBlock): WrapNvDbCount=1, WrapNvDbDescription=Last Server Message ID, WrapNvDbIndex=0, WrapNvDbType=SINGLE, WrapNvDbAccessMacro=false
        LastServerMsgId (WrapNvDataElement): WrapNvDeLength=8, WrapNvDeDescription=Last Server Message ID, WrapNvDeIndex=0, WrapNvDeDefaultValue=0xFF
      ServerMsgIdFlag (WrapNvDataBlock): WrapNvDbCount=1, WrapNvDbDescription=Server Message ID binary flag, WrapNvDbIndex=1, WrapNvDbType=SINGLE, WrapNvDbAccessMacro=false
        ServerMsgIdFlag (WrapNvDataElement): WrapNvDeLength=1, WrapNvDeDescription=Server Message ID binary flag, WrapNvDeIndex=0, WrapNvDeDefaultValue=0xFF
    WrapNvGeneral:
      WrapNvEEPROMBaseAddress = 1879055360
      WrapNvFirstHandle = 1
      WrapNvNVMDataHandling = EXTERNAL_EEPROM_DRIVER
      WrapNvMainFunctionPolling = false
      WrapNvDevErrorDetect = true

AUTOSAR XML (schema 00050)
package /ActiveEcuC
  module config Dcm: implementation-config-variant=VARIANT-PRE-COMPILE, module-description=Dcm_Impl
    DcmConfigSet
      DcmGeneral:
        DcmRespondAllRequest = true
        DcmVersionInfoApi = false
        DcmBaudrateSwitch = false
        DcmKeySlotMode = false
        DcmNwStatusRxBufferSize = 0
        DcmQueuedRequest = false
        DcmTaskTime = 0
        DcmCanHardwareLoopTimeout = 100
        DcmTaskCycle = 5
        DcmDevErrorDetect = true
      DcmDsp
        DcmDspSession
          DcmDspSessionRow: DcmDspSessionLevel=0, DcmDspSessionP2ServerMax=0, DcmDspSessionP2StarServerMax=0
      DcmDsl
        DcmDslBuffer: DcmDslBufferSize=8
        DcmDslDiagResp: DcmDslDiagRespMaxNumOfDeclinedRequests=3, DcmDslDiagRespOnSecondDeclinedRequest=false
        DcmDslProtocol
          DcmDslProtocolRow_29812fbf (DcmDslProtocolRow): DcmDslProtocolID=DCM_UDS_ON_CAN
            DcmDslConnection_9abab095 (DcmDslConnection)
              DcmDslMainConnection_fa25e029 (DcmDslMainConnection): DcmDslProtocolRxTesterSourceAddr=0, DcmDslPayloadLimit=2050
                Diag_Demo_Request_Message_oDemoFBL_Ford_CANFD_937daa12_Rx_2d07a855 (DcmDslProtocolRx):
                  DcmDslProtocolRxAddrType = DCM_PHYSICAL_TYPE
                  DcmDslProtocolRxPduId = 2
                  DcmDslProtocolRxComMChannelRef = CN_DemoFBL_Ford_CANFD_0f313723
                  DcmDslProtocolRxPduRef = Diag_Demo_Request_Message_oDemoFBL_Ford_CANFD_937daa12_Rx
                Diag_Functional_Request_Message_oDemoFBL_Ford_CANFD_f0d52d28_Rx_21e70716 (DcmDslProtocolRx):
                  DcmDslProtocolRxAddrType = DCM_FUNCTIONAL_TYPE
                  DcmDslProtocolRxPduId = 3
                  DcmDslProtocolRxComMChannelRef = CN_DemoFBL_Ford_CANFD_0f313723
                  DcmDslProtocolRxPduRef = Diag_Functional_Request_Message_oDemoFBL_Ford_CANFD_f0d52d28_Rx
                Diag_Demo_Response_Message_oDemoFBL_Ford_CANFD_075f1067_Tx_a94a0c49 (DcmDslProtocolTx): DcmDslTxConfirmationPduId=1, DcmDslProtocolTxPduRef=Diag_Demo_Response_Message_oDemoFBL_Ford_CANFD_075f1067_Tx
            DcmDslConnection_9a5c8c89 (DcmDslConnection)
              DcmDslMainConnection_e1029789 (DcmDslMainConnection): DcmDslProtocolRxTesterSourceAddr=0, DcmDslPayloadLimit=2050
                Diag_Demo_Response_Message_oDemoFBL_Ford_CANFD_20_af8657d4_Tx_c9d72f8e (DcmDslProtocolTx): DcmDslTxConfirmationPduId=0, DcmDslProtocolTxPduRef=Diag_Demo_Response_Message_oDemoFBL_Ford_CANFD_20_af8657d4_Tx
                Diag_Demo_Request_Message_oDemoFBL_Ford_CANFD_20_36f6fa2d_Rx_0e6d71f3 (DcmDslProtocolRx):
                  DcmDslProtocolRxAddrType = DCM_PHYSICAL_TYPE
                  DcmDslProtocolRxPduId = 0
                  DcmDslProtocolRxComMChannelRef = CN_DemoFBL_Ford_CANFD_0f313723
                  DcmDslProtocolRxPduRef = Diag_Demo_Request_Message_oDemoFBL_Ford_CANFD_20_36f6fa2d_Rx
                Diag_Functional_Request_Message_oDemoFBL_Ford_CANFD_20_b3c5bf5e_Rx_81389dfe (DcmDslProtocolRx):
                  DcmDslProtocolRxAddrType = DCM_FUNCTIONAL_TYPE
                  DcmDslProtocolRxPduId = 1
                  DcmDslProtocolRxComMChannelRef = CN_DemoFBL_Ford_CANFD_0f313723
                  DcmDslProtocolRxPduRef = Diag_Functional_Request_Message_oDemoFBL_Ford_CANFD_20_b3c5bf5e_Rx
            DcmDslConnectionGroup: DcmDslConnectionGroupId=0, DcmDslConnectionConcurrentRef=DcmDslConnection_9abab095, DcmDslConnectionConcurrentRef=DcmDslConnection_9a5c8c89
      DcmGeneration:
        DcmInterfacesForDeactivatedData = false
        DcmReduceConstantData2Define = false
        DcmReduceNumericalDataByOffsetThreshold = 0
        DcmReferringKeysInComments = false
        DcmShortSymbols = false

AUTOSAR XML (schema 00050)
package /ActiveEcuC
  module config EcuC: implementation-config-variant=VARIANT-PRE-COMPILE, module-description=EcuC_Impl
    EcucPduCollection: PduIdTypeEnum=UINT8, PduLengthTypeEnum=UINT16
      18 x Pdu, all with J1939Requestable=false:
        Diag_Demo_Response_Message_Tp_oDemoFBL_Ford_CANFD_9a3b189a_Tx: DynamicLength=false, PduLength=64, SysTPduToFrameMappingRef=Diag_Demo_Response_Message_Tp
        Diag_Demo_Request_Message_Tp_oDemoFBL_Ford_CANFD_20_03eb2b50_Rx: DynamicLength=false, PduLength=8, SysTPduToFrameMappingRef=Diag_Demo_Request_Message_Tp
        Diag_Demo_Response_Message_oDemoFBL_Ford_CANFD_20_af8657d4_Tx: DynamicLength=true, PduLength=8
        Diag_Demo_Response_Message_oDemoFBL_Ford_CANFD_20_ee4ec61c_Tx: DynamicLength=true, PduLength=8
        Diag_Demo_Request_Message_oDemoFBL_Ford_CANFD_20_0a455198_Rx: DynamicLength=true, PduLength=8
        Diag_Functional_Request_Message_oDemoFBL_Ford_CANFD_20_b3c5bf5e_Rx: DynamicLength=true, PduLength=7
        Diag_Demo_Request_Message_Tp_oDemoFBL_Ford_CANFD_7e308f1e_Rx: DynamicLength=false, PduLength=64, SysTPduToFrameMappingRef=Diag_Demo_Request_Message_Tp
        Diag_Functional_Request_Message_Tp_oDemoFBL_Ford_CANFD_b5d38b6f_Rx: DynamicLength=false, PduLength=64, SysTPduToFrameMappingRef=Diag_Functional_Request_Message_Tp
        Diag_Functional_Request_Message_oDemoFBL_Ford_CANFD_20_c1a655e9_Rx: DynamicLength=true, PduLength=7
        Diag_Demo_Response_Message_oDemoFBL_Ford_CANFD_d48e43f7_Tx: DynamicLength=true, PduLength=64
        Diag_Demo_Request_Message_oDemoFBL_Ford_CANFD_645d95ca_Rx: DynamicLength=true, PduLength=64
        Diag_Demo_Response_Message_Tp_oDemoFBL_Ford_CANFD_20_4c055dbd_Tx: DynamicLength=false, PduLength=8, SysTPduToFrameMappingRef=Diag_Demo_Response_Message_Tp
        Diag_Functional_Request_Message_oDemoFBL_Ford_CANFD_f0d52d28_Rx: DynamicLength=true, PduLength=62
        Diag_Functional_Request_Message_Tp_oDemoFBL_Ford_CANFD_20_0bb75f3a_Rx: DynamicLength=false, PduLength=8, SysTPduToFrameMappingRef=Diag_Functional_Request_Message_Tp
        Diag_Functional_Request_Message_oDemoFBL_Ford_CANFD_bd4dd5f9_Rx: DynamicLength=true, PduLength=62
        Diag_Demo_Request_Message_oDemoFBL_Ford_CANFD_937daa12_Rx: DynamicLength=true, PduLength=64
        Diag_Demo_Request_Message_oDemoFBL_Ford_CANFD_20_36f6fa2d_Rx: DynamicLength=true, PduLength=8
        Diag_Demo_Response_Message_oDemoFBL_Ford_CANFD_075f1067_Tx: DynamicLength=true, PduLength=64
    EcucGeneral:
      DummyFunction = false
      DummyStatement = true
      StructAlignment = Auto
      ArrayAlignment = Align8Bit
      StructInArrayAlignment = Auto
      SizeOfEnum = Size32Bit
      SizeOfROMPointer = Size32Bit
      SizeOfRAMPointer = Size32Bit
      AtomicBitAccessInBitfield = false
      AtomicVariableAccess = Atomic32BitAccess
      CPUType = CPU32Bit
      SizeOfInt = Size32Bit
      ByteOrder = LITTLE_ENDIAN
      BitOrder = LSB_to_MSB
      BitFieldDataType = INT
      DummyStatementKind = None
      ConditionalGenerating = false
      EcucBswImplementationCodeType = EcuCSourceCode
      EcuCUseStdReturnTypeForRte = false
      PostbuildLoadable: AlignmentFillPattern=255, PBROMStartAddress=0, PBRAMStartAddress=0, PBROMEndAddress=0, PBRAMEndAddress=0
      BswInitialization
        24 x InitFunction:
          CanIf_Init: Header=CanIf.h, InitPhase=INIT_TWO_IF, ConfigType=CanIf_ConfigType, ConfigPtrClass=CANIF_INIT_DATA, ConfigPtrName=CanIf_Config_Ptr, ModuleRef=CanIf  # /ActiveEcuC/CanIf PLAIN_TEXT Init function description of CanIf in UnfilteredViewInInvariantProject (UnfilteredInvariantProjectModelView) .
          CanIf_InitMemory: Header=CanIf.h, InitPhase=INIT_MEMORY, ModuleRef=CanIf  # /ActiveEcuC/CanIf PLAIN_TEXT InitMemory function description of CanIf in UnfilteredViewInInvariantProject (UnfilteredInvariantProjectModelView) .
          CanTp_Init: Header=CanTp.h, InitPhase=INIT_TWO_TP, ConfigType=CanTp_ConfigType, ConfigPtrClass=CANTP_INIT_DATA, ConfigPtrName=CanTp_Config_Ptr, ModuleRef=CanTp  # /ActiveEcuC/CanTp PLAIN_TEXT Init function description of CanTp in UnfilteredViewInInvariantProject (UnfilteredInvariantProjectModelView) .
          CanTp_InitMemory: Header=CanTp.h, InitPhase=INIT_MEMORY, ModuleRef=CanTp  # /ActiveEcuC/CanTp PLAIN_TEXT InitMemory function description of CanTp in UnfilteredViewInInvariantProject (UnfilteredInvariantProjectModelView) .
          Can_InitMemory: Header=Can.h, InitPhase=INIT_MEMORY, ModuleRef=Can  # /ActiveEcuC/Can PLAIN_TEXT InitMemory function description of Can in UnfilteredViewInInvariantProject (UnfilteredInvariantProjectModelView) .
          Can_Init: Header=Can.h, InitPhase=INIT_TWO_DRV, ConfigType=Can_ConfigType, ConfigPtrClass=CAN_INIT_DATA, ConfigPtrName=Can_Config_Ptr, ModuleRef=Can  # /ActiveEcuC/Can PLAIN_TEXT Init function description of Can in UnfilteredViewInInvariantProject (UnfilteredInvariantProjectModelView) .
          CryIf_InitMemory: Header=CryIf.h, InitPhase=INIT_MEMORY, ModuleRef=CryIf  # /ActiveEcuC/CryIf PLAIN_TEXT Initializes variables of the Crypto Interface
          CryIf_Init: Header=CryIf.h, InitPhase=INIT_TWO_IF, ModuleRef=CryIf  # /ActiveEcuC/CryIf PLAIN_TEXT Initializes the Crypto Interface
          Crypto_30_LibCv_InitMemory: Header=Crypto_30_LibCv.h, InitPhase=INIT_MEMORY, ModuleRef=Crypto  # /ActiveEcuC/Crypto PLAIN_TEXT Initializes variables of the Crypto Driver
          Crypto_30_LibCv_Init: Header=Crypto_30_LibCv.h, InitPhase=INIT_TWO_DRV, ModuleRef=Crypto  # /ActiveEcuC/Crypto PLAIN_TEXT Initializes the Crypto Driver
          Csm_Init: Header=Csm.h, InitPhase=INIT_TWO_SYS, ModuleRef=Csm  # /ActiveEcuC/Csm PLAIN_TEXT Initializes the Crypto Service Manager
          Csm_InitMemory: Header=Csm.h, InitPhase=INIT_MEMORY, ModuleRef=Csm  # /ActiveEcuC/Csm PLAIN_TEXT Initializes variables of the Crypto Service Manager
          FblCw_InitMemory: Header=fbl_inc.h, InitPhase=INIT_MEMORY, ModuleRef=Dcm  # /ActiveEcuC/Dcm PLAIN_TEXT InitMemory function description of FblCw in UnfilteredViewInInvariantProject (UnfilteredInvariantProjectModelView) .
          FblCw_Init: Header=fbl_inc.h, InitPhase=INIT_THREE, ConfigType=FblCw_ConfigType, ConfigPtrClass=FBLCW_INIT_DATA, ConfigPtrName=FblCw_Config_Ptr, ModuleRef=Dcm  # /ActiveEcuC/Dcm PLAIN_TEXT Init function description of FblCw in UnfilteredViewInInvariantProject (UnfilteredInvariantProjectModelView) .
          Det_Init: Header=Det.h, InitPhase=INIT_ZERO, ConfigType=Det_ConfigType, ConfigPtrClass=DET_INIT_DATA, ConfigPtrName=Det_Config_Ptr, ModuleRef=Det  # /ActiveEcuC/Det PLAIN_TEXT Init function description of Det in UnfilteredViewInInvariantProject (UnfilteredInvariantProjectModelView) .
          Det_InitMemory: Header=Det.h, InitPhase=INIT_MEMORY, ModuleRef=Det  # /ActiveEcuC/Det PLAIN_TEXT InitMemory function description of Det in UnfilteredViewInInvariantProject (UnfilteredInvariantProjectModelView) .
          PduR_InitMemory: Header=PduR.h, InitPhase=INIT_MEMORY, ModuleRef=PduR  # /ActiveEcuC/PduR PLAIN_TEXT InitMemory function description of PduR in UnfilteredViewInInvariantProject (UnfilteredInvariantProjectModelView) .
          PduR_PreInit: Header=PduR.h, InitPhase=INIT_ONE, ConfigType=PduR_PBConfigType, ConfigPtrClass=PDUR_INIT_DATA, ConfigPtrName=PduR_Config_Ptr, ModuleRef=PduR  # /ActiveEcuC/PduR PLAIN_TEXT PreInit function description of PduR in UnfilteredViewInInvariantProject (UnfilteredInvariantProjectModelView) .
          PduR_Init: Header=PduR.h, InitPhase=INIT_TWO_COM, ConfigType=PduR_PBConfigType, ConfigPtrClass=PDUR_INIT_DATA, ConfigPtrName=PduR_Config_Ptr, ModuleRef=PduR  # /ActiveEcuC/PduR PLAIN_TEXT Init function description of PduR in UnfilteredViewInInvariantProject (UnfilteredInvariantProjectModelView) .
          SecM_Init: Header=Sec.h, InitPhase=INIT_TWO_SYS, ModuleRef=Smh  # /ActiveEcuC/Smh PLAIN_TEXT SecM_Init function description
          WrapNv_Init: Header=WrapNv.h, InitPhase=INIT_TWO_SYS, ModuleRef=WrapNv  # /ActiveEcuC/WrapNv PLAIN_TEXT WrapNv_Init function description
          Brs_Init: Header=, InitPhase=NO_INIT, ModuleRef=vBRS  # /ActiveEcuC/vBRS PLAIN_TEXT Automatically generated by BswInitFctConfigurationService.
          vBaseEnv_Init: Header=, InitPhase=NO_INIT, ModuleRef=vBaseEnv  # /ActiveEcuC/vBaseEnv PLAIN_TEXT Created vBaseEnv_Init by Extended Init XML Service
          vLinkGen_Init: Header=vLinkGen_Lcfg.h, InitPhase=NO_INIT, ModuleRef=vLinkGen  # /ActiveEcuC/vLinkGen PLAIN_TEXT Dummy initialization of the vLinkGen

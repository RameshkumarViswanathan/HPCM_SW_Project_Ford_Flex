AUTOSAR XML (schema 00050)
package /ActiveEcuC
  module config CanTp: implementation-config-variant=VARIANT-PRE-COMPILE, module-description=CanTp_Impl
    CanTpGeneral:
      CanTpVersionInfoApi = false
      CanTpSupportExtendedAddressing = false
      CanTpSupportMixed11Addressing = false
      CanTpSupportStandardAddressing = true
      CanTpChangeParameterApi = true
      CanTpDevErrorDetect = true
      CanTpPaddingByte = 204
      CanTpReadParameterApi = true
      CanTpPaddingActive = true
      CanTpHavePaddingByte = true
      CanTpNumRxChannels = 0
      CanTpNumTxChannels = 0
      CanTpEnableSplitMainFunction = false
      CanTpSupportMixed29Addressing = true
      CanTpSupportNormalFixedAddressing = true
      CanTpSupportCustomAddressing = false
      CanTpOnlyNotifyInformedAppl = true
      CanTpRc = false
      CanTpTc = false
      CanTpSafeBswChecks = false
      CanTpEnableSynchronousTransmit = true
      CanTpSupportLongFirstFrames = true
      CanTpFlexibleDataRateSupport = true
    CanTpConfig: CanTpMainFunctionPeriod=0.005
      5 x CanTpChannel:
        TPCH_8176a70c: CanTpChannelMode=CANTP_MODE_HALF_DUPLEX
          CanTpTxNSdu_448959cb (CanTpTxNSdu):
            CanTpTxAddressingFormat = CANTP_STANDARD
            CanTpTxDl = 8
            CanTpTxTaType = CANTP_PHYSICAL
            CanTpNas = 1.4
            CanTpNcs = 0.2
            CanTpTc = false
            CanTpTxNSduId = 0
            CanTpTxPaddingActivation = CANTP_ON
            CanTpNbs = 1.4
            CanTpTxNSduRef = Diag_Demo_Response_Message_oDemoFBL_Ford_CANFD_20_ee4ec61c_Tx
            CanTpTxNPdu_707904c1 (CanTpTxNPdu): CanTpTxNPduConfirmationPduId=1, CanTpTxNPduRef=Diag_Demo_Response_Message_Tp_oDemoFBL_Ford_CANFD_20_4c055dbd_Tx
            CanTpRxFcNPdu_707904c1 (CanTpRxFcNPdu): CanTpRxFcNPduId=1, CanTpRxFcNPduRef=Diag_Demo_Request_Message_Tp_oDemoFBL_Ford_CANFD_20_03eb2b50_Rx
          CanTpRxNSdu_448959cb (CanTpRxNSdu):
            CanTpRxAddressingFormat = CANTP_STANDARD
            CanTpRxDl = 8
            CanTpRxTaType = CANTP_PHYSICAL
            CanTpNbr = 0.1
            CanTpRxNSduId = 2
            CanTpRxPaddingActivation = CANTP_ON
            CanTpBs = 0
            CanTpNar = 1.4
            CanTpNcr = 1.4
            CanTpRxWftMax = 255
            CanTpSTmin = 0
            CanTpRxNSduRef = Diag_Demo_Request_Message_oDemoFBL_Ford_CANFD_20_0a455198_Rx
            CanTpTxFcNPdu_5283d033 (CanTpTxFcNPdu): CanTpTxFcNPduConfirmationPduId=1, CanTpTxFcNPduRef=Diag_Demo_Response_Message_Tp_oDemoFBL_Ford_CANFD_20_4c055dbd_Tx
            CanTpRxNPdu_5283d033 (CanTpRxNPdu): CanTpRxNPduId=1, CanTpRxNPduRef=Diag_Demo_Request_Message_Tp_oDemoFBL_Ford_CANFD_20_03eb2b50_Rx
        TPCH_544fd71b: CanTpChannelMode=CANTP_MODE_HALF_DUPLEX
          CanTpRxNSdu_6af12f3d (CanTpRxNSdu):
            CanTpRxAddressingFormat = CANTP_STANDARD
            CanTpRxDl = 8
            CanTpRxTaType = CANTP_FUNCTIONAL
            CanTpNbr = 100
            CanTpRxNSduId = 1
            CanTpRxPaddingActivation = CANTP_ON
            CanTpRxNSduRef = Diag_Functional_Request_Message_oDemoFBL_Ford_CANFD_20_c1a655e9_Rx
            CanTpRxNPdu_5cf6a80a (CanTpRxNPdu): CanTpRxNPduId=2, CanTpRxNPduRef=Diag_Functional_Request_Message_Tp_oDemoFBL_Ford_CANFD_20_0bb75f3a_Rx
        TPCH_d2c1d1b2: CanTpChannelMode=CANTP_MODE_HALF_DUPLEX
          CanTpRxNSdu_f565e11a (CanTpRxNSdu):
            CanTpRxAddressingFormat = CANTP_STANDARD
            CanTpRxDl = 64
            CanTpRxTaType = CANTP_CANFD_PHYSICAL
            CanTpNbr = 0.1
            CanTpRxNSduId = 3
            CanTpRxPaddingActivation = CANTP_ON
            CanTpBs = 0
            CanTpNar = 1.4
            CanTpNcr = 1.4
            CanTpRxWftMax = 255
            CanTpSTmin = 0
            CanTpRxNSduRef = Diag_Demo_Request_Message_oDemoFBL_Ford_CANFD_645d95ca_Rx
            CanTpTxFcNPdu_f56359e8 (CanTpTxFcNPdu): CanTpTxFcNPduConfirmationPduId=0, CanTpTxFcNPduRef=Diag_Demo_Response_Message_Tp_oDemoFBL_Ford_CANFD_9a3b189a_Tx
            CanTpRxNPdu_f56359e8 (CanTpRxNPdu): CanTpRxNPduId=0, CanTpRxNPduRef=Diag_Demo_Request_Message_Tp_oDemoFBL_Ford_CANFD_7e308f1e_Rx
          CanTpTxNSdu_f565e11a (CanTpTxNSdu):
            CanTpTxAddressingFormat = CANTP_STANDARD
            CanTpTxDl = 64
            CanTpTxTaType = CANTP_CANFD_PHYSICAL
            CanTpNas = 1.4
            CanTpNcs = 0.2
            CanTpTc = false
            CanTpTxNSduId = 1
            CanTpTxPaddingActivation = CANTP_ON
            CanTpNbs = 1.4
            CanTpTxNSduRef = Diag_Demo_Response_Message_oDemoFBL_Ford_CANFD_d48e43f7_Tx
            CanTpRxFcNPdu_d7998d1a (CanTpRxFcNPdu): CanTpRxFcNPduId=0, CanTpRxFcNPduRef=Diag_Demo_Request_Message_Tp_oDemoFBL_Ford_CANFD_7e308f1e_Rx
            CanTpTxNPdu_d7998d1a (CanTpTxNPdu): CanTpTxNPduConfirmationPduId=0, CanTpTxNPduRef=Diag_Demo_Response_Message_Tp_oDemoFBL_Ford_CANFD_9a3b189a_Tx
        TPCH_87b3b250: CanTpChannelMode=CANTP_MODE_HALF_DUPLEX
          CanTpRxNSdu_2891e3cb (CanTpRxNSdu):
            CanTpRxAddressingFormat = CANTP_STANDARD
            CanTpRxDl = 64
            CanTpRxTaType = CANTP_CANFD_FUNCTIONAL
            CanTpNbr = 100
            CanTpRxNSduId = 0
            CanTpRxPaddingActivation = CANTP_ON
            CanTpRxNSduRef = Diag_Functional_Request_Message_oDemoFBL_Ford_CANFD_bd4dd5f9_Rx
            CanTpRxNPdu_49f52d39 (CanTpRxNPdu): CanTpRxNPduId=3, CanTpRxNPduRef=Diag_Functional_Request_Message_Tp_oDemoFBL_Ford_CANFD_b5d38b6f_Rx
        CanTpChannel: CanTpChannelMode=CANTP_MODE_FULL_DUPLEX

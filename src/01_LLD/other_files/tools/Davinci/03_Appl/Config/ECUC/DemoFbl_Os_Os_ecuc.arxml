AUTOSAR XML (schema 00050)
package /ActiveEcuC
  module config Os: implementation-config-variant=VARIANT-PRE-COMPILE
    OsCounter: OsCounterMaxAllowedValue=1, OsCounterMinCycle=1, OsCounterTicksPerBase=1, OsCounterType=HARDWARE
    OsAppMode
    OsOS: OsStackMonitoring=false, OsStatus=EXTENDED, OsUseGetServiceId=false, OsUseParameterAccess=false, OsUseResScheduler=true
      OsHooks: OsErrorHook=false, OsPostTaskHook=false, OsPreTaskHook=false, OsShutdownHook=false, OsStartupHook=false, OsProtectionHook=false
    OsResource: OsResourceProperty=STANDARD

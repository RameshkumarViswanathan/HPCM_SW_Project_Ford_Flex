AUTOSAR XML (schema 00050)
package /ActiveEcuC
  module config vSet: implementation-config-variant=VARIANT-PRE-COMPILE, module-description=vSet_Impl
    vSetCalibration
    vSetGeneral: vSetDummyStatementKind=None
    vSetPlatform:
      vSetBitOrder = LSB_to_MSB
      vSetSizeOfInt = Size32Bit
      vSetCPUType = CPU32Bit
      vSetSizeOfEnum = Size32Bit
      vSetByteOrder = LITTLE_ENDIAN
      vSetSizeOfRAMPointer = Size32Bit
      vSetSizeOfROMPointer = Size32Bit
    vSetBswInitialization
      30 x vSetInitFunction:
        CanIf_InitMemory: vSetHeader=CanIf.h, vSetModuleRef=CanIf  # /ActiveEcuC/CanIf PLAIN_TEXT InitMemory function description of CanIf in UnfilteredViewInInvariantProject (UnfilteredInvariantProjectModelView) .
          vSetInitFunctionInstance: vSetInitPhase=INIT_MEMORY
        CanIf_Init: vSetHeader=CanIf.h, vSetConfigType=CanIf_ConfigType, vSetConfigPtrClass=CANIF_INIT_DATA, vSetModuleRef=CanIf  # /ActiveEcuC/CanIf PLAIN_TEXT Init function description of CanIf in UnfilteredViewInInvariantProject (UnfilteredInvariantProjectModelView) .
          vSetInitFunctionInstance: vSetInitPhase=INIT_TWO_IF, vSetConfigPtrName=CanIf_Config_Ptr
        CanTp_Init: vSetHeader=CanTp.h, vSetConfigType=CanTp_ConfigType, vSetConfigPtrClass=CANTP_INIT_DATA, vSetModuleRef=CanTp  # /ActiveEcuC/CanTp PLAIN_TEXT Init function description of CanTp in UnfilteredViewInInvariantProject (UnfilteredInvariantProjectModelView) .
          vSetInitFunctionInstance: vSetInitPhase=INIT_TWO_TP, vSetConfigPtrName=CanTp_Config_Ptr
        CanTp_InitMemory: vSetHeader=CanTp.h, vSetModuleRef=CanTp  # /ActiveEcuC/CanTp PLAIN_TEXT InitMemory function description of CanTp in UnfilteredViewInInvariantProject (UnfilteredInvariantProjectModelView) .
          vSetInitFunctionInstance: vSetInitPhase=INIT_MEMORY
        Can_Init: vSetHeader=Can.h, vSetConfigType=Can_ConfigType, vSetConfigPtrClass=CAN_INIT_DATA, vSetModuleRef=Can  # /ActiveEcuC/Can PLAIN_TEXT Init function description of Can in UnfilteredViewInInvariantProject (UnfilteredInvariantProjectModelView) .
          vSetInitFunctionInstance: vSetInitPhase=INIT_TWO_DRV, vSetConfigPtrName=Can_Config_Ptr
        Can_InitMemory: vSetHeader=Can.h, vSetModuleRef=Can  # /ActiveEcuC/Can PLAIN_TEXT InitMemory function description of Can in UnfilteredViewInInvariantProject (UnfilteredInvariantProjectModelView) .
          vSetInitFunctionInstance: vSetInitPhase=INIT_MEMORY
        FblCw_Init: vSetHeader=fbl_inc.h, vSetConfigType=FblCw_ConfigType, vSetConfigPtrClass=FBLCW_INIT_DATA, vSetModuleRef=Dcm  # /ActiveEcuC/Dcm PLAIN_TEXT Init function description of FblCw in UnfilteredViewInInvariantProject (UnfilteredInvariantProjectModelView) .
          vSetInitFunctionInstance: vSetInitPhase=INIT_THREE, vSetConfigPtrName=FblCw_Config_Ptr
        FblCw_InitMemory: vSetHeader=fbl_inc.h, vSetModuleRef=Dcm  # /ActiveEcuC/Dcm PLAIN_TEXT InitMemory function description of FblCw in UnfilteredViewInInvariantProject (UnfilteredInvariantProjectModelView) .
          vSetInitFunctionInstance: vSetInitPhase=INIT_MEMORY
        Det_InitMemory: vSetHeader=Det.h, vSetModuleRef=Det  # /ActiveEcuC/Det PLAIN_TEXT InitMemory function description of Det in UnfilteredViewInInvariantProject (UnfilteredInvariantProjectModelView) .
          vSetInitFunctionInstance: vSetInitPhase=INIT_MEMORY
        Det_Init: vSetHeader=Det.h, vSetConfigType=Det_ConfigType, vSetConfigPtrClass=DET_INIT_DATA, vSetModuleRef=Det  # /ActiveEcuC/Det PLAIN_TEXT Init function description of Det in UnfilteredViewInInvariantProject (UnfilteredInvariantProjectModelView) .
          vSetInitFunctionInstance: vSetInitPhase=INIT_ZERO, vSetConfigPtrName=Det_Config_Ptr
        PduR_InitMemory: vSetHeader=PduR.h, vSetModuleRef=PduR  # /ActiveEcuC/PduR PLAIN_TEXT InitMemory function description of PduR in UnfilteredViewInInvariantProject (UnfilteredInvariantProjectModelView) .
          vSetInitFunctionInstance: vSetInitPhase=INIT_MEMORY
        PduR_PreInit: vSetHeader=PduR.h, vSetConfigType=PduR_PBConfigType, vSetConfigPtrClass=PDUR_INIT_DATA, vSetModuleRef=PduR  # /ActiveEcuC/PduR PLAIN_TEXT PreInit function description of PduR in UnfilteredViewInInvariantProject (UnfilteredInvariantProjectModelView) .
          vSetInitFunctionInstance: vSetInitPhase=INIT_ONE, vSetConfigPtrName=PduR_Config_Ptr
        PduR_Init: vSetHeader=PduR.h, vSetConfigType=PduR_PBConfigType, vSetConfigPtrClass=PDUR_INIT_DATA, vSetModuleRef=PduR  # /ActiveEcuC/PduR PLAIN_TEXT Init function description of PduR in UnfilteredViewInInvariantProject (UnfilteredInvariantProjectModelView) .
          vSetInitFunctionInstance: vSetInitPhase=INIT_TWO_COM, vSetConfigPtrName=PduR_Config_Ptr
        Brs_Init: vSetHeader=, vSetModuleRef=vBRS  # /ActiveEcuC/vBRS PLAIN_TEXT Automatically generated by BswInitFctConfigurationService.
          vSetInitFunctionInstance: vSetInitPhase=NO_INIT
        vBaseEnv_Init: vSetHeader=, vSetModuleRef=vBaseEnv  # /ActiveEcuC/vBaseEnv PLAIN_TEXT Created vBaseEnv_Init by Extended Init XML Service
          vSetInitFunctionInstance: vSetInitPhase=NO_INIT
        vMemAccM_InitMemory: vSetHeader=vMemAccM.h, vSetModuleRef=vMemAccM  # /ActiveEcuC/vMemAccM PLAIN_TEXT Initializes all *_INIT_* section variables within the vMemAccM.
          vSetInitFunctionInstance: vSetInitPhase=INIT_MEMORY
        vMemAccM_Init: vSetHeader=vMemAccM.h, vSetModuleRef=vMemAccM  # /ActiveEcuC/vMemAccM PLAIN_TEXT Initializes the vMemAccM.
          vSetInitFunctionInstance: vSetInitPhase=INIT_TWO_DRV
        Csm_InitMemory: vSetHeader=Csm.h, vSetModuleRef=Csm  # /ActiveEcuC/Csm PLAIN_TEXT Initializes variables of the Crypto Service Manager
          vSetInitFunctionInstance: vSetInitPhase=INIT_MEMORY
        Csm_Init: vSetHeader=Csm.h, vSetModuleRef=Csm  # /ActiveEcuC/Csm PLAIN_TEXT Initializes the Crypto Service Manager
          vSetInitFunctionInstance: vSetInitPhase=INIT_TWO_SYS
        CryIf_InitMemory: vSetHeader=CryIf.h, vSetModuleRef=CryIf  # /ActiveEcuC/CryIf PLAIN_TEXT Initializes variables of the Crypto Interface
          vSetInitFunctionInstance: vSetInitPhase=INIT_MEMORY
        CryIf_Init: vSetHeader=CryIf.h, vSetModuleRef=CryIf  # /ActiveEcuC/CryIf PLAIN_TEXT Initializes the Crypto Interface
          vSetInitFunctionInstance: vSetInitPhase=INIT_TWO_IF
        Crypto_30_LibCv_InitMemory: vSetHeader=Crypto_30_LibCv.h, vSetModuleRef=Crypto  # /ActiveEcuC/Crypto PLAIN_TEXT Initializes variables of the Crypto Driver
          vSetInitFunctionInstance: vSetInitPhase=INIT_MEMORY
        Crypto_30_LibCv_Init: vSetHeader=Crypto_30_LibCv.h, vSetModuleRef=Crypto  # /ActiveEcuC/Crypto PLAIN_TEXT Initializes the Crypto Driver
          vSetInitFunctionInstance: vSetInitPhase=INIT_TWO_DRV
        Xcp_Init: vSetHeader=Xcp.h, vSetModuleRef=Xcp  # /ActiveEcuC/Xcp PLAIN_TEXT Module Initialization function of module Xcp.
          vSetInitFunctionInstance: vSetInitPhase=INIT_TWO_TP
        Xcp_InitMemory: vSetHeader=Xcp.h, vSetModuleRef=Xcp  # /ActiveEcuC/Xcp PLAIN_TEXT Memory Initialization function of module Xcp.
          vSetInitFunctionInstance: vSetInitPhase=INIT_MEMORY
        CanXcp_InitMemory: vSetHeader=CanXcp.h, vSetModuleRef=Xcp  # /ActiveEcuC/Xcp PLAIN_TEXT Memory Initialization function of module CanXcp.
          vSetInitFunctionInstance: vSetInitPhase=INIT_MEMORY
        CanXcp_Init: vSetHeader=CanXcp.h, vSetConfigType=CanXcp_ConfigType, vSetConfigPtrClass=CANXCP_CONST, vSetModuleRef=Xcp  # /ActiveEcuC/Xcp PLAIN_TEXT Module Initialization function of module CanXcp.
          vSetInitFunctionInstance: vSetInitPhase=INIT_TWO_TP, vSetConfigPtrName=NULL_PTR
        SecM_Init: vSetHeader=Sec.h, vSetModuleRef=Smh  # /ActiveEcuC/Smh PLAIN_TEXT SecM_Init function description
          vSetInitFunctionInstance: vSetInitPhase=INIT_TWO_SYS
        WrapNv_Init: vSetHeader=WrapNv.h, vSetModuleRef=WrapNv  # /ActiveEcuC/WrapNv PLAIN_TEXT WrapNv_Init function description
          vSetInitFunctionInstance: vSetInitPhase=INIT_TWO_SYS
        vLinkGen_Init: vSetHeader=vLinkGen_Lcfg.h, vSetModuleRef=vLinkGen  # /ActiveEcuC/vLinkGen PLAIN_TEXT Dummy initialization of the vLinkGen
          vSetInitFunctionInstance: vSetInitPhase=NO_INIT

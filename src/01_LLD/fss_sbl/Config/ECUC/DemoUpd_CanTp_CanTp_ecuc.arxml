AUTOSAR XML (schema 00049)
package /ActiveEcuC
  module config CanTp: implementation-config-variant=VARIANT-PRE-COMPILE, module-description=CanTp_Impl
    CanTpGeneral:
      CanTpVersionInfoApi = false
      CanTpSupportExtendedAddressing = false
      CanTpSupportMixed11Addressing = false
      CanTpSupportStandardAddressing = true
      CanTpChangeParameterApi = true
      CanTpDevErrorDetect = false
      CanTpPaddingByte = 170
      CanTpReadParameterApi = true
      CanTpPaddingActive = true
      CanTpHavePaddingByte = true
      CanTpNumRxChannels = 0
      CanTpNumTxChannels = 0
      CanTpEnableSplitMainFunction = false
      CanTpSupportMixed29Addressing = true
      CanTpSupportNormalFixedAddressing = true
      CanTpSupportCustomAddressing = false
      CanTpOnlyNotifyInformedAppl = true
      CanTpRc = false
      CanTpTc = false
      CanTpSafeBswChecks = false
      CanTpEnableSynchronousTransmit = true
      CanTpUseOnlyFirstFc = true
      CanTpFlexibleDataRateSupport = true
      CanTpSupportLongFirstFrames = true
      CanTpDynamicChannelAssignment = false
    CanTpConfig: CanTpMainFunctionPeriod=0.005
      TPCH_2b4edd05 (CanTpChannel): CanTpChannelMode=CANTP_MODE_FULL_DUPLEX
        CanTpTxNSdu_e57fe586 (CanTpTxNSdu):
          CanTpTxAddressingFormat = CANTP_STANDARD
          CanTpTxDl = 8
          CanTpTxTaType = CANTP_PHYSICAL
          CanTpNas = 0.1
          CanTpNcs = 0.2
          CanTpTc = false
          CanTpTxNSduId = 0
          CanTpTxPaddingActivation = CANTP_ON
          CanTpNbs = 0.5
          CanTpTxNSduRef = Blu_CAN_Request_CanTp2PduR_Vehicle1_Tx
          CanTpRxFcNPdu_8e782e38 (CanTpRxFcNPdu): CanTpRxFcNPduId=0, CanTpRxFcNPduRef=Blu_CAN_Request_CanIf2CanTP_Vehicle2_Rx
          CanTpTxNPdu_8e782e38 (CanTpTxNPdu): CanTpTxNPduConfirmationPduId=0, CanTpTxNPduRef=Blu_CAN_Request_CanIf2CanTP_Vehicle2_Tx
        CanTpRxNSdu_e57fe586 (CanTpRxNSdu):
          CanTpRxAddressingFormat = CANTP_STANDARD
          CanTpRxDl = 8
          CanTpRxTaType = CANTP_PHYSICAL
          CanTpNbr = 0.1
          CanTpRxNSduId = 0
          CanTpRxPaddingActivation = CANTP_ON
          CanTpBs = 0
          CanTpNar = 0.1
          CanTpNcr = 0.5
          CanTpRxWftMax = 15
          CanTpSTmin = 0
          CanTpRxNSduRef = Blu_CAN_Request_CanTp2PduR_Vehicle1_Rx
          CanTpRxNPdu_ac82faca (CanTpRxNPdu): CanTpRxNPduId=0, CanTpRxNPduRef=Blu_CAN_Request_CanIf2CanTP_Vehicle2_Rx
          CanTpTxFcNPdu_ac82faca (CanTpTxFcNPdu): CanTpTxFcNPduConfirmationPduId=0, CanTpTxFcNPduRef=Blu_CAN_Request_CanIf2CanTP_Vehicle2_Tx

AUTOSAR XML (schema 00049)
package /ActiveEcuC
  module config FblHal: implementation-config-variant=VARIANT-LINK-TIME, module-description=FblHal_Impl
    FblHalTricore:
      FblHalFlashBankPF{0..2}Size = KB_3072
      FblHalFlashBankPF3Size = KB_1024
      FblHalFlashBankPF4Size = KB_0
      FblHalFlashBankPF5Size = KB_0
    FblHalGeneral:
      FblHalECCSafeRead = true
      FblHalFlashCodeBufferSize = 2048
      FblHalDerivativeSpecificDefines = #define FBL_SFR_BASE_ADRESSES_PRECONFIGURED
      FblHalDerivativeSpecificDefines = #define FBL_PORT_BASE 0xF003A000u /**< Port handling base address */
      FblHalDerivativeSpecificDefines = #define FBL_PFI_BASE 0xA8080000u /**< PFI base address */
      FblHalDerivativeSpecificDefines = #define FBL_SCU_BASE 0xF0036000u /**< System control unit base address */
      FblHalDerivativeSpecificDefines = #define FBL_DMU_BASE 0xF8040000u /**< Data memory unit base address */
      FblHalDerivativeSpecificDefines = #define FBL_GPT12_BASE 0xF0001800u /**< GPT12 base address */
      FblHalDerivativeSpecificDefines = #define FBL_CPUSFR_BASE 0xF8800000u /**< CPU SFR base address */
      FblHalDerivativeSpecificDefines = #define FBL_STM_BASE 0xF0001000u /**< System timer module base address */
      FblHalDerivativeSpecificDefines = #define C_COMP_GNU_TRICORE_MULTICAN
      FblHalDerivativeSpecificDefines = #define V_COMP_GNU_TRICORE
      FblHalDerivativeSpecificDefines = #define V_CPU_TRICORE
      FblHalDerivativeSpecificDefines = #define C_CPUTYPE_32BIT
      FblHalDerivativeSpecificDefines = #define VGEN_ENABLE_CANFBL
      FblHalDerivativeSpecificDefines = #define V_SUPPRESS_EXTENDED_VERSION_CHECK
      FblHalDerivativeSpecificDefines = #define V_ENABLE_VSTDLIB_ASR_ABSTRACTION
      FblHalDerivativeSpecificDefines = #define C_CPUTYPE_BITORDER_LSB2MSB
      FblHalTimerClockFreq = 100000000
      FblHalTimerClockRef = McuClockReferencePoint_Timer

AUTOSAR XML (schema 00049)
package /Port
  module config Port: implementation-config-variant=VARIANT-POST-BUILD, module-description=Port_Impl
    CommonPublishedInformation:
      ArMajorVersion = 4
      ArMinorVersion = 2
      ArPatchVersion = 2
      ModuleId = 124
      Release = _TRICORE_TC387
      SwMajorVersion = 20
      SwMinorVersion = 10
      SwPatchVersion = 0
      VendorId = 17
    PortConfigSet
      17 x PortContainer:
        PortContainer_0: PortNumber=0, PortNumberOfPortPins=13
          13 x PortPin, all with PortPinDirection=PORT_PIN_IN, PortPinDirectionChangeable=false, PortPinInitialMode=GPIO, PortPinLevelValue=PORT_PIN_LEVEL_LOW, PortPinModeChangeable=false, PortPinOutputPinDriveMode=PORT_PIN_OUT_PUSHPULL, PortPinInputPadLevel=PORT_INPUT_LEVEL_CMOS_AUTOMOTIVE, PortPinEnableAnalogInputOnly=PORT_PIN_ANALOG_INPUT_DISABLE, PortPinEmergencyStop=false, PortPinControllerSelect=DISABLE:
            PortPin_{0..5}: PortPinId={0..5}, PortPinSymbolicName=PORT_0_PIN_{0..5}, PortPinMode=PORT_PIN_MODE_ALL, PortPinInputPullResistor=PORT_PIN_IN_PULL_UP, PortPinOutputPadDriveStrength=PORT_PIN_DEFAULT_DRIVER
            PortPin_6_InvSide_DIm: PortPinId=6, PortPinSymbolicName=PORT_0_PIN_6, PortPinInputPullResistor=PORT_PIN_IN_NO_PULL, PortPinOutputPadDriveStrength=PORT_PIN_MEDIUM_DRIVER, PortPinMode=PORT_PIN_MODE_GPIO
            PortPin_{7..9}: PortPinId={7..9}, PortPinSymbolicName=PORT_0_PIN_{7..9}, PortPinMode=PORT_PIN_MODE_ALL, PortPinInputPullResistor=PORT_PIN_IN_PULL_UP, PortPinOutputPadDriveStrength=PORT_PIN_DEFAULT_DRIVER
            PortPin_11: PortPinId=11, PortPinSymbolicName=PORT_0_PIN_11, PortPinMode=PORT_PIN_MODE_ALL, PortPinInputPullResistor=PORT_PIN_IN_PULL_UP, PortPinOutputPadDriveStrength=PORT_PIN_DEFAULT_DRIVER
            PortPin_12: PortPinId=12, PortPinSymbolicName=PORT_0_PIN_12, PortPinMode=PORT_PIN_MODE_ALL, PortPinInputPullResistor=PORT_PIN_IN_PULL_UP, PortPinOutputPadDriveStrength=PORT_PIN_DEFAULT_DRIVER
            PortPin_10: PortPinId=10, PortPinSymbolicName=PORT_0_PIN_10, PortPinMode=PORT_PIN_MODE_ALL, PortPinInputPullResistor=PORT_PIN_IN_PULL_UP, PortPinOutputPadDriveStrength=PORT_PIN_DEFAULT_DRIVER
        PortContainer_1: PortNumber=1, PortNumberOfPortPins=5
          5 x PortPin, all with PortPinDirection=PORT_PIN_IN, PortPinDirectionChangeable=false, PortPinInitialMode=GPIO, PortPinLevelValue=PORT_PIN_LEVEL_LOW, PortPinMode=PORT_PIN_MODE_ALL, PortPinModeChangeable=false, PortPinInputPullResistor=PORT_PIN_IN_PULL_UP, PortPinOutputPadDriveStrength=PORT_PIN_DEFAULT_DRIVER, PortPinOutputPinDriveMode=PORT_PIN_OUT_PUSHPULL, PortPinInputPadLevel=PORT_INPUT_LEVEL_CMOS_AUTOMOTIVE, PortPinEnableAnalogInputOnly=PORT_PIN_ANALOG_INPUT_DISABLE, PortPinEmergencyStop=false, PortPinControllerSelect=DISABLE:
            PortPin_3: PortPinId=19, PortPinSymbolicName=PORT_1_PIN_3
            PortPin_4: PortPinId=20, PortPinSymbolicName=PORT_1_PIN_4
            PortPin_5: PortPinId=21, PortPinSymbolicName=PORT_1_PIN_5
            PortPin_6: PortPinId=22, PortPinSymbolicName=PORT_1_PIN_6
            PortPin_7: PortPinId=23, PortPinSymbolicName=PORT_1_PIN_7
        PortContainer_10: PortNumber=10, PortNumberOfPortPins=9
          9 x PortPin, all with PortPinControllerSelect=DISABLE, PortPinDirectionChangeable=false, PortPinEmergencyStop=false, PortPinEnableAnalogInputOnly=PORT_PIN_ANALOG_INPUT_DISABLE, PortPinInputPadLevel=PORT_INPUT_LEVEL_CMOS_AUTOMOTIVE, PortPinModeChangeable=false, PortPinOutputPinDriveMode=PORT_PIN_OUT_PUSHPULL:
            PortPin_5_PMS_HWCFG1: PortPinDirection=PORT_PIN_IN, PortPinId=165, PortPinInitialMode=GPIO, PortPinInputPullResistor=PORT_PIN_IN_NO_PULL, PortPinLevelValue=PORT_PIN_LEVEL_LOW, PortPinMode=PORT_PIN_MODE_GPIO, PortPinOutputPadDriveStrength=PORT_PIN_MEDIUM_DRIVER, PortPinSymbolicName=PORT_10_PIN_5
            PortPin_0: PortPinDirection=PORT_PIN_IN, PortPinId=160, PortPinInitialMode=GPIO, PortPinInputPullResistor=PORT_PIN_IN_PULL_UP, PortPinLevelValue=PORT_PIN_LEVEL_LOW, PortPinOutputPadDriveStrength=PORT_PIN_DEFAULT_DRIVER, PortPinSymbolicName=PORT_10_PIN_0, PortPinMode=PORT_PIN_MODE_ALL
            PortPin_1_Tlf35584HcMiso_SPm: PortPinDirection=PORT_PIN_IN, PortPinId=161, PortPinInitialMode=GPIO, PortPinInputPullResistor=PORT_PIN_IN_NO_PULL, PortPinLevelValue=PORT_PIN_LEVEL_LOW, PortPinMode=PORT_PIN_MODE_GPIO, PortPinOutputPadDriveStrength=PORT_PIN_STRONG_DRIVER_SHARP_EDGE, PortPinSymbolicName=PORT_10_PIN_1
            PortPin_2_Tlf35584HcClk_SPm: PortPinDirection=PORT_PIN_OUT, PortPinId=162, PortPinInitialMode=ALT3, PortPinInputPullResistor=PORT_PIN_IN_NO_PULL, PortPinLevelValue=PORT_PIN_LEVEL_HIGH, PortPinMode=PORT_PIN_MODE_ALT3, PortPinOutputPadDriveStrength=PORT_PIN_STRONG_DRIVER_SHARP_EDGE, PortPinSymbolicName=PORT_10_PIN_2
            PortPin_3_Tlf35584HcMosi_SPm: PortPinDirection=PORT_PIN_OUT, PortPinId=163, PortPinInitialMode=ALT3, PortPinInputPullResistor=PORT_PIN_IN_NO_PULL, PortPinLevelValue=PORT_PIN_LEVEL_HIGH, PortPinMode=PORT_PIN_MODE_ALT3, PortPinOutputPadDriveStrength=PORT_PIN_STRONG_DRIVER_SHARP_EDGE, PortPinSymbolicName=PORT_10_PIN_3
            PortPin_4_Tlf35584HcCs_SPm: PortPinDirection=PORT_PIN_OUT, PortPinId=164, PortPinInitialMode=ALT3, PortPinInputPullResistor=PORT_PIN_IN_NO_PULL, PortPinLevelValue=PORT_PIN_LEVEL_HIGH, PortPinMode=PORT_PIN_MODE_ALT3, PortPinOutputPadDriveStrength=PORT_PIN_STRONG_DRIVER_SHARP_EDGE, PortPinSymbolicName=PORT_10_PIN_4
            PortPin_6_PMS_HWCFG2: PortPinDirection=PORT_PIN_IN, PortPinId=166, PortPinInitialMode=GPIO, PortPinInputPullResistor=PORT_PIN_IN_NO_PULL, PortPinLevelValue=PORT_PIN_LEVEL_LOW, PortPinMode=PORT_PIN_MODE_GPIO, PortPinOutputPadDriveStrength=PORT_PIN_MEDIUM_DRIVER, PortPinSymbolicName=PORT_10_PIN_6
            PortPin_8: PortPinId=168, PortPinSymbolicName=PORT_10_PIN_8, PortPinDirection=PORT_PIN_IN, PortPinInitialMode=GPIO, PortPinLevelValue=PORT_PIN_LEVEL_LOW, PortPinMode=PORT_PIN_MODE_ALL, PortPinInputPullResistor=PORT_PIN_IN_PULL_UP, PortPinOutputPadDriveStrength=PORT_PIN_DEFAULT_DRIVER
            PortPin_7: PortPinId=167, PortPinSymbolicName=PORT_10_PIN_7, PortPinDirection=PORT_PIN_IN, PortPinInitialMode=GPIO, PortPinLevelValue=PORT_PIN_LEVEL_LOW, PortPinMode=PORT_PIN_MODE_ALL, PortPinInputPullResistor=PORT_PIN_IN_PULL_UP, PortPinOutputPadDriveStrength=PORT_PIN_DEFAULT_DRIVER
        PortContainer_11: PortNumber=11, PortNumberOfPortPins=16
          16 x PortPin, all with PortPinDirection=PORT_PIN_IN, PortPinDirectionChangeable=false, PortPinInitialMode=GPIO, PortPinLevelValue=PORT_PIN_LEVEL_LOW, PortPinMode=PORT_PIN_MODE_ALL, PortPinModeChangeable=false, PortPinInputPullResistor=PORT_PIN_IN_PULL_UP, PortPinOutputPadDriveStrength=PORT_PIN_DEFAULT_DRIVER, PortPinOutputPinDriveMode=PORT_PIN_OUT_PUSHPULL, PortPinInputPadLevel=PORT_INPUT_LEVEL_CMOS_AUTOMOTIVE, PortPinEnableAnalogInputOnly=PORT_PIN_ANALOG_INPUT_DISABLE, PortPinEmergencyStop=false, PortPinControllerSelect=DISABLE:
            PortPin_0: PortPinId=176, PortPinSymbolicName=PORT_11_PIN_0
            PortPin_1: PortPinId=177, PortPinSymbolicName=PORT_11_PIN_1
            PortPin_2: PortPinId=178, PortPinSymbolicName=PORT_11_PIN_2
            PortPin_3: PortPinId=179, PortPinSymbolicName=PORT_11_PIN_3
            PortPin_4: PortPinId=180, PortPinSymbolicName=PORT_11_PIN_4
            PortPin_5: PortPinId=181, PortPinSymbolicName=PORT_11_PIN_5
            PortPin_6: PortPinId=182, PortPinSymbolicName=PORT_11_PIN_6
            PortPin_7: PortPinId=183, PortPinSymbolicName=PORT_11_PIN_7
            PortPin_8: PortPinId=184, PortPinSymbolicName=PORT_11_PIN_8
            PortPin_9: PortPinId=185, PortPinSymbolicName=PORT_11_PIN_9
            PortPin_10: PortPinId=186, PortPinSymbolicName=PORT_11_PIN_10
            PortPin_11: PortPinId=187, PortPinSymbolicName=PORT_11_PIN_11
            PortPin_12: PortPinId=188, PortPinSymbolicName=PORT_11_PIN_12
            PortPin_13: PortPinId=189, PortPinSymbolicName=PORT_11_PIN_13
            PortPin_14: PortPinId=190, PortPinSymbolicName=PORT_11_PIN_14
            PortPin_15: PortPinId=191, PortPinSymbolicName=PORT_11_PIN_15
        PortContainer_12: PortNumber=12, PortNumberOfPortPins=2
          PortPin_0 (PortPin):
            PortPinId = 192
            PortPinSymbolicName = PORT_12_PIN_0
            PortPinDirection = PORT_PIN_IN
            PortPinDirectionChangeable = false
            PortPinInitialMode = GPIO
            PortPinLevelValue = PORT_PIN_LEVEL_LOW
            PortPinMode = PORT_PIN_MODE_ALL
            PortPinModeChangeable = false
            PortPinInputPullResistor = PORT_PIN_IN_PULL_UP
            PortPinOutputPadDriveStrength = PORT_PIN_DEFAULT_DRIVER
            PortPinOutputPinDriveMode = PORT_PIN_OUT_PUSHPULL
            PortPinInputPadLevel = PORT_INPUT_LEVEL_CMOS_AUTOMOTIVE
            PortPinEnableAnalogInputOnly = PORT_PIN_ANALOG_INPUT_DISABLE
            PortPinEmergencyStop = false
            PortPinControllerSelect = DISABLE
          PortPin_1 (PortPin):
            PortPinId = 193
            PortPinSymbolicName = PORT_12_PIN_1
            PortPinDirection = PORT_PIN_IN
            PortPinDirectionChangeable = false
            PortPinInitialMode = GPIO
            PortPinLevelValue = PORT_PIN_LEVEL_LOW
            PortPinMode = PORT_PIN_MODE_ALL
            PortPinModeChangeable = false
            PortPinInputPullResistor = PORT_PIN_IN_PULL_UP
            PortPinOutputPadDriveStrength = PORT_PIN_DEFAULT_DRIVER
            PortPinOutputPinDriveMode = PORT_PIN_OUT_PUSHPULL
            PortPinInputPadLevel = PORT_INPUT_LEVEL_CMOS_AUTOMOTIVE
            PortPinEnableAnalogInputOnly = PORT_PIN_ANALOG_INPUT_DISABLE
            PortPinEmergencyStop = false
            PortPinControllerSelect = DISABLE
        PortContainer_13: PortNumber=13, PortNumberOfPortPins=4
          PortLVDS_0 (PortLVDS):
            PortLVDSMode = LVDSH
            PortLVDSPadSupply = V3_3
            PortLVDSPinPair = Pin_0_Pin_1
            PortLVDSRxEnController = PORT_CONTROLLED
            PortLVDSRxPathEnable = false
            PortLVDSRxTerminationMode = INTERNAL_TERMINATION
            PortLVDSTxEnController = PORT_CONTROLLED
            PortLVDSTxPathEnable = false
            PortLVDSTxPowerDownPullDown = DISABLE
          PortLVDS_1 (PortLVDS):
            PortLVDSMode = LVDSH
            PortLVDSPadSupply = V3_3
            PortLVDSPinPair = Pin_2_Pin_3
            PortLVDSRxEnController = PORT_CONTROLLED
            PortLVDSRxPathEnable = false
            PortLVDSRxTerminationMode = INTERNAL_TERMINATION
            PortLVDSTxEnController = PORT_CONTROLLED
            PortLVDSTxPathEnable = false
            PortLVDSTxPowerDownPullDown = DISABLE
          4 x PortPin, all with PortPinDirection=PORT_PIN_IN, PortPinDirectionChangeable=false, PortPinInitialMode=GPIO, PortPinLevelValue=PORT_PIN_LEVEL_LOW, PortPinModeChangeable=false, PortPinOutputPinDriveMode=PORT_PIN_OUT_PUSHPULL, PortPinInputPadLevel=PORT_INPUT_LEVEL_CMOS_AUTOMOTIVE, PortPinEnableAnalogInputOnly=PORT_PIN_ANALOG_INPUT_DISABLE, PortPinEmergencyStop=false, PortPinControllerSelect=DISABLE:
            PortPin_0: PortPinId=208, PortPinSymbolicName=PORT_13_PIN_0, PortPinMode=PORT_PIN_MODE_ALL, PortPinInputPullResistor=PORT_PIN_IN_PULL_UP, PortPinOutputPadDriveStrength=PORT_PIN_DEFAULT_DRIVER
            PortPin_1_CanUltimateBypass_DIm: PortPinId=209, PortPinSymbolicName=PORT_13_PIN_1, PortPinMode=PORT_PIN_MODE_GPIO, PortPinInputPullResistor=PORT_PIN_IN_NO_PULL, PortPinOutputPadDriveStrength=PORT_PIN_MEDIUM_DRIVER
            PortPin_2: PortPinId=210, PortPinSymbolicName=PORT_13_PIN_2, PortPinMode=PORT_PIN_MODE_ALL, PortPinInputPullResistor=PORT_PIN_IN_PULL_UP, PortPinOutputPadDriveStrength=PORT_PIN_DEFAULT_DRIVER
            PortPin_3: PortPinId=211, PortPinSymbolicName=PORT_13_PIN_3, PortPinMode=PORT_PIN_MODE_ALL, PortPinInputPullResistor=PORT_PIN_IN_PULL_UP, PortPinOutputPadDriveStrength=PORT_PIN_DEFAULT_DRIVER
        PortContainer_14: PortNumber=14, PortNumberOfPortPins=11
          PortLVDS_0 (PortLVDS):
            PortLVDSMode = LVDSH
            PortLVDSPadSupply = V3_3
            PortLVDSPinPair = Pin_10_Pin_9
            PortLVDSRxEnController = PORT_CONTROLLED
            PortLVDSRxPathEnable = false
            PortLVDSRxTerminationMode = INTERNAL_TERMINATION
            PortLVDSTxEnController = PORT_CONTROLLED
            PortLVDSTxPathEnable = false
            PortLVDSTxPowerDownPullDown = DISABLE
          11 x PortPin, all with PortPinControllerSelect=DISABLE, PortPinDirectionChangeable=false, PortPinEmergencyStop=false, PortPinEnableAnalogInputOnly=PORT_PIN_ANALOG_INPUT_DISABLE, PortPinInputPadLevel=PORT_INPUT_LEVEL_CMOS_AUTOMOTIVE, PortPinModeChangeable=false, PortPinOutputPinDriveMode=PORT_PIN_OUT_PUSHPULL:
            PortPin_2_PMS_HWCFG3: PortPinDirection=PORT_PIN_IN, PortPinId=226, PortPinInitialMode=GPIO, PortPinInputPullResistor=PORT_PIN_IN_NO_PULL, PortPinLevelValue=PORT_PIN_LEVEL_LOW, PortPinMode=PORT_PIN_MODE_GPIO, PortPinOutputPadDriveStrength=PORT_PIN_MEDIUM_DRIVER, PortPinSymbolicName=PORT_14_PIN_2
            PortPin_0_CanEtsEn_DOm: PortPinDirection=PORT_PIN_OUT, PortPinId=224, PortPinInitialMode=GPIO, PortPinInputPullResistor=PORT_PIN_IN_NO_PULL, PortPinLevelValue=PORT_PIN_LEVEL_LOW, PortPinMode=PORT_PIN_MODE_GPIO, PortPinOutputPadDriveStrength=PORT_PIN_MEDIUM_DRIVER, PortPinSymbolicName=PORT_14_PIN_0
            PortPin_1_CanEtsNstb_DOm: PortPinDirection=PORT_PIN_OUT, PortPinId=225, PortPinInitialMode=GPIO, PortPinInputPullResistor=PORT_PIN_IN_NO_PULL, PortPinLevelValue=PORT_PIN_LEVEL_LOW, PortPinMode=PORT_PIN_MODE_GPIO, PortPinOutputPadDriveStrength=PORT_PIN_MEDIUM_DRIVER, PortPinSymbolicName=PORT_14_PIN_1
            PortPin_3_PMS_HWCFG4: PortPinDirection=PORT_PIN_IN, PortPinId=227, PortPinInitialMode=GPIO, PortPinInputPullResistor=PORT_PIN_IN_NO_PULL, PortPinLevelValue=PORT_PIN_LEVEL_LOW, PortPinMode=PORT_PIN_MODE_GPIO, PortPinOutputPadDriveStrength=PORT_PIN_MEDIUM_DRIVER, PortPinSymbolicName=PORT_14_PIN_3
            PortPin_4_PMS_HWCFG5: PortPinDirection=PORT_PIN_IN, PortPinId=228, PortPinInitialMode=GPIO, PortPinInputPullResistor=PORT_PIN_IN_NO_PULL, PortPinLevelValue=PORT_PIN_LEVEL_LOW, PortPinMode=PORT_PIN_MODE_GPIO, PortPinOutputPadDriveStrength=PORT_PIN_MEDIUM_DRIVER, PortPinSymbolicName=PORT_14_PIN_4
            PortPin_5_PMS_HWCFG6: PortPinDirection=PORT_PIN_IN, PortPinId=229, PortPinInitialMode=GPIO, PortPinInputPullResistor=PORT_PIN_IN_NO_PULL, PortPinLevelValue=PORT_PIN_LEVEL_LOW, PortPinMode=PORT_PIN_MODE_GPIO, PortPinOutputPadDriveStrength=PORT_PIN_MEDIUM_DRIVER, PortPinSymbolicName=PORT_14_PIN_5
            PortPin_6_CanEtsErr_DIm: PortPinDirection=PORT_PIN_IN, PortPinId=230, PortPinInitialMode=GPIO, PortPinInputPullResistor=PORT_PIN_IN_NO_PULL, PortPinLevelValue=PORT_PIN_LEVEL_LOW, PortPinMode=PORT_PIN_MODE_GPIO, PortPinOutputPadDriveStrength=PORT_PIN_MEDIUM_DRIVER, PortPinSymbolicName=PORT_14_PIN_6
            PortPin_7: PortPinId=231, PortPinSymbolicName=PORT_14_PIN_7, PortPinDirection=PORT_PIN_IN, PortPinInitialMode=GPIO, PortPinLevelValue=PORT_PIN_LEVEL_LOW, PortPinMode=PORT_PIN_MODE_ALL, PortPinInputPullResistor=PORT_PIN_IN_PULL_UP, PortPinOutputPadDriveStrength=PORT_PIN_DEFAULT_DRIVER
            PortPin_8: PortPinId=232, PortPinSymbolicName=PORT_14_PIN_8, PortPinDirection=PORT_PIN_IN, PortPinInitialMode=GPIO, PortPinLevelValue=PORT_PIN_LEVEL_LOW, PortPinMode=PORT_PIN_MODE_ALL, PortPinInputPullResistor=PORT_PIN_IN_PULL_UP, PortPinOutputPadDriveStrength=PORT_PIN_DEFAULT_DRIVER
            PortPin_9_CanDebugTx_CNm: PortPinId=233, PortPinSymbolicName=PORT_14_PIN_9, PortPinDirection=PORT_PIN_OUT, PortPinInitialMode=ALT2, PortPinLevelValue=PORT_PIN_LEVEL_HIGH, PortPinMode=PORT_PIN_MODE_ALT2, PortPinInputPullResistor=PORT_PIN_IN_NO_PULL, PortPinOutputPadDriveStrength=PORT_PIN_MEDIUM_DRIVER
            PortPin_10_CanDebugRx_CNm: PortPinId=234, PortPinSymbolicName=PORT_14_PIN_10, PortPinDirection=PORT_PIN_IN, PortPinInitialMode=GPIO, PortPinLevelValue=PORT_PIN_LEVEL_LOW, PortPinMode=PORT_PIN_MODE_GPIO, PortPinInputPullResistor=PORT_PIN_IN_NO_PULL, PortPinOutputPadDriveStrength=PORT_PIN_MEDIUM_DRIVER
        PortContainer_15: PortNumber=15, PortNumberOfPortPins=9
          9 x PortPin, all with PortPinDirection=PORT_PIN_IN, PortPinDirectionChangeable=false, PortPinInitialMode=GPIO, PortPinLevelValue=PORT_PIN_LEVEL_LOW, PortPinMode=PORT_PIN_MODE_ALL, PortPinModeChangeable=false, PortPinInputPullResistor=PORT_PIN_IN_PULL_UP, PortPinOutputPadDriveStrength=PORT_PIN_DEFAULT_DRIVER, PortPinOutputPinDriveMode=PORT_PIN_OUT_PUSHPULL, PortPinInputPadLevel=PORT_INPUT_LEVEL_CMOS_AUTOMOTIVE, PortPinEnableAnalogInputOnly=PORT_PIN_ANALOG_INPUT_DISABLE, PortPinEmergencyStop=false, PortPinControllerSelect=DISABLE:
            PortPin_0: PortPinId=240, PortPinSymbolicName=PORT_15_PIN_0
            PortPin_1: PortPinId=241, PortPinSymbolicName=PORT_15_PIN_1
            PortPin_2: PortPinId=242, PortPinSymbolicName=PORT_15_PIN_2
            PortPin_3: PortPinId=243, PortPinSymbolicName=PORT_15_PIN_3
            PortPin_4: PortPinId=244, PortPinSymbolicName=PORT_15_PIN_4
            PortPin_5: PortPinId=245, PortPinSymbolicName=PORT_15_PIN_5
            PortPin_6: PortPinId=246, PortPinSymbolicName=PORT_15_PIN_6
            PortPin_7: PortPinId=247, PortPinSymbolicName=PORT_15_PIN_7
            PortPin_8: PortPinId=248, PortPinSymbolicName=PORT_15_PIN_8
        PortContainer_2: PortNumber=2, PortNumberOfPortPins=12
          12 x PortPin, all with PortPinDirectionChangeable=false, PortPinModeChangeable=false, PortPinOutputPinDriveMode=PORT_PIN_OUT_PUSHPULL, PortPinInputPadLevel=PORT_INPUT_LEVEL_CMOS_AUTOMOTIVE, PortPinEnableAnalogInputOnly=PORT_PIN_ANALOG_INPUT_DISABLE, PortPinEmergencyStop=false, PortPinControllerSelect=DISABLE:
            PortPin_0_CanEtsTx_CNm: PortPinId=32, PortPinSymbolicName=PORT_2_PIN_0, PortPinDirection=PORT_PIN_OUT, PortPinInitialMode=ALT5, PortPinLevelValue=PORT_PIN_LEVEL_HIGH, PortPinMode=PORT_PIN_MODE_GPIO, PortPinInputPullResistor=PORT_PIN_IN_NO_PULL, PortPinOutputPadDriveStrength=PORT_PIN_STRONG_DRIVER_SHARP_EDGE
            PortPin_1_CanEtsRx_CNm: PortPinId=33, PortPinSymbolicName=PORT_2_PIN_1, PortPinDirection=PORT_PIN_IN, PortPinInitialMode=GPIO, PortPinLevelValue=PORT_PIN_LEVEL_HIGH, PortPinMode=PORT_PIN_MODE_GPIO, PortPinInputPullResistor=PORT_PIN_IN_NO_PULL, PortPinOutputPadDriveStrength=PORT_PIN_MEDIUM_DRIVER
            PortPin_4: PortPinId=36, PortPinSymbolicName=PORT_2_PIN_4, PortPinDirection=PORT_PIN_IN, PortPinInitialMode=GPIO, PortPinLevelValue=PORT_PIN_LEVEL_LOW, PortPinMode=PORT_PIN_MODE_ALL, PortPinInputPullResistor=PORT_PIN_IN_PULL_UP, PortPinOutputPadDriveStrength=PORT_PIN_DEFAULT_DRIVER
            PortPin_2_IgnRunStart_DIm: PortPinId=34, PortPinSymbolicName=PORT_2_PIN_2, PortPinDirection=PORT_PIN_IN, PortPinInitialMode=GPIO, PortPinLevelValue=PORT_PIN_LEVEL_LOW, PortPinMode=PORT_PIN_MODE_GPIO, PortPinInputPullResistor=PORT_PIN_IN_NO_PULL, PortPinOutputPadDriveStrength=PORT_PIN_MEDIUM_DRIVER
            PortPin_3: PortPinId=35, PortPinSymbolicName=PORT_2_PIN_3, PortPinDirection=PORT_PIN_IN, PortPinInitialMode=GPIO, PortPinLevelValue=PORT_PIN_LEVEL_LOW, PortPinMode=PORT_PIN_MODE_ALL, PortPinInputPullResistor=PORT_PIN_IN_PULL_UP, PortPinOutputPadDriveStrength=PORT_PIN_DEFAULT_DRIVER
            PortPin_5: PortPinId=37, PortPinSymbolicName=PORT_2_PIN_5, PortPinDirection=PORT_PIN_IN, PortPinInitialMode=GPIO, PortPinLevelValue=PORT_PIN_LEVEL_LOW, PortPinMode=PORT_PIN_MODE_ALL, PortPinInputPullResistor=PORT_PIN_IN_PULL_UP, PortPinOutputPadDriveStrength=PORT_PIN_DEFAULT_DRIVER
            PortPin_6: PortPinId=38, PortPinSymbolicName=PORT_2_PIN_6, PortPinDirection=PORT_PIN_IN, PortPinInitialMode=GPIO, PortPinLevelValue=PORT_PIN_LEVEL_LOW, PortPinMode=PORT_PIN_MODE_ALL, PortPinInputPullResistor=PORT_PIN_IN_PULL_UP, PortPinOutputPadDriveStrength=PORT_PIN_DEFAULT_DRIVER
            PortPin_7: PortPinId=39, PortPinSymbolicName=PORT_2_PIN_7, PortPinDirection=PORT_PIN_IN, PortPinInitialMode=GPIO, PortPinLevelValue=PORT_PIN_LEVEL_LOW, PortPinMode=PORT_PIN_MODE_ALL, PortPinInputPullResistor=PORT_PIN_IN_PULL_UP, PortPinOutputPadDriveStrength=PORT_PIN_DEFAULT_DRIVER
            PortPin_8_CanDebugEn_DOm: PortPinId=40, PortPinSymbolicName=PORT_2_PIN_8, PortPinDirection=PORT_PIN_OUT, PortPinInitialMode=GPIO, PortPinLevelValue=PORT_PIN_LEVEL_LOW, PortPinMode=PORT_PIN_MODE_GPIO, PortPinInputPullResistor=PORT_PIN_IN_NO_PULL, PortPinOutputPadDriveStrength=PORT_PIN_MEDIUM_DRIVER
            PortPin_9: PortPinId=41, PortPinSymbolicName=PORT_2_PIN_9, PortPinDirection=PORT_PIN_IN, PortPinInitialMode=GPIO, PortPinLevelValue=PORT_PIN_LEVEL_LOW, PortPinMode=PORT_PIN_MODE_ALL, PortPinInputPullResistor=PORT_PIN_IN_PULL_UP, PortPinOutputPadDriveStrength=PORT_PIN_DEFAULT_DRIVER
            PortPin_10: PortPinId=42, PortPinSymbolicName=PORT_2_PIN_10, PortPinDirection=PORT_PIN_IN, PortPinInitialMode=GPIO, PortPinLevelValue=PORT_PIN_LEVEL_LOW, PortPinMode=PORT_PIN_MODE_ALL, PortPinInputPullResistor=PORT_PIN_IN_PULL_UP, PortPinOutputPadDriveStrength=PORT_PIN_DEFAULT_DRIVER
            PortPin_11: PortPinId=43, PortPinSymbolicName=PORT_2_PIN_11, PortPinDirection=PORT_PIN_IN, PortPinInitialMode=GPIO, PortPinLevelValue=PORT_PIN_LEVEL_LOW, PortPinMode=PORT_PIN_MODE_ALL, PortPinInputPullResistor=PORT_PIN_IN_PULL_UP, PortPinOutputPadDriveStrength=PORT_PIN_DEFAULT_DRIVER
        PortContainer_20: PortNumber=20, PortNumberOfPortPins=13
          13 x PortPin, all with PortPinDirection=PORT_PIN_IN, PortPinDirectionChangeable=false, PortPinInitialMode=GPIO, PortPinLevelValue=PORT_PIN_LEVEL_LOW, PortPinMode=PORT_PIN_MODE_ALL, PortPinModeChangeable=false, PortPinInputPullResistor=PORT_PIN_IN_PULL_UP, PortPinOutputPadDriveStrength=PORT_PIN_DEFAULT_DRIVER, PortPinOutputPinDriveMode=PORT_PIN_OUT_PUSHPULL, PortPinInputPadLevel=PORT_INPUT_LEVEL_CMOS_AUTOMOTIVE, PortPinEnableAnalogInputOnly=PORT_PIN_ANALOG_INPUT_DISABLE, PortPinEmergencyStop=false, PortPinControllerSelect=DISABLE:
            PortPin_0: PortPinId=320, PortPinSymbolicName=PORT_20_PIN_0
            PortPin_1: PortPinId=321, PortPinSymbolicName=PORT_20_PIN_1
            PortPin_2: PortPinId=322, PortPinSymbolicName=PORT_20_PIN_2
            PortPin_3: PortPinId=323, PortPinSymbolicName=PORT_20_PIN_3
            PortPin_6: PortPinId=326, PortPinSymbolicName=PORT_20_PIN_6
            PortPin_7: PortPinId=327, PortPinSymbolicName=PORT_20_PIN_7
            PortPin_8: PortPinId=328, PortPinSymbolicName=PORT_20_PIN_8
            PortPin_9: PortPinId=329, PortPinSymbolicName=PORT_20_PIN_9
            PortPin_10: PortPinId=330, PortPinSymbolicName=PORT_20_PIN_10
            PortPin_11: PortPinId=331, PortPinSymbolicName=PORT_20_PIN_11
            PortPin_12: PortPinId=332, PortPinSymbolicName=PORT_20_PIN_12
            PortPin_13: PortPinId=333, PortPinSymbolicName=PORT_20_PIN_13
            PortPin_14: PortPinId=334, PortPinSymbolicName=PORT_20_PIN_14
        PortContainer_21: PortNumber=21, PortNumberOfPortPins=8
          3 x PortLVDS, all with PortLVDSMode=LVDSH, PortLVDSPadSupply=V3_3, PortLVDSRxEnController=PORT_CONTROLLED, PortLVDSRxPathEnable=false, PortLVDSRxTerminationMode=INTERNAL_TERMINATION, PortLVDSTxEnController=PORT_CONTROLLED, PortLVDSTxPathEnable=false, PortLVDSTxPowerDownPullDown=DISABLE:
            PortLVDS_0: PortLVDSPinPair=Pin_0_Pin_1
            PortLVDS_1: PortLVDSPinPair=Pin_2_Pin_3
            PortLVDS_2: PortLVDSPinPair=Pin_4_Pin_5
          8 x PortPin, all with PortPinControllerSelect=DISABLE, PortPinDirectionChangeable=false, PortPinEmergencyStop=false, PortPinEnableAnalogInputOnly=PORT_PIN_ANALOG_INPUT_DISABLE, PortPinInitialMode=GPIO, PortPinInputPadLevel=PORT_INPUT_LEVEL_CMOS_AUTOMOTIVE, PortPinModeChangeable=false, PortPinOutputPinDriveMode=PORT_PIN_OUT_PUSHPULL:
            PortPin_6_TDI_DAP3: PortPinDirection=PORT_PIN_IN, PortPinId=342, PortPinInputPullResistor=PORT_PIN_IN_NO_PULL, PortPinLevelValue=PORT_PIN_LEVEL_HIGH, PortPinMode=PORT_PIN_MODE_GPIO, PortPinOutputPadDriveStrength=PORT_PIN_MEDIUM_DRIVER, PortPinSymbolicName=PORT_21_PIN_6
            PortPin_7_TDO_DAP2: PortPinDirection=PORT_PIN_IN, PortPinId=343, PortPinInputPullResistor=PORT_PIN_IN_NO_PULL, PortPinLevelValue=PORT_PIN_LEVEL_HIGH, PortPinMode=PORT_PIN_MODE_GPIO, PortPinOutputPadDriveStrength=PORT_PIN_MEDIUM_DRIVER, PortPinSymbolicName=PORT_21_PIN_7
            PortPin_0: PortPinId=336, PortPinSymbolicName=PORT_21_PIN_0, PortPinDirection=PORT_PIN_IN, PortPinLevelValue=PORT_PIN_LEVEL_LOW, PortPinMode=PORT_PIN_MODE_ALL, PortPinInputPullResistor=PORT_PIN_IN_PULL_UP, PortPinOutputPadDriveStrength=PORT_PIN_DEFAULT_DRIVER
            PortPin_1: PortPinId=337, PortPinSymbolicName=PORT_21_PIN_1, PortPinDirection=PORT_PIN_IN, PortPinLevelValue=PORT_PIN_LEVEL_LOW, PortPinMode=PORT_PIN_MODE_ALL, PortPinInputPullResistor=PORT_PIN_IN_PULL_UP, PortPinOutputPadDriveStrength=PORT_PIN_DEFAULT_DRIVER
            PortPin_2: PortPinId=338, PortPinSymbolicName=PORT_21_PIN_2, PortPinDirection=PORT_PIN_IN, PortPinLevelValue=PORT_PIN_LEVEL_LOW, PortPinMode=PORT_PIN_MODE_ALL, PortPinInputPullResistor=PORT_PIN_IN_PULL_UP, PortPinOutputPadDriveStrength=PORT_PIN_DEFAULT_DRIVER
            PortPin_3: PortPinId=339, PortPinSymbolicName=PORT_21_PIN_3, PortPinDirection=PORT_PIN_IN, PortPinLevelValue=PORT_PIN_LEVEL_LOW, PortPinMode=PORT_PIN_MODE_ALL, PortPinInputPullResistor=PORT_PIN_IN_PULL_UP, PortPinOutputPadDriveStrength=PORT_PIN_DEFAULT_DRIVER
            PortPin_4: PortPinId=340, PortPinSymbolicName=PORT_21_PIN_4, PortPinDirection=PORT_PIN_IN, PortPinLevelValue=PORT_PIN_LEVEL_LOW, PortPinMode=PORT_PIN_MODE_ALL, PortPinInputPullResistor=PORT_PIN_IN_PULL_UP, PortPinOutputPadDriveStrength=PORT_PIN_DEFAULT_DRIVER
            PortPin_5_CanNormalMode_DOm: PortPinId=341, PortPinSymbolicName=PORT_21_PIN_5, PortPinDirection=PORT_PIN_OUT, PortPinLevelValue=PORT_PIN_LEVEL_LOW, PortPinMode=PORT_PIN_MODE_GPIO, PortPinInputPullResistor=PORT_PIN_IN_NO_PULL, PortPinOutputPadDriveStrength=PORT_PIN_MEDIUM_DRIVER
        PortContainer_22: PortNumber=22, PortNumberOfPortPins=12
          PortLVDS_0 (PortLVDS):
            PortLVDSMode = LVDSH
            PortLVDSPadSupply = V3_3
            PortLVDSPinPair = Pin_0_Pin_1
            PortLVDSRxEnController = PORT_CONTROLLED
            PortLVDSRxPathEnable = false
            PortLVDSRxTerminationMode = INTERNAL_TERMINATION
            PortLVDSTxEnController = PORT_CONTROLLED
            PortLVDSTxPathEnable = false
            PortLVDSTxPowerDownPullDown = DISABLE
          PortLVDS_1 (PortLVDS):
            PortLVDSMode = LVDSH
            PortLVDSPadSupply = V3_3
            PortLVDSPinPair = Pin_2_Pin_3
            PortLVDSRxEnController = PORT_CONTROLLED
            PortLVDSRxPathEnable = false
            PortLVDSRxTerminationMode = INTERNAL_TERMINATION
            PortLVDSTxEnController = PORT_CONTROLLED
            PortLVDSTxPathEnable = false
            PortLVDSTxPowerDownPullDown = DISABLE
          12 x PortPin, all with PortPinControllerSelect=DISABLE, PortPinDirection=PORT_PIN_IN, PortPinDirectionChangeable=false, PortPinEmergencyStop=false, PortPinEnableAnalogInputOnly=PORT_PIN_ANALOG_INPUT_DISABLE, PortPinInitialMode=GPIO, PortPinInputPadLevel=PORT_INPUT_LEVEL_CMOS_AUTOMOTIVE, PortPinInputPullResistor=PORT_PIN_IN_PULL_UP, PortPinLevelValue=PORT_PIN_LEVEL_LOW, PortPinModeChangeable=false, PortPinOutputPadDriveStrength=PORT_PIN_DEFAULT_DRIVER, PortPinOutputPinDriveMode=PORT_PIN_OUT_PUSHPULL, PortPinMode=PORT_PIN_MODE_ALL:
            PortPin_4: PortPinId=356, PortPinSymbolicName=PORT_22_PIN_4
            PortPin_5: PortPinId=357, PortPinSymbolicName=PORT_22_PIN_5
            PortPin_0: PortPinId=352, PortPinSymbolicName=PORT_22_PIN_0
            PortPin_1: PortPinId=353, PortPinSymbolicName=PORT_22_PIN_1
            PortPin_2: PortPinId=354, PortPinSymbolicName=PORT_22_PIN_2
            PortPin_3: PortPinId=355, PortPinSymbolicName=PORT_22_PIN_3
            PortPin_6: PortPinId=358, PortPinSymbolicName=PORT_22_PIN_6
            PortPin_7: PortPinId=359, PortPinSymbolicName=PORT_22_PIN_7
            PortPin_8: PortPinId=360, PortPinSymbolicName=PORT_22_PIN_8
            PortPin_9: PortPinId=361, PortPinSymbolicName=PORT_22_PIN_9
            PortPin_10: PortPinId=362, PortPinSymbolicName=PORT_22_PIN_10
            PortPin_11: PortPinId=363, PortPinSymbolicName=PORT_22_PIN_11
        PortContainer_23: PortNumber=23, PortNumberOfPortPins=8
          8 x PortPin, all with PortPinControllerSelect=DISABLE, PortPinDirection=PORT_PIN_IN, PortPinDirectionChangeable=false, PortPinEmergencyStop=false, PortPinEnableAnalogInputOnly=PORT_PIN_ANALOG_INPUT_DISABLE, PortPinInitialMode=GPIO, PortPinInputPadLevel=PORT_INPUT_LEVEL_CMOS_AUTOMOTIVE, PortPinInputPullResistor=PORT_PIN_IN_PULL_UP, PortPinLevelValue=PORT_PIN_LEVEL_LOW, PortPinModeChangeable=false, PortPinOutputPadDriveStrength=PORT_PIN_DEFAULT_DRIVER, PortPinOutputPinDriveMode=PORT_PIN_OUT_PUSHPULL, PortPinMode=PORT_PIN_MODE_ALL:
            PortPin_2: PortPinId=370, PortPinSymbolicName=PORT_23_PIN_2
            PortPin_0: PortPinId=368, PortPinSymbolicName=PORT_23_PIN_0
            PortPin_1: PortPinId=369, PortPinSymbolicName=PORT_23_PIN_1
            PortPin_3: PortPinId=371, PortPinSymbolicName=PORT_23_PIN_3
            PortPin_6: PortPinId=374, PortPinSymbolicName=PORT_23_PIN_6
            PortPin_4: PortPinId=372, PortPinSymbolicName=PORT_23_PIN_4
            PortPin_5: PortPinId=373, PortPinSymbolicName=PORT_23_PIN_5
            PortPin_7: PortPinId=375, PortPinSymbolicName=PORT_23_PIN_7
        PortContainer_32: PortNumber=32, PortNumberOfPortPins=8
          8 x PortPin, all with PortPinControllerSelect=DISABLE, PortPinDirection=PORT_PIN_IN, PortPinDirectionChangeable=false, PortPinEmergencyStop=false, PortPinEnableAnalogInputOnly=PORT_PIN_ANALOG_INPUT_DISABLE, PortPinInitialMode=GPIO, PortPinInputPadLevel=PORT_INPUT_LEVEL_CMOS_AUTOMOTIVE, PortPinInputPullResistor=PORT_PIN_IN_PULL_UP, PortPinLevelValue=PORT_PIN_LEVEL_LOW, PortPinMode=PORT_PIN_MODE_ALL, PortPinModeChangeable=false, PortPinOutputPadDriveStrength=PORT_PIN_DEFAULT_DRIVER, PortPinOutputPinDriveMode=PORT_PIN_OUT_PUSHPULL:
            PortPin_2: PortPinId=514, PortPinSymbolicName=PORT_32_PIN_2
            PortPin_3: PortPinId=515, PortPinSymbolicName=PORT_32_PIN_3
            PortPin_4: PortPinId=516, PortPinSymbolicName=PORT_32_PIN_4
            PortPin_5: PortPinId=517, PortPinSymbolicName=PORT_32_PIN_5
            PortPin_7: PortPinId=519, PortPinSymbolicName=PORT_32_PIN_7
            PortPin_6: PortPinId=518, PortPinSymbolicName=PORT_32_PIN_6
            PortPin_0: PortPinId=512, PortPinSymbolicName=PORT_32_PIN_0
            PortPin_1: PortPinId=513, PortPinSymbolicName=PORT_32_PIN_1
        PortContainer_33: PortNumber=33, PortNumberOfPortPins=16
          16 x PortPin, all with PortPinDirection=PORT_PIN_IN, PortPinDirectionChangeable=false, PortPinEmergencyStop=false, PortPinEnableAnalogInputOnly=PORT_PIN_ANALOG_INPUT_DISABLE, PortPinInitialMode=GPIO, PortPinInputPadLevel=PORT_INPUT_LEVEL_CMOS_AUTOMOTIVE, PortPinInputPullResistor=PORT_PIN_IN_PULL_UP, PortPinLevelValue=PORT_PIN_LEVEL_LOW, PortPinMode=PORT_PIN_MODE_ALL, PortPinModeChangeable=false, PortPinOutputPadDriveStrength=PORT_PIN_DEFAULT_DRIVER, PortPinOutputPinDriveMode=PORT_PIN_OUT_PUSHPULL:
            PortPin_14: PortPinControllerSelect=DISABLE, PortPinId=542, PortPinSymbolicName=PORT_33_PIN_14
            PortPin_15: PortPinControllerSelect=DISABLE, PortPinId=543, PortPinSymbolicName=PORT_33_PIN_15
            PortPin_5: PortPinControllerSelect=DISABLE, PortPinId=533, PortPinSymbolicName=PORT_33_PIN_5
            PortPin_8: PortPinControllerSelect=ENABLE, PortPinId=536, PortPinSymbolicName=PORT_33_PIN_8
            PortPin_0: PortPinId=528, PortPinSymbolicName=PORT_33_PIN_0, PortPinControllerSelect=DISABLE
            PortPin_1: PortPinId=529, PortPinSymbolicName=PORT_33_PIN_1, PortPinControllerSelect=DISABLE
            PortPin_2: PortPinId=530, PortPinSymbolicName=PORT_33_PIN_2, PortPinControllerSelect=DISABLE
            PortPin_3: PortPinId=531, PortPinSymbolicName=PORT_33_PIN_3, PortPinControllerSelect=DISABLE
            PortPin_4: PortPinId=532, PortPinSymbolicName=PORT_33_PIN_4, PortPinControllerSelect=DISABLE
            PortPin_7: PortPinId=535, PortPinSymbolicName=PORT_33_PIN_7, PortPinControllerSelect=DISABLE
            PortPin_6: PortPinId=534, PortPinSymbolicName=PORT_33_PIN_6, PortPinControllerSelect=DISABLE
            PortPin_9: PortPinId=537, PortPinSymbolicName=PORT_33_PIN_9, PortPinControllerSelect=DISABLE
            PortPin_10: PortPinId=538, PortPinSymbolicName=PORT_33_PIN_10, PortPinControllerSelect=DISABLE
            PortPin_11: PortPinId=539, PortPinSymbolicName=PORT_33_PIN_11, PortPinControllerSelect=DISABLE
            PortPin_13: PortPinId=541, PortPinSymbolicName=PORT_33_PIN_13, PortPinControllerSelect=DISABLE
            PortPin_12: PortPinId=540, PortPinSymbolicName=PORT_33_PIN_12, PortPinControllerSelect=DISABLE
        PortContainer_34: PortNumber=34, PortNumberOfPortPins=5
          5 x PortPin, all with PortPinDirectionChangeable=false, PortPinInitialMode=GPIO, PortPinLevelValue=PORT_PIN_LEVEL_LOW, PortPinModeChangeable=false, PortPinOutputPinDriveMode=PORT_PIN_OUT_PUSHPULL, PortPinInputPadLevel=PORT_INPUT_LEVEL_CMOS_AUTOMOTIVE, PortPinEnableAnalogInputOnly=PORT_PIN_ANALOG_INPUT_DISABLE, PortPinEmergencyStop=false, PortPinControllerSelect=DISABLE:
            PortPin_1: PortPinId=545, PortPinSymbolicName=PORT_34_PIN_1, PortPinDirection=PORT_PIN_IN, PortPinMode=PORT_PIN_MODE_ALL, PortPinInputPullResistor=PORT_PIN_IN_PULL_UP, PortPinOutputPadDriveStrength=PORT_PIN_DEFAULT_DRIVER
            PortPin_2_SafetyBypass_DOm: PortPinId=546, PortPinSymbolicName=PORT_34_PIN_2, PortPinDirection=PORT_PIN_OUT, PortPinMode=PORT_PIN_MODE_GPIO, PortPinInputPullResistor=PORT_PIN_IN_NO_PULL, PortPinOutputPadDriveStrength=PORT_PIN_MEDIUM_DRIVER
            PortPin_3: PortPinId=547, PortPinSymbolicName=PORT_34_PIN_3, PortPinDirection=PORT_PIN_IN, PortPinMode=PORT_PIN_MODE_ALL, PortPinInputPullResistor=PORT_PIN_IN_PULL_UP, PortPinOutputPadDriveStrength=PORT_PIN_DEFAULT_DRIVER
            PortPin_4: PortPinId=548, PortPinSymbolicName=PORT_34_PIN_4, PortPinDirection=PORT_PIN_IN, PortPinMode=PORT_PIN_MODE_ALL, PortPinInputPullResistor=PORT_PIN_IN_PULL_UP, PortPinOutputPadDriveStrength=PORT_PIN_DEFAULT_DRIVER
            PortPin_5: PortPinId=549, PortPinSymbolicName=PORT_34_PIN_5, PortPinDirection=PORT_PIN_IN, PortPinMode=PORT_PIN_MODE_ALL, PortPinInputPullResistor=PORT_PIN_IN_PULL_UP, PortPinOutputPadDriveStrength=PORT_PIN_DEFAULT_DRIVER
        PortContainer_40: PortNumber=40, PortNumberOfPortPins=15
          15 x PortPin, all with PortPinDirection=PORT_PIN_IN, PortPinDirectionChangeable=false, PortPinInitialMode=GPIO, PortPinLevelValue=PORT_PIN_LEVEL_LOW, PortPinMode=PORT_PIN_MODE_ALL, PortPinModeChangeable=false, PortPinInputPullResistor=PORT_PIN_IN_PULL_UP, PortPinOutputPadDriveStrength=PORT_PIN_DEFAULT_DRIVER, PortPinOutputPinDriveMode=PORT_PIN_OUT_PUSHPULL, PortPinInputPadLevel=PORT_INPUT_LEVEL_CMOS_AUTOMOTIVE, PortPinEnableAnalogInputOnly=PORT_PIN_ANALOG_INPUT_DISABLE, PortPinEmergencyStop=false, PortPinControllerSelect=DISABLE:
            PortPin_0: PortPinId=640, PortPinSymbolicName=PORT_40_PIN_0
            PortPin_1: PortPinId=641, PortPinSymbolicName=PORT_40_PIN_1
            PortPin_2: PortPinId=642, PortPinSymbolicName=PORT_40_PIN_2
            PortPin_3: PortPinId=643, PortPinSymbolicName=PORT_40_PIN_3
            PortPin_4: PortPinId=644, PortPinSymbolicName=PORT_40_PIN_4
            PortPin_5: PortPinId=645, PortPinSymbolicName=PORT_40_PIN_5
            PortPin_6: PortPinId=646, PortPinSymbolicName=PORT_40_PIN_6
            PortPin_7: PortPinId=647, PortPinSymbolicName=PORT_40_PIN_7
            PortPin_8: PortPinId=648, PortPinSymbolicName=PORT_40_PIN_8
            PortPin_9: PortPinId=649, PortPinSymbolicName=PORT_40_PIN_9
            PortPin_10: PortPinId=650, PortPinSymbolicName=PORT_40_PIN_10
            PortPin_11: PortPinId=651, PortPinSymbolicName=PORT_40_PIN_11
            PortPin_12: PortPinId=652, PortPinSymbolicName=PORT_40_PIN_12
            PortPin_13: PortPinId=653, PortPinSymbolicName=PORT_40_PIN_13
            PortPin_14: PortPinId=654, PortPinSymbolicName=PORT_40_PIN_14
    PortGeneral:
      PortDevErrorDetect = true
      PortInitApiMode = PORT_MCAL_SUPERVISOR
      PortInitCheckApi = false
      PortSafetyEnable = true
      PortSetPinDirectionApi = false
      PortSetPinModeApi = false
      PortVersionInfoApi = false

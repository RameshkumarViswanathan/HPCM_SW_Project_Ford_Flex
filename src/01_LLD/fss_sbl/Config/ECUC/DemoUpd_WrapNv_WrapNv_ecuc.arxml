AUTOSAR XML (schema 00049)
package /ActiveEcuC
  module config WrapNv: implementation-config-variant=VARIANT-PRE-COMPILE, module-description=WrapNv_Impl
    WrapNvMemoryLayout
      26 x WrapNvDataBlock:
        DtcList: WrapNvDbDescription=This list holds the DTC status of all available DTCs, WrapNvDbCount=1, WrapNvDbIndex=10, WrapNvDbType=SINGLE
          DtcList (WrapNvDataElement):
            WrapNvDeDescription = please hold this value consistent with kNrOfSupportedDTCs (fbl_cfg.h) if you want to use the default implementation
            WrapNvDeLength = 10
            WrapNvDeIndex = 0
            WrapNvDeDefaultValue = 0x00 0x00 0x00 0x01 0x00 0x01 0x01 0x00 0x01 0x01
            WrapNvDeNVMBlockRef = NvMBlockDescriptor_DtcList
        MetaDataPartition: WrapNvDbCount=2, WrapNvDbDescription=Count must be identical to the number of partitions you use (2 for basic and 3 for extended OTA usecase), WrapNvDbType=TABLE, WrapNvDbIndex=12
          3 x WrapNvDataElement, all with WrapNvDeNVMBlockRef=NvMBlockDescriptor_MetaDataPartition:
            PartitionRevision: WrapNvDeDescription=Holds partition revision for OTA, WrapNvDeLength=4, WrapNvDeIndex=0, WrapNvDeDefaultValue=0xFF 0xFF 0xFF 0xFF
            PartitionValidity: WrapNvDeDescription=Holds partition validity for OTA, WrapNvDeLength=1, WrapNvDeIndex=1, WrapNvDeDefaultValue=0xFF
            ActivationPending: WrapNvDeDescription=Holds information for OTA if partition has been marked for activation, WrapNvDeLength=1, WrapNvDeIndex=2, WrapNvDeDefaultValue=0xFF
        MetaDataModule: WrapNvDbCount=6, WrapNvDbDescription=Count must be identical to the number of modules you use for all partitions, WrapNvDbType=TABLE, WrapNvDbIndex=11
          5 x WrapNvDataElement, all with WrapNvDeNVMBlockRef=NvMBlockDescriptor_MetaDataModule:
            ModuleRevision: WrapNvDeDescription=Holds module revision for OTA, WrapNvDeLength=4, WrapNvDeIndex=0, WrapNvDeDefaultValue=0xFF 0xFF 0xFF 0xFF
            ModuleValidity: WrapNvDeDescription=Holds module validity for OTA, WrapNvDeLength=1, WrapNvDeIndex=1, WrapNvDeDefaultValue=0xFF
            Digest: WrapNvDeDescription=Holds "Digest" of logical block. For default use case a hash value (20 bytes) SHA-1 and for OTA use case a signature value (256 bytes) RSA 2048 (SHA-256) is used., WrapNvDeLength=256, WrapNvDeIndex=2, WrapNvDeDefaultValue=0xFF 0xFF 0xFF 0xFF 0xFF 0xFF 0xFF 0xFF 0xFF 0xFF 0xFF 0xFF 0xFF 0xFF 0xFF 0xFF 0xFF 0xFF 0xFF 0xFF 0xFF 0xFF 0xFF 0xFF 0xFF 0xFF 0xFF 0xFF 0xFF 0xFF 0xFF 0xFF 0xFF 0xFF 0xFF 0xFF 0xFF 0xFF 0xFF 0xFF 0xFF 0xFF 0xFF 0xFF 0xFF 0xFF 0xFF 0xFF 0xFF 0xFF 0xFF 0xFF 0xFF 0xFF 0xFF 0xFF 0xFF 0xFF 0xFF 0xFF 0xFF 0xFF 0xFF 0xFF 0xFF 0xFF 0xFF 0xFF 0xFF 0xFF 0xFF 0xFF 0xFF 0xFF 0xFF 0xFF 0xFF 0xFF 0xFF 0xFF 0xFF 0xFF 0xFF 0xFF 0xFF 0xFF 0xFF 0xFF 0xFF 0xFF 0xFF 0xFF 0xFF 0xFF 0xFF 0xFF 0xFF 0xFF 0xFF 0xFF 0xFF 0xFF 0xFF 0xFF 0xFF 0xFF 0xFF 0xFF 0xFF 0xFF 0xFF 0xFF 0xFF 0xFF 0xFF 0xFF 0xFF 0xFF 0xFF 0xFF 0xFF 0xFF 0xFF 0xFF 0xFF 0xFF 0xFF 0xFF 0xFF 0xFF 0xFF 0xFF 0xFF 0xFF 0xFF 0xFF 0xFF 0xFF 0xFF 0xFF 0xFF 0xFF 0xFF 0xFF 0xFF 0xFF 0xFF 0xFF 0xFF 0xFF 0xFF 0xFF 0xFF 0xFF 0xFF 0xFF 0xFF 0xFF 0xFF 0xFF 0xFF 0xFF 0xFF 0xFF 0xFF 0xFF 0xFF 0xFF 0xFF 0xFF 0xFF 0xFF 0xFF 0xFF 0xFF 0xFF 0xFF 0xFF 0xFF 0xFF 0xFF 0xFF 0xFF 0xFF 0xFF 0xFF 0xFF 0xFF 0xFF 0xFF 0xFF 0xFF 0xFF 0xFF 0xFF 0xFF 0xFF 0xFF 0xFF 0xFF 0xFF 0xFF 0xFF 0xFF 0xFF 0xFF 0xFF 0xFF 0xFF 0xFF 0xFF 0xFF 0xFF 0xFF 0xFF 0xFF 0xFF 0xFF 0xFF 0xFF 0xFF 0xFF 0xFF 0xFF 0xFF 0xFF 0xFF 0xFF 0xFF 0xFF 0xFF 0xFF 0xFF 0xFF 0xFF 0xFF 0xFF 0xFF 0xFF 0xFF 0xFF 0xFF 0xFF 0xFF 0xFF 0xFF 0xFF 0xFF 0xFF 0xFF 0xFF 0xFF 0xFF 0xFF 0xFF 0xFF
            ProgAttemptCounter: WrapNvDeDescription=Holds programming counter of logical block. Just unmark the generate icon if you don't use programming counters at all and you want to save memory, WrapNvDeLength=1, WrapNvDeIndex=3, WrapNvDeDefaultValue=0x00
            dummy_block_MetadataNvBlocks: WrapNvDeIndex=4, WrapNvDeLength=2, WrapNvDeDescription=, WrapNvDeDefaultValue=0xFF 0xFF
        ProgReqFlag: WrapNvDbCount=1, WrapNvDbDescription=Default mechanism, how the bootloader detect entry from application, WrapNvDbIndex=2, WrapNvDbType=SINGLE
          ProgReqFlag (WrapNvDataElement):
            WrapNvDeDescription = Default mechanism, how the bootloader detect entry from application
            WrapNvDeLength = 1
            WrapNvDeIndex = 0
            WrapNvDeDefaultValue = 0xFF
            WrapNvDeNVMBlockRef = NvMBlockDescriptor_ProgReqFlag
        DcmDslRxTesterSourceAddr: WrapNvDbCount=1, WrapNvDbDescription=Tester source address to identify diagnostic connection during transitions bootloader <-> application, WrapNvDbIndex=8, WrapNvDbType=SINGLE
          DcmDslRxTesterSourceAddr (WrapNvDataElement):
            WrapNvDeDescription = Tester source address to identify diagnostic connection during transitions bootloader <-> application
            WrapNvDeLength = 2
            WrapNvDeIndex = 2
            WrapNvDeDefaultValue = 0xFF 0xFF
            WrapNvDeNVMBlockRef = NvMBlockDescriptor_DcmDslRxTesterSourceAddr
        InitFlag: WrapNvDbCount=1, WrapNvDbDescription=Defines if non-volatile memory has been initialized, WrapNvDbIndex=9, WrapNvDbType=SINGLE
          InitFlag (WrapNvDataElement):
            WrapNvDeDescription = Defines if non-volatile memory has been initialized
            WrapNvDeLength = 1
            WrapNvDeIndex = 3
            WrapNvDeDefaultValue = 0x55
            WrapNvDeNVMBlockRef = NvMBlockDescriptor_InitFlag
        DiagSecH: WrapNvDbIndex=13, WrapNvDbCount=1, WrapNvDbDescription=Default configuration for security access Renault DiagSecH, WrapNvDbType=STRUCT
          7 x WrapNvDataElement, all with WrapNvDeNVMBlockRef=NvMBlockDescriptor_DiagSecH:
            AuthentificationFlag: WrapNvDeDescription=AuthentificationFlag, WrapNvDeIndex=2, WrapNvDeLength=1, WrapNvDeDefaultValue=0xFF
            Counter: WrapNvDeDescription=Counter, WrapNvDeIndex=4, WrapNvDeLength=32, WrapNvDeDefaultValue=0x00 0x00 0x00 0x00 0x00 0x00 0x00 0x00 0x00 0x00 0x00 0x00 0x00 0x00 0x00 0x00 0x00 0x00 0x00 0x00 0x00 0x00 0x00 0x00 0x00 0x00 0x00 0x00 0x00 0x00 0x00 0x00
            FVirginFlag: WrapNvDeDescription=FVirginFlag (Default Valute F_NORMAL=0xFF), WrapNvDeIndex=1, WrapNvDeLength=1, WrapNvDeDefaultValue=0xFF
            PUN: WrapNvDeDescription=PUN (32 bytes for DiagSecH), WrapNvDeIndex=5, WrapNvDeLength=32, WrapNvDeDefaultValue=0xFF 0xFF 0xFF 0xFF 0xFF 0xFF 0xFF 0xFF 0xFF 0xFF 0xFF 0xFF 0xFF 0xFF 0xFF 0xFF 0xFF 0xFF 0xFF 0xFF 0xFF 0xFF 0xFF 0xFF 0xFF 0xFF 0xFF 0xFF 0xFF 0xFF 0xFF 0xFF
            SecretSeed: WrapNvDeDescription=SecretSeed, WrapNvDeIndex=3, WrapNvDeLength=256, WrapNvDeDefaultValue=0xFF 0xFF 0xFF 0xFF 0xFF 0xFF 0xFF 0xFF 0xFF 0xFF 0xFF 0xFF 0xFF 0xFF 0xFF 0xFF 0xFF 0xFF 0xFF 0xFF 0xFF 0xFF 0xFF 0xFF 0xFF 0xFF 0xFF 0xFF 0xFF 0xFF 0xFF 0xFF 0xFF 0xFF 0xFF 0xFF 0xFF 0xFF 0xFF 0xFF 0xFF 0xFF 0xFF 0xFF 0xFF 0xFF 0xFF 0xFF 0xFF 0xFF 0xFF 0xFF 0xFF 0xFF 0xFF 0xFF 0xFF 0xFF 0xFF 0xFF 0xFF 0xFF 0xFF 0xFF 0xFF 0xFF 0xFF 0xFF 0xFF 0xFF 0xFF 0xFF 0xFF 0xFF 0xFF 0xFF 0xFF 0xFF 0xFF 0xFF 0xFF 0xFF 0xFF 0xFF 0xFF 0xFF 0xFF 0xFF 0xFF 0xFF 0xFF 0xFF 0xFF 0xFF 0xFF 0xFF 0xFF 0xFF 0xFF 0xFF 0xFF 0xFF 0xFF 0xFF 0xFF 0xFF 0xFF 0xFF 0xFF 0xFF 0xFF 0xFF 0xFF 0xFF 0xFF 0xFF 0xFF 0xFF 0xFF 0xFF 0xFF 0xFF 0xFF 0xFF 0xFF 0xFF 0xFF 0xFF 0xFF 0xFF 0xFF 0xFF 0xFF 0xFF 0xFF 0xFF 0xFF 0xFF 0xFF 0xFF 0xFF 0xFF 0xFF 0xFF 0xFF 0xFF 0xFF 0xFF 0xFF 0xFF 0xFF 0xFF 0xFF 0xFF 0xFF 0xFF 0xFF 0xFF 0xFF 0xFF 0xFF 0xFF 0xFF 0xFF 0xFF 0xFF 0xFF 0xFF 0xFF 0xFF 0xFF 0xFF 0xFF 0xFF 0xFF 0xFF 0xFF 0xFF 0xFF 0xFF 0xFF 0xFF 0xFF 0xFF 0xFF 0xFF 0xFF 0xFF 0xFF 0xFF 0xFF 0xFF 0xFF 0xFF 0xFF 0xFF 0xFF 0xFF 0xFF 0xFF 0xFF 0xFF 0xFF 0xFF 0xFF 0xFF 0xFF 0xFF 0xFF 0xFF 0xFF 0xFF 0xFF 0xFF 0xFF 0xFF 0xFF 0xFF 0xFF 0xFF 0xFF 0xFF 0xFF 0xFF 0xFF 0xFF 0xFF 0xFF 0xFF 0xFF 0xFF 0xFF 0xFF 0xFF 0xFF 0xFF 0xFF 0xFF 0xFF 0xFF 0xFF 0xFF 0xFF 0xFF 0xFF 0xFF 0xFF 0xFF 0xFF 0xFF 0xFF 0xFF 0xFF 0xFF 0xFF 0xFF
            VirginFlag: WrapNvDeDescription=VirginFlag (Default Valute F_VIRGIN=0x00), WrapNvDeIndex=0, WrapNvDeLength=1, WrapNvDeDefaultValue=0x00
            dummy_block_DiagSecH: WrapNvDeIndex=6, WrapNvDeLength=1, WrapNvDeDescription=, WrapNvDeDefaultValue=0xFF
        ApplValidity: WrapNvDbType=SINGLE, WrapNvDbIndex=4, WrapNvDbCount=1, WrapNvDbDescription=Application validity flag
          ApplValidity (WrapNvDataElement):
            WrapNvDeIndex = 0
            WrapNvDeLength = 1
            WrapNvDeDescription = Application validity flag
            WrapNvDeDefaultValue = 0x01
            WrapNvDeNVMBlockRef = NvMBlockDescriptor_fblApplValidityNvBlock
        ResetResponseFlag: WrapNvDbType=SINGLE, WrapNvDbIndex=3, WrapNvDbCount=1, WrapNvDbDescription=Flag if a response to a request received before response is required
          ResetResponseFlag (WrapNvDataElement):
            WrapNvDeIndex = 0
            WrapNvDeLength = 1
            WrapNvDeDescription = Flag if a response to a request received before response is required
            WrapNvDeDefaultValue = 0xFF
            WrapNvDeNVMBlockRef = NvMBlockDescriptor_ResetResponseFlagNvBlock
        SecAccessDelayFlag: WrapNvDbType=SINGLE, WrapNvDbIndex=6, WrapNvDbCount=1, WrapNvDbDescription=Security Access delay flag
          SecAccessDelayFlag (WrapNvDataElement):
            WrapNvDeIndex = 0
            WrapNvDeLength = 1
            WrapNvDeDescription = Security Access delay flag
            WrapNvDeDefaultValue = 0xFF
            WrapNvDeNVMBlockRef = NvMBlockDescriptor_SecAccessDelayFlagNvBlock
        SecAccessInvalidCount: WrapNvDbType=SINGLE, WrapNvDbIndex=7, WrapNvDbCount=1, WrapNvDbDescription=Invalid security access attempt counter
          SecAccessInvalidCount (WrapNvDataElement):
            WrapNvDeIndex = 0
            WrapNvDeLength = 1
            WrapNvDeDescription = Invalid security access attempt counter
            WrapNvDeDefaultValue = 0xFF
            WrapNvDeNVMBlockRef = NvMBlockDescriptor_SecAccessInvalidCountNvBlock
        ValidityFlags: WrapNvDbType=SINGLE, WrapNvDbIndex=5, WrapNvDbCount=1, WrapNvDbDescription=Logical block validity information
          ValidityFlags (WrapNvDataElement):
            WrapNvDeIndex = 0
            WrapNvDeLength = 1
            WrapNvDeDescription = Logical block validity information
            WrapNvDeDefaultValue = 0xFE
            WrapNvDeNVMBlockRef = NvMBlockDescriptor_ValidityFlagsNvBlock
        MileageForNormalMode: WrapNvDbType=SINGLE, WrapNvDbIndex=0, WrapNvDbCount=1, WrapNvDbDescription=
          MileageForNormalMode (WrapNvDataElement): WrapNvDeIndex=0, WrapNvDeLength=1, WrapNvDeDescription=, WrapNvDeDefaultValue=0x00, WrapNvDeNVMBlockRef=NvMBlockDescriptor_MileageForNormalMode
        VIN: WrapNvDbType=SINGLE, WrapNvDbIndex=1, WrapNvDbCount=1, WrapNvDbDescription=
          VIN (WrapNvDataElement):
            WrapNvDeIndex = 0
            WrapNvDeLength = 17
            WrapNvDeDescription = 
            WrapNvDeDefaultValue = 0xFF 0xFF 0xFF 0xFF 0xFF 0xFF 0xFF 0xFF 0xFF 0xFF 0xFF 0xFF 0xFF 0xFF 0xFF 0xFF 0xFF
            WrapNvDeNVMBlockRef = NvMBlockDescriptor_VIN
        XcpRxTesterSourceAddr: WrapNvDbType=SINGLE, WrapNvDbIndex=15, WrapNvDbCount=1, WrapNvDbDescription=
          XcpRxTesterSourceAddr (WrapNvDataElement): WrapNvDeIndex=0, WrapNvDeLength=1, WrapNvDeDescription=, WrapNvDeDefaultValue=0x00, WrapNvDeNVMBlockRef=NvMBlockDescriptor_XcpRxTesterSourceAddr
        FotaState: WrapNvDbType=SINGLE, WrapNvDbIndex=14, WrapNvDbCount=1, WrapNvDbDescription=
          FotaState (WrapNvDataElement): WrapNvDeIndex=0, WrapNvDeLength=1, WrapNvDeDescription=, WrapNvDeDefaultValue=0xFF, WrapNvDeNVMBlockRef=NvMBlockDescriptor_FotaState
        PrevFotaState: WrapNvDbType=SINGLE, WrapNvDbIndex=16, WrapNvDbCount=1, WrapNvDbDescription=
          PrevFotaState (WrapNvDataElement): WrapNvDeIndex=0, WrapNvDeLength=1, WrapNvDeDescription=, WrapNvDeDefaultValue=0xFF, WrapNvDeNVMBlockRef=NvMBlockDescriptor_PrevFotaState
        CancelCounter: WrapNvDbType=SINGLE, WrapNvDbIndex=17, WrapNvDbCount=1, WrapNvDbDescription=
          CancelCounter (WrapNvDataElement): WrapNvDeIndex=0, WrapNvDeLength=1, WrapNvDeDescription=, WrapNvDeDefaultValue=0xFF, WrapNvDeNVMBlockRef=NvMBlockDescriptor_CancelCounter
        ErrorCodes: WrapNvDbType=SINGLE, WrapNvDbIndex=18, WrapNvDbCount=1, WrapNvDbDescription=
          ErrorCodes (WrapNvDataElement): WrapNvDeIndex=0, WrapNvDeLength=3, WrapNvDeDescription=, WrapNvDeDefaultValue=0xFF 0xFF 0xFF, WrapNvDeNVMBlockRef=NvMBlockDescriptor_ErrorCodes
        SignatureLB00: WrapNvDbType=SINGLE, WrapNvDbIndex=19, WrapNvDbCount=1, WrapNvDbDescription=
          SignatureLB00 (WrapNvDataElement):
            WrapNvDeIndex = 0
            WrapNvDeLength = 256
            WrapNvDeDescription = 
            WrapNvDeDefaultValue = 0xFF 0xFF 0xFF 0xFF 0xFF 0xFF 0xFF 0xFF 0xFF 0xFF 0xFF 0xFF 0xFF 0xFF 0xFF 0xFF 0xFF 0xFF 0xFF 0xFF 0xFF 0xFF 0xFF 0xFF 0xFF 0xFF 0xFF 0xFF 0xFF 0xFF 0xFF 0xFF 0xFF 0xFF 0xFF 0xFF 0xFF 0xFF 0xFF 0xFF 0xFF 0xFF 0xFF 0xFF 0xFF 0xFF 0xFF 0xFF 0xFF 0xFF 0xFF 0xFF 0xFF 0xFF 0xFF 0xFF 0xFF 0xFF 0xFF 0xFF 0xFF 0xFF 0xFF 0xFF 0xFF 0xFF 0xFF 0xFF 0xFF 0xFF 0xFF 0xFF 0xFF 0xFF 0xFF 0xFF 0xFF 0xFF 0xFF 0xFF 0xFF 0xFF 0xFF 0xFF 0xFF 0xFF 0xFF 0xFF 0xFF 0xFF 0xFF 0xFF 0xFF 0xFF 0xFF 0xFF 0xFF 0xFF 0xFF 0xFF 0xFF 0xFF 0xFF 0xFF 0xFF 0xFF 0xFF 0xFF 0xFF 0xFF 0xFF 0xFF 0xFF 0xFF 0xFF 0xFF 0xFF 0xFF 0xFF 0xFF 0xFF 0xFF 0xFF 0xFF 0xFF 0xFF 0xFF 0xFF 0xFF 0xFF 0xFF 0xFF 0xFF 0xFF 0xFF 0xFF 0xFF 0xFF 0xFF 0xFF 0xFF 0xFF 0xFF 0xFF 0xFF 0xFF 0xFF 0xFF 0xFF 0xFF 0xFF 0xFF 0xFF 0xFF 0xFF 0xFF 0xFF 0xFF 0xFF 0xFF 0xFF 0xFF 0xFF 0xFF 0xFF 0xFF 0xFF 0xFF 0xFF 0xFF 0xFF 0xFF 0xFF 0xFF 0xFF 0xFF 0xFF 0xFF 0xFF 0xFF 0xFF 0xFF 0xFF 0xFF 0xFF 0xFF 0xFF 0xFF 0xFF 0xFF 0xFF 0xFF 0xFF 0xFF 0xFF 0xFF 0xFF 0xFF 0xFF 0xFF 0xFF 0xFF 0xFF 0xFF 0xFF 0xFF 0xFF 0xFF 0xFF 0xFF 0xFF 0xFF 0xFF 0xFF 0xFF 0xFF 0xFF 0xFF 0xFF 0xFF 0xFF 0xFF 0xFF 0xFF 0xFF 0xFF 0xFF 0xFF 0xFF 0xFF 0xFF 0xFF 0xFF 0xFF 0xFF 0xFF 0xFF 0xFF 0xFF 0xFF 0xFF 0xFF 0xFF 0xFF 0xFF 0xFF 0xFF 0xFF 0xFF 0xFF 0xFF 0xFF 0xFF 0xFF 0xFF 0xFF
            WrapNvDeNVMBlockRef = NvMBlockDescriptor_SignatureLB00
        SignatureLB10: WrapNvDbType=SINGLE, WrapNvDbIndex=20, WrapNvDbCount=1, WrapNvDbDescription=
          SignatureLB10 (WrapNvDataElement):
            WrapNvDeIndex = 0
            WrapNvDeLength = 256
            WrapNvDeDescription = 
            WrapNvDeDefaultValue = 0xFF 0xFF 0xFF 0xFF 0xFF 0xFF 0xFF 0xFF 0xFF 0xFF 0xFF 0xFF 0xFF 0xFF 0xFF 0xFF 0xFF 0xFF 0xFF 0xFF 0xFF 0xFF 0xFF 0xFF 0xFF 0xFF 0xFF 0xFF 0xFF 0xFF 0xFF 0xFF 0xFF 0xFF 0xFF 0xFF 0xFF 0xFF 0xFF 0xFF 0xFF 0xFF 0xFF 0xFF 0xFF 0xFF 0xFF 0xFF 0xFF 0xFF 0xFF 0xFF 0xFF 0xFF 0xFF 0xFF 0xFF 0xFF 0xFF 0xFF 0xFF 0xFF 0xFF 0xFF 0xFF 0xFF 0xFF 0xFF 0xFF 0xFF 0xFF 0xFF 0xFF 0xFF 0xFF 0xFF 0xFF 0xFF 0xFF 0xFF 0xFF 0xFF 0xFF 0xFF 0xFF 0xFF 0xFF 0xFF 0xFF 0xFF 0xFF 0xFF 0xFF 0xFF 0xFF 0xFF 0xFF 0xFF 0xFF 0xFF 0xFF 0xFF 0xFF 0xFF 0xFF 0xFF 0xFF 0xFF 0xFF 0xFF 0xFF 0xFF 0xFF 0xFF 0xFF 0xFF 0xFF 0xFF 0xFF 0xFF 0xFF 0xFF 0xFF 0xFF 0xFF 0xFF 0xFF 0xFF 0xFF 0xFF 0xFF 0xFF 0xFF 0xFF 0xFF 0xFF 0xFF 0xFF 0xFF 0xFF 0xFF 0xFF 0xFF 0xFF 0xFF 0xFF 0xFF 0xFF 0xFF 0xFF 0xFF 0xFF 0xFF 0xFF 0xFF 0xFF 0xFF 0xFF 0xFF 0xFF 0xFF 0xFF 0xFF 0xFF 0xFF 0xFF 0xFF 0xFF 0xFF 0xFF 0xFF 0xFF 0xFF 0xFF 0xFF 0xFF 0xFF 0xFF 0xFF 0xFF 0xFF 0xFF 0xFF 0xFF 0xFF 0xFF 0xFF 0xFF 0xFF 0xFF 0xFF 0xFF 0xFF 0xFF 0xFF 0xFF 0xFF 0xFF 0xFF 0xFF 0xFF 0xFF 0xFF 0xFF 0xFF 0xFF 0xFF 0xFF 0xFF 0xFF 0xFF 0xFF 0xFF 0xFF 0xFF 0xFF 0xFF 0xFF 0xFF 0xFF 0xFF 0xFF 0xFF 0xFF 0xFF 0xFF 0xFF 0xFF 0xFF 0xFF 0xFF 0xFF 0xFF 0xFF 0xFF 0xFF 0xFF 0xFF 0xFF 0xFF 0xFF 0xFF 0xFF 0xFF 0xFF 0xFF 0xFF 0xFF 0xFF 0xFF 0xFF 0xFF 0xFF 0xFF 0xFF 0xFF
            WrapNvDeNVMBlockRef = NvMBlockDescriptor_SignatureLB10
        SignatureLB01: WrapNvDbType=SINGLE, WrapNvDbIndex=21, WrapNvDbCount=1, WrapNvDbDescription=
          SignatureLB01 (WrapNvDataElement):
            WrapNvDeIndex = 0
            WrapNvDeLength = 256
            WrapNvDeDescription = 
            WrapNvDeDefaultValue = 0xFF 0xFF 0xFF 0xFF 0xFF 0xFF 0xFF 0xFF 0xFF 0xFF 0xFF 0xFF 0xFF 0xFF 0xFF 0xFF 0xFF 0xFF 0xFF 0xFF 0xFF 0xFF 0xFF 0xFF 0xFF 0xFF 0xFF 0xFF 0xFF 0xFF 0xFF 0xFF 0xFF 0xFF 0xFF 0xFF 0xFF 0xFF 0xFF 0xFF 0xFF 0xFF 0xFF 0xFF 0xFF 0xFF 0xFF 0xFF 0xFF 0xFF 0xFF 0xFF 0xFF 0xFF 0xFF 0xFF 0xFF 0xFF 0xFF 0xFF 0xFF 0xFF 0xFF 0xFF 0xFF 0xFF 0xFF 0xFF 0xFF 0xFF 0xFF 0xFF 0xFF 0xFF 0xFF 0xFF 0xFF 0xFF 0xFF 0xFF 0xFF 0xFF 0xFF 0xFF 0xFF 0xFF 0xFF 0xFF 0xFF 0xFF 0xFF 0xFF 0xFF 0xFF 0xFF 0xFF 0xFF 0xFF 0xFF 0xFF 0xFF 0xFF 0xFF 0xFF 0xFF 0xFF 0xFF 0xFF 0xFF 0xFF 0xFF 0xFF 0xFF 0xFF 0xFF 0xFF 0xFF 0xFF 0xFF 0xFF 0xFF 0xFF 0xFF 0xFF 0xFF 0xFF 0xFF 0xFF 0xFF 0xFF 0xFF 0xFF 0xFF 0xFF 0xFF 0xFF 0xFF 0xFF 0xFF 0xFF 0xFF 0xFF 0xFF 0xFF 0xFF 0xFF 0xFF 0xFF 0xFF 0xFF 0xFF 0xFF 0xFF 0xFF 0xFF 0xFF 0xFF 0xFF 0xFF 0xFF 0xFF 0xFF 0xFF 0xFF 0xFF 0xFF 0xFF 0xFF 0xFF 0xFF 0xFF 0xFF 0xFF 0xFF 0xFF 0xFF 0xFF 0xFF 0xFF 0xFF 0xFF 0xFF 0xFF 0xFF 0xFF 0xFF 0xFF 0xFF 0xFF 0xFF 0xFF 0xFF 0xFF 0xFF 0xFF 0xFF 0xFF 0xFF 0xFF 0xFF 0xFF 0xFF 0xFF 0xFF 0xFF 0xFF 0xFF 0xFF 0xFF 0xFF 0xFF 0xFF 0xFF 0xFF 0xFF 0xFF 0xFF 0xFF 0xFF 0xFF 0xFF 0xFF 0xFF 0xFF 0xFF 0xFF 0xFF 0xFF 0xFF 0xFF 0xFF 0xFF 0xFF 0xFF 0xFF 0xFF 0xFF 0xFF 0xFF 0xFF 0xFF 0xFF 0xFF 0xFF 0xFF 0xFF 0xFF 0xFF 0xFF 0xFF 0xFF 0xFF 0xFF 0xFF 0xFF 0xFF
            WrapNvDeNVMBlockRef = NvMBlockDescriptor_SignatureLB01
        SignatureLB11: WrapNvDbType=SINGLE, WrapNvDbIndex=22, WrapNvDbCount=1, WrapNvDbDescription=
          SignatureLB11 (WrapNvDataElement):
            WrapNvDeIndex = 0
            WrapNvDeLength = 256
            WrapNvDeDescription = 
            WrapNvDeDefaultValue = 0xFF 0xFF 0xFF 0xFF 0xFF 0xFF 0xFF 0xFF 0xFF 0xFF 0xFF 0xFF 0xFF 0xFF 0xFF 0xFF 0xFF 0xFF 0xFF 0xFF 0xFF 0xFF 0xFF 0xFF 0xFF 0xFF 0xFF 0xFF 0xFF 0xFF 0xFF 0xFF 0xFF 0xFF 0xFF 0xFF 0xFF 0xFF 0xFF 0xFF 0xFF 0xFF 0xFF 0xFF 0xFF 0xFF 0xFF 0xFF 0xFF 0xFF 0xFF 0xFF 0xFF 0xFF 0xFF 0xFF 0xFF 0xFF 0xFF 0xFF 0xFF 0xFF 0xFF 0xFF 0xFF 0xFF 0xFF 0xFF 0xFF 0xFF 0xFF 0xFF 0xFF 0xFF 0xFF 0xFF 0xFF 0xFF 0xFF 0xFF 0xFF 0xFF 0xFF 0xFF 0xFF 0xFF 0xFF 0xFF 0xFF 0xFF 0xFF 0xFF 0xFF 0xFF 0xFF 0xFF 0xFF 0xFF 0xFF 0xFF 0xFF 0xFF 0xFF 0xFF 0xFF 0xFF 0xFF 0xFF 0xFF 0xFF 0xFF 0xFF 0xFF 0xFF 0xFF 0xFF 0xFF 0xFF 0xFF 0xFF 0xFF 0xFF 0xFF 0xFF 0xFF 0xFF 0xFF 0xFF 0xFF 0xFF 0xFF 0xFF 0xFF 0xFF 0xFF 0xFF 0xFF 0xFF 0xFF 0xFF 0xFF 0xFF 0xFF 0xFF 0xFF 0xFF 0xFF 0xFF 0xFF 0xFF 0xFF 0xFF 0xFF 0xFF 0xFF 0xFF 0xFF 0xFF 0xFF 0xFF 0xFF 0xFF 0xFF 0xFF 0xFF 0xFF 0xFF 0xFF 0xFF 0xFF 0xFF 0xFF 0xFF 0xFF 0xFF 0xFF 0xFF 0xFF 0xFF 0xFF 0xFF 0xFF 0xFF 0xFF 0xFF 0xFF 0xFF 0xFF 0xFF 0xFF 0xFF 0xFF 0xFF 0xFF 0xFF 0xFF 0xFF 0xFF 0xFF 0xFF 0xFF 0xFF 0xFF 0xFF 0xFF 0xFF 0xFF 0xFF 0xFF 0xFF 0xFF 0xFF 0xFF 0xFF 0xFF 0xFF 0xFF 0xFF 0xFF 0xFF 0xFF 0xFF 0xFF 0xFF 0xFF 0xFF 0xFF 0xFF 0xFF 0xFF 0xFF 0xFF 0xFF 0xFF 0xFF 0xFF 0xFF 0xFF 0xFF 0xFF 0xFF 0xFF 0xFF 0xFF 0xFF 0xFF 0xFF 0xFF 0xFF 0xFF 0xFF 0xFF 0xFF 0xFF 0xFF 0xFF
            WrapNvDeNVMBlockRef = NvMBlockDescriptor_SignatureLB11
        Appl_NvUpdateState: WrapNvDbType=SINGLE, WrapNvDbIndex=23, WrapNvDbCount=1, WrapNvDbDescription=
          Appl_NvUpdateState (WrapNvDataElement): WrapNvDeIndex=0, WrapNvDeLength=1, WrapNvDeDescription=, WrapNvDeDefaultValue=0xFF, WrapNvDeNVMBlockRef=NvMBlockDescriptor_Appl_NvUpdateState
        DTCStatusNvBlock: WrapNvDbType=SINGLE, WrapNvDbIndex=24, WrapNvDbCount=1, WrapNvDbDescription=
          DTCStatusNvBlock (WrapNvDataElement):
            WrapNvDeIndex = 0
            WrapNvDeLength = 15
            WrapNvDeDescription = 
            WrapNvDeDefaultValue = 0xFF 0xFF 0xFF 0xFF 0xFF 0xFF 0xFF 0xFF 0xFF 0xFF 0xFF 0xFF 0xFF 0xFF 0xFF
            WrapNvDeNVMBlockRef = NvMBlockDescriptor_DTCStatusNvBlock
        PartitionInfo: WrapNvDbType=SINGLE, WrapNvDbIndex=25, WrapNvDbCount=1, WrapNvDbDescription=
          PartitionInfo (WrapNvDataElement):
            WrapNvDeIndex = 0
            WrapNvDeLength = 6
            WrapNvDeDescription = 
            WrapNvDeDefaultValue = 0xFF 0xFF 0xFF 0xFF 0xFF 0xFF
            WrapNvDeNVMBlockRef = NvMBlockDescriptor_PartitionInfo
    WrapNvGeneral:
      WrapNvMainFunctionPolling = true
      WrapNvEEPROMBaseAddress = 1879244800
      WrapNvFirstHandle = 1
      WrapNvNVMDataHandling = FEE
      WrapNvDevErrorDetect = true
      WrapNvUserConfigFile = $(DpaProjectFolder)\Config\wrappnv_config.cfg
      WrapNvMainFunctionCycle_Fee (WrapNvMainFunctionCycle): WrapNvMainFunctionCycleValue=1, WrapNvMainFunctionCycleModuleRef=Fee
      WrapNvMainFunctionCycle_Fls (WrapNvMainFunctionCycle): WrapNvMainFunctionCycleValue=1, WrapNvMainFunctionCycleModuleRef=Fls

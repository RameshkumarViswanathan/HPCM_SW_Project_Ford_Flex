AUTOSAR XML (schema 00049)
package /ActiveEcuC
  module config EcuM: implementation-config-variant=VARIANT-POST-BUILD-LOADABLE
    EcuMGeneral: EcuMDevErrorDetect=false, EcuMIncludeDem=false, EcuMIncludeDet=false, EcuMMainFunctionPeriod=10, EcuMVersionInfoApi=false
    EcuMConfiguration
      EcuMCommonConfiguration: EcuMConfigConsistencyHash=18446744073709551615, EcuMDefaultAppMode=OsAppMode, EcuMOSResource=OsResource
        CN_DemoFBL_Renault_SLP5_27027b75 (EcuMWakeupSource): EcuMWakeupSourceId=5, EcuMWakeupSourcePolling=false, EcuMResetReasonRef=MCU_CB0_RESET
        EcuMDriverInitListOne
          EcuMDriverInitItem: EcuMModuleID=, EcuMModuleService=
        EcuMDefaultShutdownTarget: EcuMDefaultState=EcuMStateOff
        EcuMDriverRestartList
          EcuMDriverInitItem: EcuMModuleID=, EcuMModuleService=
        EcuMSleepMode: EcuMSleepModeId=0, EcuMSleepModeSuspend=false, EcuMSleepModeMcuModeRef=McuModeSettingConf_0, EcuMWakeupSourceMask=CN_DemoFBL_Renault_SLP5_27027b75
      EcuMFlexConfiguration: EcuMNormalMcuModeRef=McuModeSettingConf_0
        EcuMFlexUserConfig: EcuMFlexUser=0
        EcuMResetMode: EcuMResetModeId=0
        EcuMShutdownCause: EcuMShutdownCauseId=0
        EcuMShutdownTarget: EcuMShutdownTargetId=0

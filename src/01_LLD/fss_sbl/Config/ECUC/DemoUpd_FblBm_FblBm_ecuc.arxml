AUTOSAR XML (schema 00049)
package /ActiveEcuC
  module config FblBm: implementation-config-variant=VARIANT-PRE-COMPILE, module-description=FblBm_Impl
    FblBmGeneral:
      FblBmExecutionInstance = FlashBootloaderUpdater
      FblBmStandaloneMode = true
      FblBmIncludeOemConfiguration = true
      FblBmIncludeHardwareConfiguration = false
      FblBmHeaderAddress = 2147876832
      FblBmSecureBoot = false
      FblBmFailsafeUpdater = false
      FblBmInitializeKeys = false
      FblBmInitializeMacOfBootloader = false

AUTOSAR XML (schema 00049)
package /ActiveEcuC
  module config CanIf: implementation-config-variant=VARIANT-PRE-COMPILE, module-description=CanIf_Impl
    CanIfCtrlDrvCfg_7d254554 (CanIfCtrlDrvCfg): CanIfCtrlDrvTxCancellation=false, CanIfCtrlDrvInitHohConfigRef=CanIfInitHohCfg, CanIfCtrlDrvNameRef=CanGeneral
      Blu_VehicleCanIfCtrlCfg (CanIfCtrlCfg):  # CT_DemoFBL_Vector_SLP3_ALPINE_LEFT
        CanIfCtrlId = 0
        CanIfCtrlWakeupSupport = false
        CanIfCtrlJ1939DynAddrSupport = DISABLED
        CanIfCtrlCanCtrlRef = Blu_Vehicle_Controller
        CanIfCtrlTrcvCfgRef = CanIfTrcvCfg
    CanIfDispatchCfg:
      CanIfDispatchUserCtrlBusOffName = FblCw_ControllerBusOff
      CanIfDispatchUserCtrlBusOffUL = CDD
      CanIfDispatchUserCtrlModeIndicationName = FblCw_ControllerModeIndication
      CanIfDispatchUserCtrlModeIndicationUL = CDD
      CanIfDispatchUserTrcvModeIndicationUL = CDD
      CanIfDispatchUserTrcvModeIndicationName = Appl_TrcvModeIndication
    CanIfInitCfg
      CanIfInitHohCfg: CanIfInitRefCfgSet=CanConfigSet
        Blu_VehicleCanIfHrhCfg_Rx (CanIfHrhCfg): CanIfHrhSoftwareFilter=true, CanIfHrhCanCtrlIdRef=Blu_VehicleCanIfCtrlCfg, CanIfHrhIdSymRef=Blu_VehicleHwObject_Rx  # CN_DemoFBL_Vector_SLP3_ALPINE_LEFT
        Blu_VehicleCanIfHthCfg_Tx (CanIfHthCfg): CanIfHthCanCtrlIdRef=Blu_VehicleCanIfCtrlCfg, CanIfHthIdSymRef=Blu_VehicleHwObject_Tx  # CN_DemoFBL_Vector_SLP3_ALPINE_LEFT
      CHNL_4bbd136d (CanIfBufferCfg):
        CanIfBufferSize = 1
        CanIfTxBufferHandlingType = PRIO_BY_CANID
        CanIfTxBufferMappedTxPdus = 1
        CanIfTxBufferMaxPduLength = 8
        CanIfBufferHthRef = Blu_VehicleCanIfHthCfg_Tx
      Blu_VehicleCanIfRxPduCfg_Rx (CanIfRxPduCfg):  # Demo_1_CAN_Request_Tp_oDemoFBL_Vector_SLP3_ALPINE_LEFT
        CanIfRxPduCanId = 419430385
        CanIfRxPduCanIdType = EXTENDED_NO_FD_CAN
        CanIfRxPduDlc = 8
        CanIfRxPduUserRxIndicationName = CanTp_RxIndication
        CanIfRxPduUserRxIndicationType = PDUID_PDUINFOPTR
        CanIfRxPduUserRxIndicationUL = CAN_TP
        CanIfRxPduId = 0
        CanIfRxPduReadData = false
        CanIfRxPduReadNotifyStatus = false
        CanIfRxPduDlcCheck = false
        CanIfRxPduHrhIdRef = Blu_VehicleCanIfHrhCfg_Rx
        CanIfRxPduRef = Blu_CAN_Request_CanIf2CanTP_Vehicle2_Rx
      Blu_VehicleCanIfTxPduCfg_Tx (CanIfTxPduCfg):  # Demo_1_CAN_Response_Tp_oDemoFBL_Vector_SLP3_ALPINE_LEFT
        CanIfTxPduCanId = 419426815
        CanIfTxPduCanIdType = EXTENDED_CAN
        CanIfTxPduDlc = 8
        CanIfTxPduUserTxConfirmationName = CanTp_TxConfirmation
        CanIfTxPduUserTxConfirmationUL = CAN_TP
        CanIfTxPduId = 0
        CanIfTxPduReadNotifyStatus = false
        CanIfTxPduType = STATIC
        CanIfTxPduTruncation = true
        CanIfTxPduBufferRef = CHNL_4bbd136d
        CanIfTxPduRef = Blu_CAN_Request_CanIf2CanTP_Vehicle2_Tx
    CanIfPrivateCfg:
      CanIfPrivateSoftwareFilterType = LINEAR
      CanIfPrivateDlcCheck = false
      CanIfSupportTTCAN = false
      CanIfTransceiverMapping = false
      CanIfTransceiverHandling = true
      CanIfSupportExtendedIds = true
      CanIfSupportNmOsek = false
      CanIfTxBufferType = BYTE_QUEUE
      CanIfWakeupSupport = false
      CanIfStaticFdTxBufferSupport = false
      CanIfRxSearchConsiderMsgType = true
      CanIfTxBufferFifoSupport = false
      CanIfSetPduReceptionModeSupport = false
      CanIfCheckWakeupCanRetType = false
      CanIfDataChecksumRxSupport = false
      CanIfDataChecksumTxSupport = false
    CanIfPublicCfg:
      CanIfPublicPnSupport = false
      CanIfPublicCddHeaderFile = CanIf_Cdd.h
      CanIfPublicVersionInfoApi = false
      CanIfPublicCancelTransmitSupport = false
      CanIfPublicDevErrorDetect = true
      CanIfPublicHandleTypeEnum = UINT8
      CanIfPublicMultipleDrvSupport = false
      CanIfPublicNumberOfCanHwUnits = 1
      CanIfPublicReadRxPduDataApi = false
      CanIfPublicReadRxPduNotifyStatusApi = false
      CanIfPublicReadTxPduNotifyStatusApi = false
      CanIfPublicSetDynamicTxIdApi = false
      CanIfPublicTxBuffering = true
      CanIfPublicTxConfirmPollingSupport = false
      CanIfPublicWakeupCheckValidSupport = false
      CanIfPnWakeupTxPduFilterSupport = false
      CanIfPnTrcvHandlingSupport = false
      CanIfJ1939DynAddrSupport = DISABLED
      CanIfSafeBswChecks = false
      CanIfBusMirroringSupport = false
      CanIfEnableSecurityEventReporting = false
      CanIfSupportCanDrvAsr440 = false
      CanIfPublicChangeBaudrateSupport = false
      CanIfSetBaudrateApi = false
      CanIfPublicCddHeaderFile = Appl_stub.h
    CanIfTrcvDrvCfg
      CanIfTrcvCfg: CanIfTrcvId=0, CanIfTrcvWakeupSupport=false, CanIfTrcvCanTrcvRef=CanTrcvChannel_0

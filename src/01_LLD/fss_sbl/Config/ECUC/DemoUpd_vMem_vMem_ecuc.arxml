AUTOSAR XML (schema 00049)
package /ActiveEcuC
  module config vMem: implementation-config-variant=VARIANT-PRE-COMPILE, module-description=vMem_Impl
    vMemInstance: vMemInstanceId=0
      vMemSectorList
        4 x vMemSector, all with vMemPageSize=32, vMemSectorSize=131072:
          vMemSector_S4_S15: vMemNumberOfSectors=3, vMemStartAddress=2147876864
          vMemSector_S20_S31: vMemNumberOfSectors=3, vMemStartAddress=2154168320
          vMemSector_S0_S3: vMemNumberOfSectors=1, vMemStartAddress=2147745792
          vMemSector_S16_S19: vMemNumberOfSectors=1, vMemStartAddress=2154037248
    vMemInstanceMapping: vMemvMemInstanceRef=vMemInstance, vMemFblMemoryDeviceRef=Flash
    vMemGeneral: vMemInitialize=false, vMemUseIsBlank=false, vMemUserMainFunction=false, vMemUserInitFunction=false, vMemCompareAfterWrite=false

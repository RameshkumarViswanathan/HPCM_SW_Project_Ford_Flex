AUTOSAR XML (schema 00049)
package /ActiveEcuC
  module config vMemAccM: implementation-config-variant=VARIANT-PRE-COMPILE, module-description=vMemAccM_Impl
    AddressArea_A (vMemAccMAddressAreaConfiguration): vMemAccMAddressAreaId=0, vMemAccMAddressAreaPriority=0, vMemAccMReadRequestLength=64
      4 x vMemAccMSubAddressAreaConfiguration, all with vMemAccMvMemFuncPtrTableSymbol=vMem_30_Fbl_FunctionPointerTable, vMemAccMUseEraseBurst=false, vMemAccMUseWriteBurst=false:
        SubAddressArea_Bootloader_A: vMemAccMNumberOfSectors=3, vMemAccMVirtualStartAddress=2147876864, vMemAccMPhysicalStartAddress=2147876864, vMemAccMSectorRef=vMemSector_S4_S15
        SubAddressArea_Bootloader_B: vMemAccMNumberOfSectors=3, vMemAccMVirtualStartAddress=2154168320, vMemAccMPhysicalStartAddress=2154168320, vMemAccMSectorRef=vMemSector_S20_S31
        SubAddressArea_BootManager_A: vMemAccMNumberOfSectors=1, vMemAccMVirtualStartAddress=2147745792, vMemAccMPhysicalStartAddress=2147745792, vMemAccMSectorRef=vMemSector_S0_S3
        SubAddressArea_BootManager_B: vMemAccMNumberOfSectors=1, vMemAccMVirtualStartAddress=2154037248, vMemAccMPhysicalStartAddress=2154037248, vMemAccMSectorRef=vMemSector_S16_S19
    vMemAccMGeneral:
      vMemAccMVersionInfoApi = false
      vMemAccMMainFunctionPeriod = 0.005
      vMemAccMMainFunctionTriggering = FixedCycleTime
      vMemAccMSafeBswChecks = false
      vMemAccMDevErrorDetect = true
      vMemAccMCompareApi = false

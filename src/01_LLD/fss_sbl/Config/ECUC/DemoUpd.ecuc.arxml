AUTOSAR XML (schema 00049)
package /ActiveEcuC
  ecuc value collection ActiveEcuC
    ecuc-values:
      EcuM
      EcuC
      vSet
      Det
      MemMap
      Os
      vLinkGen
      FblBm
      vMem
      vMemAccM
      FblHal
      FblBmHdr
      Csm
      vSecPrim
      Crypto
      CryIf
      vBaseEnv
      vBRS
      ResourceM
      Dem
      Smh
      Fee
      Fls
      Irq
      McalLib
      Mcu
      NvM
      WrapNv
      Fbl

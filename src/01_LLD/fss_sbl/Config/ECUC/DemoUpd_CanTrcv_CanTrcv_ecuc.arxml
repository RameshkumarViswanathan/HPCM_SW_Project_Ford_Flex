AUTOSAR XML (schema 00049)
package /ActiveEcuC
  module config CanTrcv: implementation-config-variant=VARIANT-PRE-COMPILE, module-description=CanTrcv_Impl
    CanTrcvConfigSet
      CanTrcvChannel_0 (CanTrcvChannel):
        CanTrcvHwPnSupport = false
        CanTrcvInitState = CANTRCV_OP_MODE_NORMAL
        CanTrcvChannelId = 0
        CanTrcvChannelUsed = true
        CanTrcvControlsPowerSupply = false
        CanTrcvMaxBaudrate = 1000
        CanTrcvWakeupByBusUsed = false
        CanTrcvHardwareVariantGroup = TJA1043_REFERENCE_GROUP
        CanTrcvAccess
          CanTrcvDioAccess
            4 x CanTrcvDioChannelAccess:
              PinEN: CanTrcvHardwareInterfaceName=PinEN, CanTrcvDioSymNameRef=DioChannel_0_CanEtsEn
              PinSTB: CanTrcvHardwareInterfaceName=PinSTB, CanTrcvDioSymNameRef=DioChannel_1_CanEtsNstb
              PinERR: CanTrcvHardwareInterfaceName=PinERR, CanTrcvDioSymNameRef=DioChannel_6_CanEtsErr
              PinRXD: CanTrcvHardwareInterfaceName=PinRXD, CanTrcvDioSymNameRef=DioChannel_1_CanEtsRx_CNm
    CanTrcvGeneral:
      CanTrcvDevErrorDetect = true
      CanTrcvGetVersionInfo = false
      CanTrcvWakeUpSupport = CANTRCV_WAKEUP_BY_POLLING
      CanTrcvIndex = 0
      CanTrcvMainFunctionPeriod = 0.01
      CanTrcvSafeBswChecks = false

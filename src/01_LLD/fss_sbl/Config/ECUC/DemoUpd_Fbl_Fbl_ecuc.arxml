AUTOSAR XML (schema 00049)
package /ActiveEcuC
  module config Fbl: implementation-config-variant=VARIANT-LINK-TIME, module-description=Fbl_Impl
    FblFlashBlockTable
      8 x FblFlashBlock, all with FblFbMemoryDeviceRef=Flash, FblFbLogicalBlockRef=FblLogicalBlock_BM_FBL:
        FblFlashBlock_5: FblFbStartAddress=2154168320, FblFbEndAddress=2154299391, FblFbDescription=PF0 PS4-7: 32KB Block0_B (Bootloader)
        FblFlashBlock_6: FblFbStartAddress=2154299392, FblFbEndAddress=2154430463, FblFbDescription=PF0 PS8-11: 128KB Block1_B (Bootloader)
        FblFlashBlock_7: FblFbStartAddress=2154430464, FblFbEndAddress=2154561535, FblFbDescription=PF0 PS12-15: 128KB Block2_B (Bootloader)
        FblFlashBlock_1: FblFbStartAddress=2147876864, FblFbEndAddress=2148007935, FblFbDescription=PF0 PS4-7: 128KB Block0_A (Bootloader)
        FblFlashBlock_2: FblFbStartAddress=2148007936, FblFbEndAddress=2148139007, FblFbDescription=PF0 PS8-11: 32KB Block1_A (Bootloader)
        FblFlashBlock_3: FblFbStartAddress=2148139008, FblFbEndAddress=2148270079, FblFbDescription=PF0 PS12-15 128KB Block2_A (Bootloader)
        FblFlashBlock_0: FblFbStartAddress=2147745792, FblFbEndAddress=2147876863, FblFbDescription=PF0 PS0-3: 128KB Block0_A (BootManager)
        FblFlashBlock_4: FblFbStartAddress=2154037248, FblFbEndAddress=2154168319, FblFbDescription=PF0 PS0-3: 128KB Block0_B (BootManager)
    FblGeneral:
      FblDataProcessingBufferSize = 4096
      FblDiagnosticBufferSize = 4095
      FblInternalMemoryCopy = true
      FblMaximumNumberOfSegments = 10
      FblP2Server = 50
      FblP2StarServer = 5000
      FblUnalignedDataTransfer = true
      FblWriteSegmentation = 4096
      FblApplicationStateTask = true
      FblApplicationTimerTask = true
      FblUserConfigFile = $(DpaProjectFolder)\Config\user_config.cfg
      FblPipelinedVerification = false
      FblAdaptiveDataTransferRcrrp = false
      FblGatewaySupport = false
      FblInputVerification = false
      FblProcessedVerification = false
      FblS3ServerExtendedSession = 5000
      FblS3ServerProgrammingSession = 5000
      FblSuspendDriverOperation = false
      FblVerificationFunction = false
      FblCommonData = false
      FblPresencePattern = false
      FblFlashDriverUsage = DOWNLOAD_DRIVER
      FblResponseAfterReset = false
      FblSleepTime = 300000
      FblSleepMode = false
      FblStayInBoot = false
      FblVerificationSegmentation = 256
      FblOutputVerification = false
      FblGapFilling = false
      FblFillCode = 255
      FblProjectState = INTEGRATION
      FblHeaderAddress = 2148269824
      FblStartFunction = false
      FblUserSubfunction = false
      FblUserService = false
      FblUserRoutine = false
      FblWatchdogService = false
      FblWatchdogTriggerCycle = 1
      FblEncryptionMode = false
      FblCompressionMode = false
      FblPipelinedProgramming = false
      FblMaximumAmountOfLogicalBlocks = 8
      FblBlockStartAddress = 2147876864
      FblBlockLength = 393216
      FblOta = true
      FblOneStepUpdater = false
      FblHardwareSwap = false
    FblLogicalBlockTable
      FblLogicalBlock_BM_FBL (FblLogicalBlock):
        FblLbOutputVerification = V_NULL
        FblLbPipelinedVerification = V_NULL
        FblLbInputVerification = V_NULL
        FblLbProcessedVerification = V_NULL
        FblLbBlockIndex = 64769
        FblLbDisposability = MANDATORY
        FblLbStartAddress = 2147745792
        FblLbEndAddress = 2154561535
        FblLbMaxReprogAttempts = 126
        FblLbDescription = 
        FblLbBmHeaderAddress = 2148269824
      FblLogicalBlock_ASW (FblLogicalBlock):
        FblLbOutputVerification = V_NULL
        FblLbPipelinedVerification = V_NULL
        FblLbInputVerification = V_NULL
        FblLbProcessedVerification = V_NULL
        FblLbBlockIndex = 64770
        FblLbDisposability = MANDATORY
        FblLbStartAddress = 0
        FblLbEndAddress = 0
        FblLbMaxReprogAttempts = 0
        FblLbDescription = 
        FblLbBmHeaderAddress = 0
    FblRenault:
      FblSystemInternalFailureDtc = false
      FblAccessDelayTime = 600000
      FblApplicationValidityFlag = false
      FblCheckProgrammingPreconditionsService = false
      FblBsAndStminSpecific = true
      FblCheckProgDepRoutine = true
      FblDtc06ForEachLogicalBlock = true
      FblSingleGlobal06Dtc = true
      FblSingleGlobal06DtcId = 65023
      FblEcuResetInDefault = true
      FblRoutineControlInDefault = false
    FblMemoryDeviceTable
      Flash (FblMemoryDevice):
        FblMdSegmentSize = 32
        FblMdErasedValue = 0
        FblMdIndex = 0
        FblMdInitHook = false
        FblMdDeinitHook = false
        FblMdReadHook = false
        FblMdEraseHook = false
        FblMdWriteHook = false
        FblMdVerifyHook = false

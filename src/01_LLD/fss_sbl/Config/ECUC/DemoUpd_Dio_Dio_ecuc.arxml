AUTOSAR XML (schema 00049)
package /Dio
  module config Dio: implementation-config-variant=VARIANT-LINK-TIME, module-description=Dio_Impl
    CommonPublishedInformation:
      ArMajorVersion = 4
      ArMinorVersion = 2
      ArPatchVersion = 2
      ModuleId = 120
      Release = _TRICORE_TC387
      SwMajorVersion = 20
      SwMinorVersion = 0
      SwPatchVersion = 1
      VendorId = 17
    DioConfig
      3 x DioPort:
        DioPort_14: DioPortId=14
          4 x DioChannel:
            DioChannel_0_CanEtsEn: DioChannelId=0
            DioChannel_1_CanEtsNstb: DioChannelId=1
            DioChannel_6_CanEtsErr: DioChannelId=6
            DioChannel_10_CanDebugRx_CNm: DioChannelId=10
        DioPort_0: DioPortId=0
          DioChannel_6_InvSide_DIm (DioChannel): DioChannelId=6
        DioPort_2: DioPortId=2
          DioChannel_2_IgnRunStart (DioChannel): DioChannelId=2
          DioChannel_1_CanEtsRx_CNm (DioChannel): DioChannelId=1
    DioGeneral: DioDevErrorDetect=true, DioFlipChannelApi=false, DioMaskedWritePortApi=true, DioSafetyEnable=false, DioVersionInfoApi=false

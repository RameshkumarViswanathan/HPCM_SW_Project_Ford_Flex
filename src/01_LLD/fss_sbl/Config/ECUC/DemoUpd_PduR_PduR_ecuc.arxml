AUTOSAR XML (schema 00049)
package /ActiveEcuC
  module config PduR: implementation-config-variant=VARIANT-PRE-COMPILE, module-description=PduR_Impl
    PduRGeneral:
      PduRVersionInfoApi = false
      PduRDevErrorDetect = true
      PduRMetaDataSupport = false
      PduRPduCallback = false
      PduRSwitching = false
      PduRSafeBswChecks = false
      PduREnableDeferredTransmission = false
      PduREnableDeferredReception = false
      PduRSupportMulticore = false
      PduRRoutingTypeGateway = false
      PduRSpinlockRetryCounter = 4294967295
      PduRExtendedErrorChecks = false
      PduRGeneration:
        PduROutOfBoundsWriteProtectionStrategy = NONE
        PduROutOfBoundsWriteSanitizer = false
        PduROutOfBoundsReadSanitizer = false
        PduRNumericalDataTypeMinimizationStrategy = WITH_CAST
        PduRReduceConstantData2Define = false
        PduRBoolDataInArrayOfStructStrategy = BITMASKING
        PduRDeduplicateIndirectedData = true
        PduRDataDeduplicationStrategy = WITH_CAST
        PduRReduceBoolDataByNegationThreshold = 2
        PduRReduceBoolDataByNumericalComparisonThreshold = 2
        PduRReduceBoolDataByNumericalRelationThreshold = 2
        PduRReduceBoolDataByNumericalOperandStrategy = WITH_ANY_VALUE
        PduRReduceNumericalDataByOffsetThreshold = 2
        PduRReduceNumericalDataByArraySubtractionThreshold = 2
        PduRReduceDataByStreaming = false
        PduRShortSymbols = false
        PduRInterfacesForDeactivatedData = false
        PduRReferringKeysInComments = false
    PduRRoutingTables: PduRConfigurationId=0
      PduRRoutingTable
        Blu_PduRRoutinhPath_Tx (PduRRoutingPath): PduRRoutingPathCommunicationType=TRANSPORT_PROTOCOL, PduRMulticoreRoutingPath=false, PduRLockRef=PduRLock_PduRExclusiveArea  # Demo_1_CAN_Response_oDemoFBL_Vector_SLP3_ALPINE_LEFT
          PduRSrcPdu_2127c142 (PduRSrcPdu): PduRSourcePduHandleId=0, PduRSrcPduDirection=TRANSMIT, PduRSrcPduRef=Blu_CAN_Request_PduR2Dcm_Vehicle_Tx, PduRSrcPduPduRBswModulesRef=Dcm
          PduRDestPdu_Tx (PduRDestPdu):  # Demo_1_CAN_Response_oDemoFBL_Vector_SLP3_ALPINE_LEFT
            PduRDestPduHandleId = 0
            PduRDestPduDirection = TRANSMIT
            PduRDestPduRoutingType = API_FORWARDING
            PduRDestPduDataProcessing = IMMEDIATE
            PduRPduLengthHandlingStrategy = UNUSED
            PduRDestPduCrossPartitionDestination = false
            PduRDestPduRef = Blu_CAN_Request_CanTp2PduR_Vehicle1_Tx
            PduRDestPduPduRBswModulesRef = CanTp
        Blu_PduRRoutinhPath_Rx (PduRRoutingPath): PduRRoutingPathCommunicationType=TRANSPORT_PROTOCOL, PduRMulticoreRoutingPath=false, PduRLockRef=PduRLock_PduRExclusiveArea  # Demo_1_CAN_Request_oDemoFBL_Vector_SLP3_ALPINE_LEFT
          PduRDestPdu_b65775dd (PduRDestPdu):
            PduRDestPduHandleId = 0
            PduRDestPduDirection = RECEIVE
            PduRDestPduRoutingType = API_FORWARDING
            PduRDestPduDataProcessing = IMMEDIATE
            PduRPduLengthHandlingStrategy = UNUSED
            PduRDestPduCrossPartitionDestination = false
            PduRDestPduRef = Blu_CAN_Request_PduR2Dcm_Vehicle_Rx
            PduRDestPduPduRBswModulesRef = Dcm
          PduRSrcPdu_b65775dd (PduRSrcPdu): PduRSourcePduHandleId=0, PduRSrcPduDirection=RECEIVE, PduRSrcPduRef=Blu_CAN_Request_CanTp2PduR_Vehicle1_Rx, PduRSrcPduPduRBswModulesRef=CanTp
      PduRLock_PduRExclusiveArea (PduRLock)
        PduRExclusiveArea: PduRExclusiveAreaId=0
    CanTp (PduRBswModules):
      PduRCancelReceive = false
      PduRCancelTransmit = false
      PduRChangeParameterRequestApi = true
      PduRCommunicationInterface = false
      PduRLowerModule = true
      PduRTransportProtocol = true
      PduRTriggertransmit = false
      PduRTxConfirmation = false
      PduRUpperModule = false
      PduRUseTag = false
      PduRBswModuleRef = CanTp
    Dcm (PduRBswModules):
      PduRCancelReceive = false
      PduRCancelTransmit = false
      PduRChangeParameterRequestApi = true
      PduRCommunicationInterface = false
      PduRLowerModule = false
      PduRTransportProtocol = true
      PduRTriggertransmit = false
      PduRTxConfirmation = false
      PduRUpperModule = true
      PduRUseTag = true
      PduRBswModuleRef = Dcm

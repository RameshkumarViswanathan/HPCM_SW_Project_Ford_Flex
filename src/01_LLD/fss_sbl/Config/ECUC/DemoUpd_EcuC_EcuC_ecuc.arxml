AUTOSAR XML (schema 00049)
package /ActiveEcuC
  module config EcuC: implementation-config-variant=VARIANT-PRE-COMPILE, module-description=EcuC_Impl
    EcucPduCollection: PduIdTypeEnum=UINT8, PduLengthTypeEnum=UINT16
      6 x Pdu, all with PduLength=8, J1939Requestable=false:
        Demo_0_CAN_Request_oDemoFBL_Renault_SLP5_fcb17c20_Rx: DynamicLength=true
        Demo_0_CAN_Response_oDemoFBL_Renault_SLP5_dc09baea_Tx: DynamicLength=true
        Demo_0_CAN_Response_oDemoFBL_Renault_SLP5_6f439772_Tx: DynamicLength=true
        Demo_0_CAN_Request_oDemoFBL_Renault_SLP5_60ded03a_Rx: DynamicLength=true
        Demo_0_CAN_Request_Tp_oDemoFBL_Renault_SLP5_7034f1ac_Rx: DynamicLength=false
        Demo_0_CAN_Response_Tp_oDemoFBL_Renault_SLP5_7a18007a_Tx: DynamicLength=false
    EcucGeneral:
      CPUType = CPU32Bit
      SizeOfInt = Size32Bit
      ByteOrder = LITTLE_ENDIAN
      BitOrder = LSB_to_MSB
      AtomicBitAccessInBitfield = false
      AtomicVariableAccess = Atomic32BitAccess
      SizeOfEnum = Size32Bit
      SizeOfROMPointer = Size32Bit
      SizeOfRAMPointer = Size32Bit
      BitFieldDataType = INT
      StructAlignment = Auto
      ArrayAlignment = Align8Bit
      StructInArrayAlignment = Auto
      DummyFunction = false
      DummyStatement = true
      DummyStatementKind = None
      ConditionalGenerating = true
      EcucBswImplementationCodeType = EcuCSourceCode
      EcuCUseStdReturnTypeForRte = false
      PostbuildLoadable: AlignmentFillPattern=255, PBROMStartAddress=0, PBRAMStartAddress=0, PBROMEndAddress=0, PBRAMEndAddress=0
      BswInitialization
        19 x InitFunction:
          Det_Init: Header=Det.h, InitPhase=INIT_ZERO, ConfigType=Det_ConfigType, ConfigPtrName=Det_Config_Ptr, ConfigPtrClass=DET_INIT_DATA, ModuleRef=Det  # /ActiveEcuC/Det PLAIN_TEXT Init function description of Det in UnfilteredViewInInvariantProject (UnfilteredInvariantProjectModelView) .
          Det_InitMemory: Header=Det.h, InitPhase=INIT_MEMORY, ModuleRef=Det  # /ActiveEcuC/Det PLAIN_TEXT InitMemory function description of Det in UnfilteredViewInInvariantProject (UnfilteredInvariantProjectModelView) .
          WrapNv_Init: Header=WrapNv.h, InitPhase=INIT_TWO_SYS, ModuleRef=WrapNv  # /ActiveEcuC/WrapNv PLAIN_TEXT WrapNv_Init function description
          vLinkGen_Init: Header=vLinkGen_Lcfg.h, InitPhase=NO_INIT, ModuleRef=vLinkGen  # /ActiveEcuC/vLinkGen PLAIN_TEXT Dummy initialization of the vLinkGen
          vMemAccM_Init: Header=vMemAccM.h, InitPhase=INIT_TWO_DRV, ModuleRef=vMemAccM  # /ActiveEcuC/vMemAccM PLAIN_TEXT Initializes the vMemAccM.
          vMemAccM_InitMemory: Header=vMemAccM.h, InitPhase=INIT_MEMORY, ModuleRef=vMemAccM  # /ActiveEcuC/vMemAccM PLAIN_TEXT Initializes all *_INIT_* section variables within the vMemAccM.
          CryIf_InitMemory: Header=CryIf.h, InitPhase=INIT_MEMORY, ModuleRef=CryIf  # /ActiveEcuC/CryIf PLAIN_TEXT Initializes variables of the Crypto Interface
          CryIf_Init: Header=CryIf.h, InitPhase=INIT_TWO_IF, ModuleRef=CryIf  # /ActiveEcuC/CryIf PLAIN_TEXT Initializes the Crypto Interface
          Crypto_30_LibCv_InitMemory: Header=Crypto_30_LibCv.h, InitPhase=INIT_MEMORY, ModuleRef=Crypto  # /ActiveEcuC/Crypto PLAIN_TEXT Initializes variables of the Crypto Driver
          Crypto_30_LibCv_Init: Header=Crypto_30_LibCv.h, InitPhase=INIT_TWO_DRV, ModuleRef=Crypto  # /ActiveEcuC/Crypto PLAIN_TEXT Initializes the Crypto Driver
          Csm_Init: Header=Csm.h, InitPhase=INIT_TWO_SYS, ModuleRef=Csm  # /ActiveEcuC/Csm PLAIN_TEXT Initializes the Crypto Service Manager
          Csm_InitMemory: Header=Csm.h, InitPhase=INIT_MEMORY, ModuleRef=Csm  # /ActiveEcuC/Csm PLAIN_TEXT Initializes variables of the Crypto Service Manager
          vBaseEnv_Init: Header=, InitPhase=NO_INIT, ModuleRef=vBaseEnv  # /ActiveEcuC/vBaseEnv PLAIN_TEXT Created vBaseEnv_Init by Extended Init XML Service
          Fee_Init: Header=Fee.h, InitPhase=INIT_ONE_LATE, ConfigType=Fee_ConfigType, ConfigPtrName=&Fee_Config, ConfigPtrClass=AUTOMATIC, ModuleRef=Fee  # /ActiveEcuC/Fee PLAIN_TEXT Created Fee_Init by Extended Init XML Service
          Fls_17_Dmu_Init: Header=Fls_17_Dmu.h, InitPhase=INIT_ONE, ConfigType=Fls_17_Dmu_ConfigType, ConfigPtrName=&Fls_17_Dmu_Config, ConfigPtrClass=AUTOMATIC, ModuleRef=Fls  # /ActiveEcuC/Fls PLAIN_TEXT Created Fls_17_Dmu_Init by Extended Init XML Service
          Brs_Init: Header=, InitPhase=NO_INIT, ModuleRef=vBRS  # /ActiveEcuC/vBRS PLAIN_TEXT Automatically generated by EcuCBswInitFctConfigurationService.
          McalLib_Init: Header=McalLib.h, InitPhase=NO_INIT, ModuleRef=McalLib  # /ActiveEcuC/McalLib PLAIN_TEXT Created McalLib_Init by Extended Init XML Service
          Irq_Init: Header=Irq.h, InitPhase=NO_INIT, ModuleRef=Irq  # /ActiveEcuC/Irq PLAIN_TEXT Created Irq_Init by Extended Init XML Service
          Mcu_Init: Header=Mcu.h, InitPhase=INIT_ONE_EARLY, ConfigType=Mcu_ConfigType, ConfigPtrName=&Mcu_Config, ConfigPtrClass=AUTOMATIC, AdditionalInitCode=Mcu_InitClock(0);while (MCU_PLL_LOCKED != Mcu_GetPllStatus());Mcu_DistributePllClock();, ModuleRef=Mcu  # /Mcu/Mcu PLAIN_TEXT Created Mcu_Init by Extended Init XML Service

AUTOSAR XML (schema 00049)
package /ActiveEcuC
  module config Dcm: implementation-config-variant=VARIANT-PRE-COMPILE, module-description=Dcm_Impl
    DcmConfigSet
      DcmGeneral:
        DcmRespondAllRequest = true
        DcmVersionInfoApi = false
        DcmBaudrateSwitch = false
        DcmKeySlotMode = false
        DcmNwStatusRxBufferSize = 0
        DcmQueuedRequest = false
        DcmTaskTime = 0
        DcmCanHardwareLoopTimeout = 100
        DcmTaskCycle = 5
        DcmDevErrorDetect = true
        DcmBswInitializationFilter = Dcm
        DcmBswInitializationFilter = Fee
        DcmBswInitializationFilter = Fls
        DcmBswInitializationFilter = Ea
        DcmBswInitializationFilter = Eep
        DcmBswInitializationFilter = Gpt
        DcmBswInitializationFilter = Mcu
        DcmBswInitializationFilter = Port
        DcmBswInitializationFilter = Dio
      DcmDsp
        DcmDspSession
          DcmDspSessionRow: DcmDspSessionLevel=0, DcmDspSessionP2ServerMax=0, DcmDspSessionP2StarServerMax=0
      DcmDsl
        DcmDslBuffer: DcmDslBufferSize=8
        DcmDslDiagResp: DcmDslDiagRespMaxNumOfDeclinedRequests=3, DcmDslDiagRespOnSecondDeclinedRequest=false
        DcmDslProtocol
          DcmDslProtocolRow_29812fbf (DcmDslProtocolRow): DcmDslProtocolID=DCM_UDS_ON_CAN
            DcmDslConnection_9ba5ed2e (DcmDslConnection)
              DcmDslMainConnection: DcmDslProtocolRxTesterSourceAddr=1, DcmDslPayloadLimit=4095
                Blu_VehicleDcmDslProtocol_Rx (DcmDslProtocolRx):
                  DcmDslProtocolRxAddrType = DCM_PHYSICAL_TYPE
                  DcmDslProtocolRxPduId = 0
                  DcmDslProtocolRxComMChannelRef = (unset)
                  DcmDslProtocolRxPduRef = Blu_CAN_Request_PduR2Dcm_Vehicle_Rx
                Blu_VehicleDcmDslProtocol_Tx (DcmDslProtocolTx): DcmDslTxConfirmationPduId=0, DcmDslProtocolTxPduRef=Blu_CAN_Request_PduR2Dcm_Vehicle_Tx
      DcmGeneration:
        DcmInterfacesForDeactivatedData = false
        DcmReduceConstantData2Define = false
        DcmReduceNumericalDataByOffsetThreshold = 0
        DcmReferringKeysInComments = false
        DcmShortSymbols = false

AUTOSAR XML (schema 00049)
package /ActiveEcuC
  module config FblBmHdr: implementation-config-variant=VARIANT-PRE-COMPILE, module-description=FblBmHdr_Impl
    FblBmHdrHeader: FblBmHdrBlockStartAddress=2148270080, FblBmHdrBlockLength=3391488, FblBmHdrEntryAddress=_start, FblBmHdrTargetRef=FblUpdater
      FblBmHdrVariant
        FblBmHdrAuthenticationHeader: FblBmHdrAuthenticationHeaderAddress=0x800C0000
    4 x FblBmHdrTarget:
      Appl: FblBmHdrTargetId=2
      Data: FblBmHdrTargetId=3
      Fbl: FblBmHdrTargetId=0
      FblUpdater: FblBmHdrTargetId=1
    FblBmHdrGeneral: FblBmHdrMaxVerificationEntries=10, FblBmHdrSbVerificationList=false

AUTOSAR XML (schema 4-0-3)
package /MICROSAR
  bsw implementation PduR_Impl: programming-language=C, sw-version=17.02.00, used-code-generator=DaVinci Configurator, vendor-id=30, ar-release-version=4.01.02

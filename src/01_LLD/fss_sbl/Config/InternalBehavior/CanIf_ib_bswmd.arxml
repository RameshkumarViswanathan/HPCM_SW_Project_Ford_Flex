AUTOSAR XML (schema 00048)
package /MICROSAR
  bsw implementation CanIf_Impl: programming-language=C, sw-version=8.03.00, used-code-generator=cMSR, vendor-id=30, ar-release-version=4.00.03

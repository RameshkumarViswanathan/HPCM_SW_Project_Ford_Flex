ENTRY(brsStartupEntry);
MEMORY
{
  RegionBlock_DSPR5 : ORIGIN = 0x10000000 , LENGTH = 0x00018000
  RegionBlock_DSPR4 : ORIGIN = 0x30000000 , LENGTH = 0x00018000
  RegionBlock_DSPR3 : ORIGIN = 0x40000000 , LENGTH = 0x00018000
  RegionBlock_DSPR2 : ORIGIN = 0x50000000 , LENGTH = 0x00018000
  RegionBlock_DSPR1 : ORIGIN = 0x60000000 , LENGTH = 0x0003C000
  RegionBlock_DSPR0 : ORIGIN = 0x70000000 , LENGTH = 0x0003BFE8
  RegionBlock_ETKMG : ORIGIN = 0x7003BFE8 , LENGTH = 0x00000018
  RegionBlock_STARTUP : ORIGIN = 0x800D0300 , LENGTH = 0x00000050
  RegionBlock_PFL0_C : ORIGIN = 0x800D0350 , LENGTH = 0x0022FCB0
  RegionBlock_PFL1_C : ORIGIN = 0x80300000 , LENGTH = 0x002E3E00
  RegionBlock_CALIB : ORIGIN = 0x80C00300 , LENGTH = 0x000A7BE0
  RegionBlock_CALSIG : ORIGIN = 0x80CA7EE0 , LENGTH = 0x00000018
  RegionBlock_BMHD0 : ORIGIN = 0xAF400000 , LENGTH = 0x00000200
  RegionBlock_BMHD1 : ORIGIN = 0xAF400200 , LENGTH = 0x00000200
  RegionBlock_BMHD2 : ORIGIN = 0xAF400400 , LENGTH = 0x00000200
  RegionBlock_BMHD3 : ORIGIN = 0xAF400600 , LENGTH = 0x00000200
  RegionBlock_LMU2 : ORIGIN = 0xB00E8000 , LENGTH = 0x00008000
  RegionBlock_LMU2_SB : ORIGIN = 0xB00F0000 , LENGTH = 0x00010000
  RegionBlock_EmemCal : ORIGIN = 0xB92C0000 , LENGTH = 0x00040000
}
SECTIONS
{
  .CSA_CORE0 : ALIGN(64)
  {
    _CSA_CORE0_START = ABSOLUTE(.);
       __CSA_BEGIN_CPU0_ = .;
    . += 24300;
    __CSA_END_CPU0_ = .;
    . = ALIGN(64);
    _CSA_CORE0_END = ABSOLUTE(. - 1);
    _CSA_CORE0_LIMIT = ABSOLUTE(.);
  } > RegionBlock_DSPR0
  _CSA_CORE0_VAR_ALL_START = _CSA_CORE0_START;
  _CSA_CORE0_VAR_ALL_END = _CSA_CORE0_END;
  _CSA_CORE0_VAR_ALL_LIMIT = _CSA_CORE0_LIMIT;
__CSA_SIZE_CPU0_ = __CSA_END_CPU0_ - __CSA_BEGIN_CPU0_;
  .CSA_CORE1 : ALIGN(64)
  {
    _CSA_CORE1_START = ABSOLUTE(.);
       __CSA_BEGIN_CPU1_ = .;
    . += 8192;
    __CSA_END_CPU1_ = .;
    . = ALIGN(64);
    _CSA_CORE1_END = ABSOLUTE(. - 1);
    _CSA_CORE1_LIMIT = ABSOLUTE(.);
  } > RegionBlock_DSPR1
  _CSA_CORE1_VAR_ALL_START = _CSA_CORE1_START;
  _CSA_CORE1_VAR_ALL_END = _CSA_CORE1_END;
  _CSA_CORE1_VAR_ALL_LIMIT = _CSA_CORE1_LIMIT;
__CSA_SIZE_CPU1_ = __CSA_END_CPU1_ - __CSA_BEGIN_CPU1_;
  .CSA_CORE2 : ALIGN(64)
  {
    _CSA_CORE2_START = ABSOLUTE(.);
       __CSA_BEGIN_CPU2_ = .;
    . += 8192;
    __CSA_END_CPU2_ = .;
    . = ALIGN(64);
    _CSA_CORE2_END = ABSOLUTE(. - 1);
    _CSA_CORE2_LIMIT = ABSOLUTE(.);
  } > RegionBlock_DSPR2
  _CSA_CORE2_VAR_ALL_START = _CSA_CORE2_START;
  _CSA_CORE2_VAR_ALL_END = _CSA_CORE2_END;
  _CSA_CORE2_VAR_ALL_LIMIT = _CSA_CORE2_LIMIT;
__CSA_SIZE_CPU2_ = __CSA_END_CPU2_ - __CSA_BEGIN_CPU2_;
  .CSA_CORE3 : ALIGN(64)
  {
    _CSA_CORE3_START = ABSOLUTE(.);
       __CSA_BEGIN_CPU3_ = .;
    . += 8192;
    __CSA_END_CPU3_ = .;
    . = ALIGN(64);
    _CSA_CORE3_END = ABSOLUTE(. - 1);
    _CSA_CORE3_LIMIT = ABSOLUTE(.);
  } > RegionBlock_DSPR3
  _CSA_CORE3_VAR_ALL_START = _CSA_CORE3_START;
  _CSA_CORE3_VAR_ALL_END = _CSA_CORE3_END;
  _CSA_CORE3_VAR_ALL_LIMIT = _CSA_CORE3_LIMIT;
__CSA_SIZE_CPU3_ = __CSA_END_CPU3_ - __CSA_BEGIN_CPU3_;
  .CSA_CORE4 : ALIGN(64)
  {
    _CSA_CORE4_START = ABSOLUTE(.);
       __CSA_BEGIN_CPU4_ = .;
    . += 8192;
    __CSA_END_CPU4_ = .;
    . = ALIGN(64);
    _CSA_CORE4_END = ABSOLUTE(. - 1);
    _CSA_CORE4_LIMIT = ABSOLUTE(.);
  } > RegionBlock_DSPR4
  _CSA_CORE4_VAR_ALL_START = _CSA_CORE4_START;
  _CSA_CORE4_VAR_ALL_END = _CSA_CORE4_END;
  _CSA_CORE4_VAR_ALL_LIMIT = _CSA_CORE4_LIMIT;
__CSA_SIZE_CPU4_ = __CSA_END_CPU4_ - __CSA_BEGIN_CPU4_;
  .CSA_CORE5 : ALIGN(64)
  {
    _CSA_CORE5_START = ABSOLUTE(.);
       __CSA_BEGIN_CPU5_ = .;
    . += 8192;
    __CSA_END_CPU5_ = .;
    . = ALIGN(64);
    _CSA_CORE5_END = ABSOLUTE(. - 1);
    _CSA_CORE5_LIMIT = ABSOLUTE(.);
  } > RegionBlock_DSPR5
  _CSA_CORE5_VAR_ALL_START = _CSA_CORE5_START;
  _CSA_CORE5_VAR_ALL_END = _CSA_CORE5_END;
  _CSA_CORE5_VAR_ALL_LIMIT = _CSA_CORE5_LIMIT;
__CSA_SIZE_CPU5_ = __CSA_END_CPU5_ - __CSA_BEGIN_CPU5_;
  .Calib_Signature : ALIGN(4)
  {
    _Calib_Signature_START = ABSOLUTE(.);
*(.etk_check)
    . = ALIGN(4);
    _Calib_Signature_END = ABSOLUTE(. - 1);
    _Calib_Signature_LIMIT = ABSOLUTE(.);
  } > RegionBlock_CALSIG
  .Calibration :
  {
    _Calibration_START = ABSOLUTE(.);
   *(.TASK_TEST_CALIB)
   *(.MMcal)
    _Calibration_END = ABSOLUTE(. - 1);
    _Calibration_LIMIT = ABSOLUTE(.);
  } > RegionBlock_CALIB
  .EE_mirror_standby :
  {
    _EE_mirror_standby_START = ABSOLUTE(.);
    _EE_mirror_standby_END = ABSOLUTE(. - 1);
    _EE_mirror_standby_LIMIT = ABSOLUTE(.);
  } > RegionBlock_LMU2_SB
  _EE_mirror_standby_VAR_ALL_START = _EE_mirror_standby_START;
  _EE_mirror_standby_VAR_ALL_END = _EE_mirror_standby_END;
  _EE_mirror_standby_VAR_ALL_LIMIT = _EE_mirror_standby_LIMIT;
  .EmemCal : ALIGN(4)
  {
    _EmemCal_START = ABSOLUTE(.);
  *(.ETK_DataFreeze_Mailbox)
  *(.etk_tab_ram)
  *(.code_checkMemClassEMURam)
  *(.etk_coldstart_pattern)
  *(.cal_tool_pattern_add)
  KEEP(*(.etk_distab_memClass))
  KEEP(*(.etk_DAQChnl_memClass))
  KEEP(*(.ETK_DisTab17_EventList))
  KEEP(*(.ETK_DisTab17_EventConfigArea))
  KEEP(*(.ETK_DisTab17_EventOutputArea))
  KEEP(*(.ETK_DisTab17_ECUTriggerMap))
    . = ALIGN(4);
    _EmemCal_END = ABSOLUTE(. - 1);
    _EmemCal_LIMIT = ABSOLUTE(.);
  } > RegionBlock_EmemCal
  _EmemCal_VAR_ALL_START = _EmemCal_START;
  _EmemCal_VAR_ALL_END = _EmemCal_END;
  _EmemCal_VAR_ALL_LIMIT = _EmemCal_LIMIT;
  .No_Cache_Zone :
  {
    _No_Cache_Zone_START = ABSOLUTE(.);
      *(.no_cache_zone)
    _No_Cache_Zone_END = ABSOLUTE(. - 1);
    _No_Cache_Zone_LIMIT = ABSOLUTE(.);
  } > RegionBlock_LMU2
  _No_Cache_Zone_VAR_ALL_START = _No_Cache_Zone_START;
  _No_Cache_Zone_VAR_ALL_END = _No_Cache_Zone_END;
  _No_Cache_Zone_VAR_ALL_LIMIT = _No_Cache_Zone_LIMIT;
  .OS_DATA_CORE0_NOINIT : ALIGN(8)
  {
    _OS_DATA_CORE0_NOINIT_START = ABSOLUTE(.);
    *(*.OS_ASILApplication_OsCore0_VAR_FAST_NOCACHE_NOINIT)
    *(*.OS_ASILApplication_OsCore0_VAR_FAST_NOINIT)
    *(*.OS_ASILApplication_OsCore0_VAR_NOCACHE_NOINIT)
    *(*.OS_ASILApplication_OsCore0_VAR_NOINIT)
    *(*.OS_CORE0_VAR_FAST_NOCACHE_NOINIT)
    *(*.OS_CORE0_VAR_FAST_NOINIT)
    *(*.OS_CORE0_VAR_NOCACHE_NOINIT)
    *(*.OS_CORE0_VAR_NOINIT)
    *(*.OS_QMApplication_OsCore0_VAR_FAST_NOCACHE_NOINIT)
    *(*.OS_QMApplication_OsCore0_VAR_FAST_NOINIT)
    *(*.OS_QMApplication_OsCore0_VAR_NOCACHE_NOINIT)
    *(*.OS_QMApplication_OsCore0_VAR_NOINIT)
    *(*.OS_SystemApplication_OsCore0_VAR_FAST_NOCACHE_NOINIT)
    *(*.OS_SystemApplication_OsCore0_VAR_FAST_NOINIT)
    *(*.OS_SystemApplication_OsCore0_VAR_NOCACHE_NOINIT)
    *(*.OS_SystemApplication_OsCore0_VAR_NOINIT)
    . = ALIGN(8);
    _OS_DATA_CORE0_NOINIT_END = ABSOLUTE(. - 1);
    _OS_DATA_CORE0_NOINIT_LIMIT = ABSOLUTE(.);
  } > RegionBlock_DSPR0
  .OS_DATA_CORE0_INIT : ALIGN(8)
  {
    _OS_DATA_CORE0_INIT_START = ABSOLUTE(.);
    *(*.OS_ASILApplication_OsCore0_VAR)
    *(*.OS_ASILApplication_OsCore0_VAR_FAST)
    *(*.OS_ASILApplication_OsCore0_VAR_FAST_NOCACHE)
    *(*.OS_ASILApplication_OsCore0_VAR_NOCACHE)
    *(*.OS_CORE0_VAR)
    *(*.OS_CORE0_VAR_FAST)
    *(*.OS_CORE0_VAR_FAST_NOCACHE)
    *(*.OS_CORE0_VAR_NOCACHE)
    *(*.OS_QMApplication_OsCore0_VAR)
    *(*.OS_QMApplication_OsCore0_VAR_FAST)
    *(*.OS_QMApplication_OsCore0_VAR_FAST_NOCACHE)
    *(*.OS_QMApplication_OsCore0_VAR_NOCACHE)
    *(*.OS_SystemApplication_OsCore0_VAR)
    *(*.OS_SystemApplication_OsCore0_VAR_FAST)
    *(*.OS_SystemApplication_OsCore0_VAR_FAST_NOCACHE)
    *(*.OS_SystemApplication_OsCore0_VAR_NOCACHE)
    . = ALIGN(8);
    _OS_DATA_CORE0_INIT_END = ABSOLUTE(. - 1);
    _OS_DATA_CORE0_INIT_LIMIT = ABSOLUTE(.);
  } > RegionBlock_DSPR0 AT> RegionBlock_PFL1_C
  _OS_DATA_CORE0_INIT_ROM_START = LOADADDR(.OS_DATA_CORE0_INIT);
  _OS_DATA_CORE0_INIT_ROM_LIMIT = LOADADDR(.OS_DATA_CORE0_INIT) + SIZEOF(.OS_DATA_CORE0_INIT);
  .OS_DATA_CORE0_ZERO_INIT : ALIGN(8)
  {
    _OS_DATA_CORE0_ZERO_INIT_START = ABSOLUTE(.);
    *(*.OS_ASILApplication_OsCore0_VAR_FAST_NOCACHE_ZERO_INIT)
    *(*.OS_ASILApplication_OsCore0_VAR_FAST_ZERO_INIT)
    *(*.OS_ASILApplication_OsCore0_VAR_NOCACHE_ZERO_INIT)
    *(*.OS_ASILApplication_OsCore0_VAR_ZERO_INIT)
    *(*.OS_CORE0_VAR_FAST_NOCACHE_ZERO_INIT)
    *(*.OS_CORE0_VAR_FAST_ZERO_INIT)
    *(*.OS_CORE0_VAR_NOCACHE_ZERO_INIT)
    *(*.OS_CORE0_VAR_ZERO_INIT)
    *(*.OS_QMApplication_OsCore0_VAR_FAST_NOCACHE_ZERO_INIT)
    *(*.OS_QMApplication_OsCore0_VAR_FAST_ZERO_INIT)
    *(*.OS_QMApplication_OsCore0_VAR_NOCACHE_ZERO_INIT)
    *(*.OS_QMApplication_OsCore0_VAR_ZERO_INIT)
    *(*.OS_SystemApplication_OsCore0_VAR_FAST_NOCACHE_ZERO_INIT)
    *(*.OS_SystemApplication_OsCore0_VAR_FAST_ZERO_INIT)
    *(*.OS_SystemApplication_OsCore0_VAR_NOCACHE_ZERO_INIT)
    *(*.OS_SystemApplication_OsCore0_VAR_ZERO_INIT)
    . = ALIGN(8);
    _OS_DATA_CORE0_ZERO_INIT_END = ABSOLUTE(. - 1);
    _OS_DATA_CORE0_ZERO_INIT_LIMIT = ABSOLUTE(.);
  } > RegionBlock_DSPR0
  _OS_DATA_CORE0_VAR_ALL_START = _OS_DATA_CORE0_NOINIT_START;
  _OS_DATA_CORE0_VAR_ALL_END = _OS_DATA_CORE0_ZERO_INIT_END;
  _OS_DATA_CORE0_VAR_ALL_LIMIT = _OS_DATA_CORE0_ZERO_INIT_LIMIT;
  .OS_DATA_CORE1_NOINIT : ALIGN(8)
  {
    _OS_DATA_CORE1_NOINIT_START = ABSOLUTE(.);
    *(*.OS_CORE1_VAR_FAST_NOCACHE_NOINIT)
    *(*.OS_CORE1_VAR_FAST_NOINIT)
    *(*.OS_CORE1_VAR_NOCACHE_NOINIT)
    *(*.OS_CORE1_VAR_NOINIT)
    *(*.OS_SystemApplication_OsCore1_VAR_FAST_NOCACHE_NOINIT)
    *(*.OS_SystemApplication_OsCore1_VAR_FAST_NOINIT)
    *(*.OS_SystemApplication_OsCore1_VAR_NOCACHE_NOINIT)
    *(*.OS_SystemApplication_OsCore1_VAR_NOINIT)
    . = ALIGN(8);
    _OS_DATA_CORE1_NOINIT_END = ABSOLUTE(. - 1);
    _OS_DATA_CORE1_NOINIT_LIMIT = ABSOLUTE(.);
    . += 16;
  } > RegionBlock_DSPR1
  .OS_DATA_CORE1_INIT : ALIGN(8)
  {
    _OS_DATA_CORE1_INIT_START = ABSOLUTE(.);
    *(*.OS_CORE1_VAR)
    *(*.OS_CORE1_VAR_FAST)
    *(*.OS_CORE1_VAR_FAST_NOCACHE)
    *(*.OS_CORE1_VAR_NOCACHE)
    *(*.OS_SystemApplication_OsCore1_VAR)
    *(*.OS_SystemApplication_OsCore1_VAR_FAST)
    *(*.OS_SystemApplication_OsCore1_VAR_FAST_NOCACHE)
    *(*.OS_SystemApplication_OsCore1_VAR_NOCACHE)
    . = ALIGN(8);
    _OS_DATA_CORE1_INIT_END = ABSOLUTE(. - 1);
    _OS_DATA_CORE1_INIT_LIMIT = ABSOLUTE(.);
    . += 16;
  } > RegionBlock_DSPR1 AT> RegionBlock_PFL1_C
  _OS_DATA_CORE1_INIT_ROM_START = LOADADDR(.OS_DATA_CORE1_INIT);
  _OS_DATA_CORE1_INIT_ROM_LIMIT = LOADADDR(.OS_DATA_CORE1_INIT) + SIZEOF(.OS_DATA_CORE1_INIT) - 16;
  .OS_DATA_CORE1_ZERO_INIT : ALIGN(8)
  {
    _OS_DATA_CORE1_ZERO_INIT_START = ABSOLUTE(.);
    *(*.OS_CORE1_VAR_FAST_NOCACHE_ZERO_INIT)
    *(*.OS_CORE1_VAR_FAST_ZERO_INIT)
    *(*.OS_CORE1_VAR_NOCACHE_ZERO_INIT)
    *(*.OS_CORE1_VAR_ZERO_INIT)
    *(*.OS_SystemApplication_OsCore1_VAR_FAST_NOCACHE_ZERO_INIT)
    *(*.OS_SystemApplication_OsCore1_VAR_FAST_ZERO_INIT)
    *(*.OS_SystemApplication_OsCore1_VAR_NOCACHE_ZERO_INIT)
    *(*.OS_SystemApplication_OsCore1_VAR_ZERO_INIT)
    . = ALIGN(8);
    _OS_DATA_CORE1_ZERO_INIT_END = ABSOLUTE(. - 1);
    _OS_DATA_CORE1_ZERO_INIT_LIMIT = ABSOLUTE(.);
    . += 16;
  } > RegionBlock_DSPR1
  _OS_DATA_CORE1_VAR_ALL_START = _OS_DATA_CORE1_NOINIT_START;
  _OS_DATA_CORE1_VAR_ALL_END = _OS_DATA_CORE1_ZERO_INIT_END;
  _OS_DATA_CORE1_VAR_ALL_LIMIT = _OS_DATA_CORE1_ZERO_INIT_LIMIT;
  .OS_DATA_CORE2_NOINIT : ALIGN(8)
  {
    _OS_DATA_CORE2_NOINIT_START = ABSOLUTE(.);
    *(*.OS_CORE2_VAR_FAST_NOCACHE_NOINIT)
    *(*.OS_CORE2_VAR_FAST_NOINIT)
    *(*.OS_CORE2_VAR_NOCACHE_NOINIT)
    *(*.OS_CORE2_VAR_NOINIT)
    *(*.OS_SystemApplication_OsCore2_VAR_FAST_NOCACHE_NOINIT)
    *(*.OS_SystemApplication_OsCore2_VAR_FAST_NOINIT)
    *(*.OS_SystemApplication_OsCore2_VAR_NOCACHE_NOINIT)
    *(*.OS_SystemApplication_OsCore2_VAR_NOINIT)
    . = ALIGN(8);
    _OS_DATA_CORE2_NOINIT_END = ABSOLUTE(. - 1);
    _OS_DATA_CORE2_NOINIT_LIMIT = ABSOLUTE(.);
    . += 16;
  } > RegionBlock_DSPR2
  .OS_DATA_CORE2_INIT : ALIGN(8)
  {
    _OS_DATA_CORE2_INIT_START = ABSOLUTE(.);
    *(*.OS_CORE2_VAR)
    *(*.OS_CORE2_VAR_FAST)
    *(*.OS_CORE2_VAR_FAST_NOCACHE)
    *(*.OS_CORE2_VAR_NOCACHE)
    *(*.OS_SystemApplication_OsCore2_VAR)
    *(*.OS_SystemApplication_OsCore2_VAR_FAST)
    *(*.OS_SystemApplication_OsCore2_VAR_FAST_NOCACHE)
    *(*.OS_SystemApplication_OsCore2_VAR_NOCACHE)
    . = ALIGN(8);
    _OS_DATA_CORE2_INIT_END = ABSOLUTE(. - 1);
    _OS_DATA_CORE2_INIT_LIMIT = ABSOLUTE(.);
    . += 16;
  } > RegionBlock_DSPR2 AT> RegionBlock_PFL1_C
  _OS_DATA_CORE2_INIT_ROM_START = LOADADDR(.OS_DATA_CORE2_INIT);
  _OS_DATA_CORE2_INIT_ROM_LIMIT = LOADADDR(.OS_DATA_CORE2_INIT) + SIZEOF(.OS_DATA_CORE2_INIT) - 16;
  .OS_DATA_CORE2_ZERO_INIT : ALIGN(8)
  {
    _OS_DATA_CORE2_ZERO_INIT_START = ABSOLUTE(.);
    *(*.OS_CORE2_VAR_FAST_NOCACHE_ZERO_INIT)
    *(*.OS_CORE2_VAR_FAST_ZERO_INIT)
    *(*.OS_CORE2_VAR_NOCACHE_ZERO_INIT)
    *(*.OS_CORE2_VAR_ZERO_INIT)
    *(*.OS_SystemApplication_OsCore2_VAR_FAST_NOCACHE_ZERO_INIT)
    *(*.OS_SystemApplication_OsCore2_VAR_FAST_ZERO_INIT)
    *(*.OS_SystemApplication_OsCore2_VAR_NOCACHE_ZERO_INIT)
    *(*.OS_SystemApplication_OsCore2_VAR_ZERO_INIT)
    . = ALIGN(8);
    _OS_DATA_CORE2_ZERO_INIT_END = ABSOLUTE(. - 1);
    _OS_DATA_CORE2_ZERO_INIT_LIMIT = ABSOLUTE(.);
    . += 16;
  } > RegionBlock_DSPR2
  _OS_DATA_CORE2_VAR_ALL_START = _OS_DATA_CORE2_NOINIT_START;
  _OS_DATA_CORE2_VAR_ALL_END = _OS_DATA_CORE2_ZERO_INIT_END;
  _OS_DATA_CORE2_VAR_ALL_LIMIT = _OS_DATA_CORE2_ZERO_INIT_LIMIT;
  .OS_DATA_CORE3_NOINIT : ALIGN(8)
  {
    _OS_DATA_CORE3_NOINIT_START = ABSOLUTE(.);
    *(*.OS_CORE3_VAR_FAST_NOCACHE_NOINIT)
    *(*.OS_CORE3_VAR_FAST_NOINIT)
    *(*.OS_CORE3_VAR_NOCACHE_NOINIT)
    *(*.OS_CORE3_VAR_NOINIT)
    *(*.OS_SystemApplication_OsCore3_VAR_FAST_NOCACHE_NOINIT)
    *(*.OS_SystemApplication_OsCore3_VAR_FAST_NOINIT)
    *(*.OS_SystemApplication_OsCore3_VAR_NOCACHE_NOINIT)
    *(*.OS_SystemApplication_OsCore3_VAR_NOINIT)
    . = ALIGN(8);
    _OS_DATA_CORE3_NOINIT_END = ABSOLUTE(. - 1);
    _OS_DATA_CORE3_NOINIT_LIMIT = ABSOLUTE(.);
    . += 16;
  } > RegionBlock_DSPR3
  .OS_DATA_CORE3_INIT : ALIGN(8)
  {
    _OS_DATA_CORE3_INIT_START = ABSOLUTE(.);
    *(*.OS_CORE3_VAR)
    *(*.OS_CORE3_VAR_FAST)
    *(*.OS_CORE3_VAR_FAST_NOCACHE)
    *(*.OS_CORE3_VAR_NOCACHE)
    *(*.OS_SystemApplication_OsCore3_VAR)
    *(*.OS_SystemApplication_OsCore3_VAR_FAST)
    *(*.OS_SystemApplication_OsCore3_VAR_FAST_NOCACHE)
    *(*.OS_SystemApplication_OsCore3_VAR_NOCACHE)
    . = ALIGN(8);
    _OS_DATA_CORE3_INIT_END = ABSOLUTE(. - 1);
    _OS_DATA_CORE3_INIT_LIMIT = ABSOLUTE(.);
    . += 16;
  } > RegionBlock_DSPR3 AT> RegionBlock_PFL1_C
  _OS_DATA_CORE3_INIT_ROM_START = LOADADDR(.OS_DATA_CORE3_INIT);
  _OS_DATA_CORE3_INIT_ROM_LIMIT = LOADADDR(.OS_DATA_CORE3_INIT) + SIZEOF(.OS_DATA_CORE3_INIT) - 16;
  .OS_DATA_CORE3_ZERO_INIT : ALIGN(8)
  {
    _OS_DATA_CORE3_ZERO_INIT_START = ABSOLUTE(.);
    *(*.OS_CORE3_VAR_FAST_NOCACHE_ZERO_INIT)
    *(*.OS_CORE3_VAR_FAST_ZERO_INIT)
    *(*.OS_CORE3_VAR_NOCACHE_ZERO_INIT)
    *(*.OS_CORE3_VAR_ZERO_INIT)
    *(*.OS_SystemApplication_OsCore3_VAR_FAST_NOCACHE_ZERO_INIT)
    *(*.OS_SystemApplication_OsCore3_VAR_FAST_ZERO_INIT)
    *(*.OS_SystemApplication_OsCore3_VAR_NOCACHE_ZERO_INIT)
    *(*.OS_SystemApplication_OsCore3_VAR_ZERO_INIT)
    . = ALIGN(8);
    _OS_DATA_CORE3_ZERO_INIT_END = ABSOLUTE(. - 1);
    _OS_DATA_CORE3_ZERO_INIT_LIMIT = ABSOLUTE(.);
    . += 16;
  } > RegionBlock_DSPR3
  _OS_DATA_CORE3_VAR_ALL_START = _OS_DATA_CORE3_NOINIT_START;
  _OS_DATA_CORE3_VAR_ALL_END = _OS_DATA_CORE3_ZERO_INIT_END;
  _OS_DATA_CORE3_VAR_ALL_LIMIT = _OS_DATA_CORE3_ZERO_INIT_LIMIT;
  .OS_DATA_CORE4_NOINIT : ALIGN(8)
  {
    _OS_DATA_CORE4_NOINIT_START = ABSOLUTE(.);
    *(*.OS_CORE4_VAR_FAST_NOCACHE_NOINIT)
    *(*.OS_CORE4_VAR_FAST_NOINIT)
    *(*.OS_CORE4_VAR_NOCACHE_NOINIT)
    *(*.OS_CORE4_VAR_NOINIT)
    *(*.OS_QMApplication_OsCore4_VAR_FAST_NOCACHE_NOINIT)
    *(*.OS_QMApplication_OsCore4_VAR_FAST_NOINIT)
    *(*.OS_QMApplication_OsCore4_VAR_NOCACHE_NOINIT)
    *(*.OS_QMApplication_OsCore4_VAR_NOINIT)
    *(*.OS_SystemApplication_OsCore4_VAR_FAST_NOCACHE_NOINIT)
    *(*.OS_SystemApplication_OsCore4_VAR_FAST_NOINIT)
    *(*.OS_SystemApplication_OsCore4_VAR_NOCACHE_NOINIT)
    *(*.OS_SystemApplication_OsCore4_VAR_NOINIT)
    . = ALIGN(8);
    _OS_DATA_CORE4_NOINIT_END = ABSOLUTE(. - 1);
    _OS_DATA_CORE4_NOINIT_LIMIT = ABSOLUTE(.);
    . += 16;
  } > RegionBlock_DSPR4
  .OS_DATA_CORE4_INIT : ALIGN(8)
  {
    _OS_DATA_CORE4_INIT_START = ABSOLUTE(.);
    *(*.OS_CORE4_VAR)
    *(*.OS_CORE4_VAR_FAST)
    *(*.OS_CORE4_VAR_FAST_NOCACHE)
    *(*.OS_CORE4_VAR_NOCACHE)
    *(*.OS_QMApplication_OsCore4_VAR)
    *(*.OS_QMApplication_OsCore4_VAR_FAST)
    *(*.OS_QMApplication_OsCore4_VAR_FAST_NOCACHE)
    *(*.OS_QMApplication_OsCore4_VAR_NOCACHE)
    *(*.OS_SystemApplication_OsCore4_VAR)
    *(*.OS_SystemApplication_OsCore4_VAR_FAST)
    *(*.OS_SystemApplication_OsCore4_VAR_FAST_NOCACHE)
    *(*.OS_SystemApplication_OsCore4_VAR_NOCACHE)
    . = ALIGN(8);
    _OS_DATA_CORE4_INIT_END = ABSOLUTE(. - 1);
    _OS_DATA_CORE4_INIT_LIMIT = ABSOLUTE(.);
    . += 16;
  } > RegionBlock_DSPR4 AT> RegionBlock_PFL1_C
  _OS_DATA_CORE4_INIT_ROM_START = LOADADDR(.OS_DATA_CORE4_INIT);
  _OS_DATA_CORE4_INIT_ROM_LIMIT = LOADADDR(.OS_DATA_CORE4_INIT) + SIZEOF(.OS_DATA_CORE4_INIT) - 16;
  .OS_DATA_CORE4_ZERO_INIT : ALIGN(8)
  {
    _OS_DATA_CORE4_ZERO_INIT_START = ABSOLUTE(.);
    *(*.OS_CORE4_VAR_FAST_NOCACHE_ZERO_INIT)
    *(*.OS_CORE4_VAR_FAST_ZERO_INIT)
    *(*.OS_CORE4_VAR_NOCACHE_ZERO_INIT)
    *(*.OS_CORE4_VAR_ZERO_INIT)
    *(*.OS_QMApplication_OsCore4_VAR_FAST_NOCACHE_ZERO_INIT)
    *(*.OS_QMApplication_OsCore4_VAR_FAST_ZERO_INIT)
    *(*.OS_QMApplication_OsCore4_VAR_NOCACHE_ZERO_INIT)
    *(*.OS_QMApplication_OsCore4_VAR_ZERO_INIT)
    *(*.OS_SystemApplication_OsCore4_VAR_FAST_NOCACHE_ZERO_INIT)
    *(*.OS_SystemApplication_OsCore4_VAR_FAST_ZERO_INIT)
    *(*.OS_SystemApplication_OsCore4_VAR_NOCACHE_ZERO_INIT)
    *(*.OS_SystemApplication_OsCore4_VAR_ZERO_INIT)
    . = ALIGN(8);
    _OS_DATA_CORE4_ZERO_INIT_END = ABSOLUTE(. - 1);
    _OS_DATA_CORE4_ZERO_INIT_LIMIT = ABSOLUTE(.);
    . += 16;
  } > RegionBlock_DSPR4
  _OS_DATA_CORE4_VAR_ALL_START = _OS_DATA_CORE4_NOINIT_START;
  _OS_DATA_CORE4_VAR_ALL_END = _OS_DATA_CORE4_ZERO_INIT_END;
  _OS_DATA_CORE4_VAR_ALL_LIMIT = _OS_DATA_CORE4_ZERO_INIT_LIMIT;
  .OS_DATA_CORE5_NOINIT : ALIGN(8)
  {
    _OS_DATA_CORE5_NOINIT_START = ABSOLUTE(.);
    *(*.OS_CORE5_VAR_FAST_NOCACHE_NOINIT)
    *(*.OS_CORE5_VAR_FAST_NOINIT)
    *(*.OS_CORE5_VAR_NOCACHE_NOINIT)
    *(*.OS_CORE5_VAR_NOINIT)
    *(*.OS_CybApplication_OsCore5_VAR_FAST_NOCACHE_NOINIT)
    *(*.OS_CybApplication_OsCore5_VAR_FAST_NOINIT)
    *(*.OS_CybApplication_OsCore5_VAR_NOCACHE_NOINIT)
    *(*.OS_CybApplication_OsCore5_VAR_NOINIT)
    *(*.OS_SystemApplication_OsCore5_VAR_FAST_NOCACHE_NOINIT)
    *(*.OS_SystemApplication_OsCore5_VAR_FAST_NOINIT)
    *(*.OS_SystemApplication_OsCore5_VAR_NOCACHE_NOINIT)
    *(*.OS_SystemApplication_OsCore5_VAR_NOINIT)
    . = ALIGN(8);
    _OS_DATA_CORE5_NOINIT_END = ABSOLUTE(. - 1);
    _OS_DATA_CORE5_NOINIT_LIMIT = ABSOLUTE(.);
    . += 16;
  } > RegionBlock_DSPR5
  .OS_DATA_CORE5_INIT : ALIGN(8)
  {
    _OS_DATA_CORE5_INIT_START = ABSOLUTE(.);
    *(*.OS_CORE5_VAR)
    *(*.OS_CORE5_VAR_FAST)
    *(*.OS_CORE5_VAR_FAST_NOCACHE)
    *(*.OS_CORE5_VAR_NOCACHE)
    *(*.OS_CybApplication_OsCore5_VAR)
    *(*.OS_CybApplication_OsCore5_VAR_FAST)
    *(*.OS_CybApplication_OsCore5_VAR_FAST_NOCACHE)
    *(*.OS_CybApplication_OsCore5_VAR_NOCACHE)
    *(*.OS_SystemApplication_OsCore5_VAR)
    *(*.OS_SystemApplication_OsCore5_VAR_FAST)
    *(*.OS_SystemApplication_OsCore5_VAR_FAST_NOCACHE)
    *(*.OS_SystemApplication_OsCore5_VAR_NOCACHE)
    . = ALIGN(8);
    _OS_DATA_CORE5_INIT_END = ABSOLUTE(. - 1);
    _OS_DATA_CORE5_INIT_LIMIT = ABSOLUTE(.);
    . += 16;
  } > RegionBlock_DSPR5 AT> RegionBlock_PFL1_C
  _OS_DATA_CORE5_INIT_ROM_START = LOADADDR(.OS_DATA_CORE5_INIT);
  _OS_DATA_CORE5_INIT_ROM_LIMIT = LOADADDR(.OS_DATA_CORE5_INIT) + SIZEOF(.OS_DATA_CORE5_INIT) - 16;
  .OS_DATA_CORE5_ZERO_INIT : ALIGN(8)
  {
    _OS_DATA_CORE5_ZERO_INIT_START = ABSOLUTE(.);
    *(*.OS_CORE5_VAR_FAST_NOCACHE_ZERO_INIT)
    *(*.OS_CORE5_VAR_FAST_ZERO_INIT)
    *(*.OS_CORE5_VAR_NOCACHE_ZERO_INIT)
    *(*.OS_CORE5_VAR_ZERO_INIT)
    *(*.OS_CybApplication_OsCore5_VAR_FAST_NOCACHE_ZERO_INIT)
    *(*.OS_CybApplication_OsCore5_VAR_FAST_ZERO_INIT)
    *(*.OS_CybApplication_OsCore5_VAR_NOCACHE_ZERO_INIT)
    *(*.OS_CybApplication_OsCore5_VAR_ZERO_INIT)
    *(*.OS_SystemApplication_OsCore5_VAR_FAST_NOCACHE_ZERO_INIT)
    *(*.OS_SystemApplication_OsCore5_VAR_FAST_ZERO_INIT)
    *(*.OS_SystemApplication_OsCore5_VAR_NOCACHE_ZERO_INIT)
    *(*.OS_SystemApplication_OsCore5_VAR_ZERO_INIT)
    . = ALIGN(8);
    _OS_DATA_CORE5_ZERO_INIT_END = ABSOLUTE(. - 1);
    _OS_DATA_CORE5_ZERO_INIT_LIMIT = ABSOLUTE(.);
    . += 16;
  } > RegionBlock_DSPR5
  _OS_DATA_CORE5_VAR_ALL_START = _OS_DATA_CORE5_NOINIT_START;
  _OS_DATA_CORE5_VAR_ALL_END = _OS_DATA_CORE5_ZERO_INIT_END;
  _OS_DATA_CORE5_VAR_ALL_LIMIT = _OS_DATA_CORE5_ZERO_INIT_LIMIT;
  .OS_DATA_SHARED_NOINIT : ALIGN(8)
  {
    _OS_DATA_SHARED_NOINIT_START = ABSOLUTE(.);
    *(*.OS_BARRIER_CORE0_VAR_FAST_NOCACHE_NOINIT)
    *(*.OS_BARRIER_CORE0_VAR_FAST_NOINIT)
    *(*.OS_BARRIER_CORE0_VAR_NOCACHE_NOINIT)
    *(*.OS_BARRIER_CORE0_VAR_NOINIT)
    *(*.OS_BARRIER_CORE1_VAR_FAST_NOCACHE_NOINIT)
    *(*.OS_BARRIER_CORE1_VAR_FAST_NOINIT)
    *(*.OS_BARRIER_CORE1_VAR_NOCACHE_NOINIT)
    *(*.OS_BARRIER_CORE1_VAR_NOINIT)
    *(*.OS_BARRIER_CORE2_VAR_FAST_NOCACHE_NOINIT)
    *(*.OS_BARRIER_CORE2_VAR_FAST_NOINIT)
    *(*.OS_BARRIER_CORE2_VAR_NOCACHE_NOINIT)
    *(*.OS_BARRIER_CORE2_VAR_NOINIT)
    *(*.OS_BARRIER_CORE3_VAR_FAST_NOCACHE_NOINIT)
    *(*.OS_BARRIER_CORE3_VAR_FAST_NOINIT)
    *(*.OS_BARRIER_CORE3_VAR_NOCACHE_NOINIT)
    *(*.OS_BARRIER_CORE3_VAR_NOINIT)
    *(*.OS_BARRIER_CORE4_VAR_FAST_NOCACHE_NOINIT)
    *(*.OS_BARRIER_CORE4_VAR_FAST_NOINIT)
    *(*.OS_BARRIER_CORE4_VAR_NOCACHE_NOINIT)
    *(*.OS_BARRIER_CORE4_VAR_NOINIT)
    *(*.OS_BARRIER_CORE5_VAR_FAST_NOCACHE_NOINIT)
    *(*.OS_BARRIER_CORE5_VAR_FAST_NOINIT)
    *(*.OS_BARRIER_CORE5_VAR_NOCACHE_NOINIT)
    *(*.OS_BARRIER_CORE5_VAR_NOINIT)
    *(*.OS_CORESHARED_0X00000011_VAR_FAST_NOCACHE_NOINIT)
    *(*.OS_CORESHARED_0X00000011_VAR_FAST_NOINIT)
    *(*.OS_CORESHARED_0X00000011_VAR_NOCACHE_NOINIT)
    *(*.OS_CORESHARED_0X00000011_VAR_NOINIT)
    *(*.OS_CORESTATUS_CORE0_VAR_FAST_NOCACHE_NOINIT)
    *(*.OS_CORESTATUS_CORE0_VAR_FAST_NOINIT)
    *(*.OS_CORESTATUS_CORE0_VAR_NOCACHE_NOINIT)
    *(*.OS_CORESTATUS_CORE0_VAR_NOINIT)
    *(*.OS_CORESTATUS_CORE1_VAR_FAST_NOCACHE_NOINIT)
    *(*.OS_CORESTATUS_CORE1_VAR_FAST_NOINIT)
    *(*.OS_CORESTATUS_CORE1_VAR_NOCACHE_NOINIT)
    *(*.OS_CORESTATUS_CORE1_VAR_NOINIT)
    *(*.OS_CORESTATUS_CORE2_VAR_FAST_NOCACHE_NOINIT)
    *(*.OS_CORESTATUS_CORE2_VAR_FAST_NOINIT)
    *(*.OS_CORESTATUS_CORE2_VAR_NOCACHE_NOINIT)
    *(*.OS_CORESTATUS_CORE2_VAR_NOINIT)
    *(*.OS_CORESTATUS_CORE3_VAR_FAST_NOCACHE_NOINIT)
    *(*.OS_CORESTATUS_CORE3_VAR_FAST_NOINIT)
    *(*.OS_CORESTATUS_CORE3_VAR_NOCACHE_NOINIT)
    *(*.OS_CORESTATUS_CORE3_VAR_NOINIT)
    *(*.OS_CORESTATUS_CORE4_VAR_FAST_NOCACHE_NOINIT)
    *(*.OS_CORESTATUS_CORE4_VAR_FAST_NOINIT)
    *(*.OS_CORESTATUS_CORE4_VAR_NOCACHE_NOINIT)
    *(*.OS_CORESTATUS_CORE4_VAR_NOINIT)
    *(*.OS_CORESTATUS_CORE5_VAR_FAST_NOCACHE_NOINIT)
    *(*.OS_CORESTATUS_CORE5_VAR_FAST_NOINIT)
    *(*.OS_CORESTATUS_CORE5_VAR_NOCACHE_NOINIT)
    *(*.OS_CORESTATUS_CORE5_VAR_NOINIT)
    *(*.OS_GLOBALSHARED_VAR_FAST_NOCACHE_NOINIT)
    *(*.OS_GLOBALSHARED_VAR_FAST_NOINIT)
    *(*.OS_GLOBALSHARED_VAR_NOCACHE_NOINIT)
    *(*.OS_GLOBALSHARED_VAR_NOINIT)
    *(*.OS_PUBLIC_CORE0_VAR_FAST_NOCACHE_NOINIT)
    *(*.OS_PUBLIC_CORE0_VAR_FAST_NOINIT)
    *(*.OS_PUBLIC_CORE0_VAR_NOCACHE_NOINIT)
    *(*.OS_PUBLIC_CORE0_VAR_NOINIT)
    *(*.OS_PUBLIC_CORE1_VAR_FAST_NOCACHE_NOINIT)
    *(*.OS_PUBLIC_CORE1_VAR_FAST_NOINIT)
    *(*.OS_PUBLIC_CORE1_VAR_NOCACHE_NOINIT)
    *(*.OS_PUBLIC_CORE1_VAR_NOINIT)
    *(*.OS_PUBLIC_CORE2_VAR_FAST_NOCACHE_NOINIT)
    *(*.OS_PUBLIC_CORE2_VAR_FAST_NOINIT)
    *(*.OS_PUBLIC_CORE2_VAR_NOCACHE_NOINIT)
    *(*.OS_PUBLIC_CORE2_VAR_NOINIT)
    *(*.OS_PUBLIC_CORE3_VAR_FAST_NOCACHE_NOINIT)
    *(*.OS_PUBLIC_CORE3_VAR_FAST_NOINIT)
    *(*.OS_PUBLIC_CORE3_VAR_NOCACHE_NOINIT)
    *(*.OS_PUBLIC_CORE3_VAR_NOINIT)
    *(*.OS_PUBLIC_CORE4_VAR_FAST_NOCACHE_NOINIT)
    *(*.OS_PUBLIC_CORE4_VAR_FAST_NOINIT)
    *(*.OS_PUBLIC_CORE4_VAR_NOCACHE_NOINIT)
    *(*.OS_PUBLIC_CORE4_VAR_NOINIT)
    *(*.OS_PUBLIC_CORE5_VAR_FAST_NOCACHE_NOINIT)
    *(*.OS_PUBLIC_CORE5_VAR_FAST_NOINIT)
    *(*.OS_PUBLIC_CORE5_VAR_NOCACHE_NOINIT)
    *(*.OS_PUBLIC_CORE5_VAR_NOINIT)
    *(*.OS_VAR_FAST_NOCACHE_NOINIT)
    *(*.OS_VAR_FAST_NOINIT)
    *(*.OS_VAR_NOCACHE_NOINIT)
    *(*.OS_VAR_NOINIT)
    . = ALIGN(8);
    _OS_DATA_SHARED_NOINIT_END = ABSOLUTE(. - 1);
    _OS_DATA_SHARED_NOINIT_LIMIT = ABSOLUTE(.);
    . += 16;
  } > RegionBlock_DSPR0
  .OS_DATA_SHARED_INIT : ALIGN(8)
  {
    _OS_DATA_SHARED_INIT_START = ABSOLUTE(.);
    *(*.OS_BARRIER_CORE0_VAR)
    *(*.OS_BARRIER_CORE0_VAR_FAST)
    *(*.OS_BARRIER_CORE0_VAR_FAST_NOCACHE)
    *(*.OS_BARRIER_CORE0_VAR_NOCACHE)
    *(*.OS_BARRIER_CORE1_VAR)
    *(*.OS_BARRIER_CORE1_VAR_FAST)
    *(*.OS_BARRIER_CORE1_VAR_FAST_NOCACHE)
    *(*.OS_BARRIER_CORE1_VAR_NOCACHE)
    *(*.OS_BARRIER_CORE2_VAR)
    *(*.OS_BARRIER_CORE2_VAR_FAST)
    *(*.OS_BARRIER_CORE2_VAR_FAST_NOCACHE)
    *(*.OS_BARRIER_CORE2_VAR_NOCACHE)
    *(*.OS_BARRIER_CORE3_VAR)
    *(*.OS_BARRIER_CORE3_VAR_FAST)
    *(*.OS_BARRIER_CORE3_VAR_FAST_NOCACHE)
    *(*.OS_BARRIER_CORE3_VAR_NOCACHE)
    *(*.OS_BARRIER_CORE4_VAR)
    *(*.OS_BARRIER_CORE4_VAR_FAST)
    *(*.OS_BARRIER_CORE4_VAR_FAST_NOCACHE)
    *(*.OS_BARRIER_CORE4_VAR_NOCACHE)
    *(*.OS_BARRIER_CORE5_VAR)
    *(*.OS_BARRIER_CORE5_VAR_FAST)
    *(*.OS_BARRIER_CORE5_VAR_FAST_NOCACHE)
    *(*.OS_BARRIER_CORE5_VAR_NOCACHE)
    *(*.OS_CORESHARED_0X00000011_VAR)
    *(*.OS_CORESHARED_0X00000011_VAR_FAST)
    *(*.OS_CORESHARED_0X00000011_VAR_FAST_NOCACHE)
    *(*.OS_CORESHARED_0X00000011_VAR_NOCACHE)
    *(*.OS_CORESTATUS_CORE0_VAR)
    *(*.OS_CORESTATUS_CORE0_VAR_FAST)
    *(*.OS_CORESTATUS_CORE0_VAR_FAST_NOCACHE)
    *(*.OS_CORESTATUS_CORE0_VAR_NOCACHE)
    *(*.OS_CORESTATUS_CORE1_VAR)
    *(*.OS_CORESTATUS_CORE1_VAR_FAST)
    *(*.OS_CORESTATUS_CORE1_VAR_FAST_NOCACHE)
    *(*.OS_CORESTATUS_CORE1_VAR_NOCACHE)
    *(*.OS_CORESTATUS_CORE2_VAR)
    *(*.OS_CORESTATUS_CORE2_VAR_FAST)
    *(*.OS_CORESTATUS_CORE2_VAR_FAST_NOCACHE)
    *(*.OS_CORESTATUS_CORE2_VAR_NOCACHE)
    *(*.OS_CORESTATUS_CORE3_VAR)
    *(*.OS_CORESTATUS_CORE3_VAR_FAST)
    *(*.OS_CORESTATUS_CORE3_VAR_FAST_NOCACHE)
    *(*.OS_CORESTATUS_CORE3_VAR_NOCACHE)
    *(*.OS_CORESTATUS_CORE4_VAR)
    *(*.OS_CORESTATUS_CORE4_VAR_FAST)
    *(*.OS_CORESTATUS_CORE4_VAR_FAST_NOCACHE)
    *(*.OS_CORESTATUS_CORE4_VAR_NOCACHE)
    *(*.OS_CORESTATUS_CORE5_VAR)
    *(*.OS_CORESTATUS_CORE5_VAR_FAST)
    *(*.OS_CORESTATUS_CORE5_VAR_FAST_NOCACHE)
    *(*.OS_CORESTATUS_CORE5_VAR_NOCACHE)
    *(*.OS_GLOBALSHARED_VAR)
    *(*.OS_GLOBALSHARED_VAR_FAST)
    *(*.OS_GLOBALSHARED_VAR_FAST_NOCACHE)
    *(*.OS_GLOBALSHARED_VAR_NOCACHE)
    *(*.OS_PUBLIC_CORE0_VAR)
    *(*.OS_PUBLIC_CORE0_VAR_FAST)
    *(*.OS_PUBLIC_CORE0_VAR_FAST_NOCACHE)
    *(*.OS_PUBLIC_CORE0_VAR_NOCACHE)
    *(*.OS_PUBLIC_CORE1_VAR)
    *(*.OS_PUBLIC_CORE1_VAR_FAST)
    *(*.OS_PUBLIC_CORE1_VAR_FAST_NOCACHE)
    *(*.OS_PUBLIC_CORE1_VAR_NOCACHE)
    *(*.OS_PUBLIC_CORE2_VAR)
    *(*.OS_PUBLIC_CORE2_VAR_FAST)
    *(*.OS_PUBLIC_CORE2_VAR_FAST_NOCACHE)
    *(*.OS_PUBLIC_CORE2_VAR_NOCACHE)
    *(*.OS_PUBLIC_CORE3_VAR)
    *(*.OS_PUBLIC_CORE3_VAR_FAST)
    *(*.OS_PUBLIC_CORE3_VAR_FAST_NOCACHE)
    *(*.OS_PUBLIC_CORE3_VAR_NOCACHE)
    *(*.OS_PUBLIC_CORE4_VAR)
    *(*.OS_PUBLIC_CORE4_VAR_FAST)
    *(*.OS_PUBLIC_CORE4_VAR_FAST_NOCACHE)
    *(*.OS_PUBLIC_CORE4_VAR_NOCACHE)
    *(*.OS_PUBLIC_CORE5_VAR)
    *(*.OS_PUBLIC_CORE5_VAR_FAST)
    *(*.OS_PUBLIC_CORE5_VAR_FAST_NOCACHE)
    *(*.OS_PUBLIC_CORE5_VAR_NOCACHE)
    *(*.OS_VAR)
    *(*.OS_VAR_FAST)
    *(*.OS_VAR_FAST_NOCACHE)
    *(*.OS_VAR_NOCACHE)
    . = ALIGN(8);
    _OS_DATA_SHARED_INIT_END = ABSOLUTE(. - 1);
    _OS_DATA_SHARED_INIT_LIMIT = ABSOLUTE(.);
    . += 16;
  } > RegionBlock_DSPR0 AT> RegionBlock_PFL1_C
  _OS_DATA_SHARED_INIT_ROM_START = LOADADDR(.OS_DATA_SHARED_INIT);
  _OS_DATA_SHARED_INIT_ROM_LIMIT = LOADADDR(.OS_DATA_SHARED_INIT) + SIZEOF(.OS_DATA_SHARED_INIT) - 16;
  .OS_DATA_SHARED_ZERO_INIT : ALIGN(8)
  {
    _OS_DATA_SHARED_ZERO_INIT_START = ABSOLUTE(.);
    *(*.OS_BARRIER_CORE0_VAR_FAST_NOCACHE_ZERO_INIT)
    *(*.OS_BARRIER_CORE0_VAR_FAST_ZERO_INIT)
    *(*.OS_BARRIER_CORE0_VAR_NOCACHE_ZERO_INIT)
    *(*.OS_BARRIER_CORE0_VAR_ZERO_INIT)
    *(*.OS_BARRIER_CORE1_VAR_FAST_NOCACHE_ZERO_INIT)
    *(*.OS_BARRIER_CORE1_VAR_FAST_ZERO_INIT)
    *(*.OS_BARRIER_CORE1_VAR_NOCACHE_ZERO_INIT)
    *(*.OS_BARRIER_CORE1_VAR_ZERO_INIT)
    *(*.OS_BARRIER_CORE2_VAR_FAST_NOCACHE_ZERO_INIT)
    *(*.OS_BARRIER_CORE2_VAR_FAST_ZERO_INIT)
    *(*.OS_BARRIER_CORE2_VAR_NOCACHE_ZERO_INIT)
    *(*.OS_BARRIER_CORE2_VAR_ZERO_INIT)
    *(*.OS_BARRIER_CORE3_VAR_FAST_NOCACHE_ZERO_INIT)
    *(*.OS_BARRIER_CORE3_VAR_FAST_ZERO_INIT)
    *(*.OS_BARRIER_CORE3_VAR_NOCACHE_ZERO_INIT)
    *(*.OS_BARRIER_CORE3_VAR_ZERO_INIT)
    *(*.OS_BARRIER_CORE4_VAR_FAST_NOCACHE_ZERO_INIT)
    *(*.OS_BARRIER_CORE4_VAR_FAST_ZERO_INIT)
    *(*.OS_BARRIER_CORE4_VAR_NOCACHE_ZERO_INIT)
    *(*.OS_BARRIER_CORE4_VAR_ZERO_INIT)
    *(*.OS_BARRIER_CORE5_VAR_FAST_NOCACHE_ZERO_INIT)
    *(*.OS_BARRIER_CORE5_VAR_FAST_ZERO_INIT)
    *(*.OS_BARRIER_CORE5_VAR_NOCACHE_ZERO_INIT)
    *(*.OS_BARRIER_CORE5_VAR_ZERO_INIT)
    *(*.OS_CORESHARED_0X00000011_VAR_FAST_NOCACHE_ZERO_INIT)
    *(*.OS_CORESHARED_0X00000011_VAR_FAST_ZERO_INIT)
    *(*.OS_CORESHARED_0X00000011_VAR_NOCACHE_ZERO_INIT)
    *(*.OS_CORESHARED_0X00000011_VAR_ZERO_INIT)
    *(*.OS_CORESTATUS_CORE0_VAR_FAST_NOCACHE_ZERO_INIT)
    *(*.OS_CORESTATUS_CORE0_VAR_FAST_ZERO_INIT)
    *(*.OS_CORESTATUS_CORE0_VAR_NOCACHE_ZERO_INIT)
    *(*.OS_CORESTATUS_CORE0_VAR_ZERO_INIT)
    *(*.OS_CORESTATUS_CORE1_VAR_FAST_NOCACHE_ZERO_INIT)
    *(*.OS_CORESTATUS_CORE1_VAR_FAST_ZERO_INIT)
    *(*.OS_CORESTATUS_CORE1_VAR_NOCACHE_ZERO_INIT)
    *(*.OS_CORESTATUS_CORE1_VAR_ZERO_INIT)
    *(*.OS_CORESTATUS_CORE2_VAR_FAST_NOCACHE_ZERO_INIT)
    *(*.OS_CORESTATUS_CORE2_VAR_FAST_ZERO_INIT)
    *(*.OS_CORESTATUS_CORE2_VAR_NOCACHE_ZERO_INIT)
    *(*.OS_CORESTATUS_CORE2_VAR_ZERO_INIT)
    *(*.OS_CORESTATUS_CORE3_VAR_FAST_NOCACHE_ZERO_INIT)
    *(*.OS_CORESTATUS_CORE3_VAR_FAST_ZERO_INIT)
    *(*.OS_CORESTATUS_CORE3_VAR_NOCACHE_ZERO_INIT)
    *(*.OS_CORESTATUS_CORE3_VAR_ZERO_INIT)
    *(*.OS_CORESTATUS_CORE4_VAR_FAST_NOCACHE_ZERO_INIT)
    *(*.OS_CORESTATUS_CORE4_VAR_FAST_ZERO_INIT)
    *(*.OS_CORESTATUS_CORE4_VAR_NOCACHE_ZERO_INIT)
    *(*.OS_CORESTATUS_CORE4_VAR_ZERO_INIT)
    *(*.OS_CORESTATUS_CORE5_VAR_FAST_NOCACHE_ZERO_INIT)
    *(*.OS_CORESTATUS_CORE5_VAR_FAST_ZERO_INIT)
    *(*.OS_CORESTATUS_CORE5_VAR_NOCACHE_ZERO_INIT)
    *(*.OS_CORESTATUS_CORE5_VAR_ZERO_INIT)
    *(*.OS_GLOBALSHARED_VAR_FAST_NOCACHE_ZERO_INIT)
    *(*.OS_GLOBALSHARED_VAR_FAST_ZERO_INIT)
    *(*.OS_GLOBALSHARED_VAR_NOCACHE_ZERO_INIT)
    *(*.OS_GLOBALSHARED_VAR_ZERO_INIT)
    *(*.OS_PUBLIC_CORE0_VAR_FAST_NOCACHE_ZERO_INIT)
    *(*.OS_PUBLIC_CORE0_VAR_FAST_ZERO_INIT)
    *(*.OS_PUBLIC_CORE0_VAR_NOCACHE_ZERO_INIT)
    *(*.OS_PUBLIC_CORE0_VAR_ZERO_INIT)
    *(*.OS_PUBLIC_CORE1_VAR_FAST_NOCACHE_ZERO_INIT)
    *(*.OS_PUBLIC_CORE1_VAR_FAST_ZERO_INIT)
    *(*.OS_PUBLIC_CORE1_VAR_NOCACHE_ZERO_INIT)
    *(*.OS_PUBLIC_CORE1_VAR_ZERO_INIT)
    *(*.OS_PUBLIC_CORE2_VAR_FAST_NOCACHE_ZERO_INIT)
    *(*.OS_PUBLIC_CORE2_VAR_FAST_ZERO_INIT)
    *(*.OS_PUBLIC_CORE2_VAR_NOCACHE_ZERO_INIT)
    *(*.OS_PUBLIC_CORE2_VAR_ZERO_INIT)
    *(*.OS_PUBLIC_CORE3_VAR_FAST_NOCACHE_ZERO_INIT)
    *(*.OS_PUBLIC_CORE3_VAR_FAST_ZERO_INIT)
    *(*.OS_PUBLIC_CORE3_VAR_NOCACHE_ZERO_INIT)
    *(*.OS_PUBLIC_CORE3_VAR_ZERO_INIT)
    *(*.OS_PUBLIC_CORE4_VAR_FAST_NOCACHE_ZERO_INIT)
    *(*.OS_PUBLIC_CORE4_VAR_FAST_ZERO_INIT)
    *(*.OS_PUBLIC_CORE4_VAR_NOCACHE_ZERO_INIT)
    *(*.OS_PUBLIC_CORE4_VAR_ZERO_INIT)
    *(*.OS_PUBLIC_CORE5_VAR_FAST_NOCACHE_ZERO_INIT)
    *(*.OS_PUBLIC_CORE5_VAR_FAST_ZERO_INIT)
    *(*.OS_PUBLIC_CORE5_VAR_NOCACHE_ZERO_INIT)
    *(*.OS_PUBLIC_CORE5_VAR_ZERO_INIT)
    *(*.OS_VAR_FAST_NOCACHE_ZERO_INIT)
    *(*.OS_VAR_FAST_ZERO_INIT)
    *(*.OS_VAR_NOCACHE_ZERO_INIT)
    *(*.OS_VAR_ZERO_INIT)
    . = ALIGN(8);
    _OS_DATA_SHARED_ZERO_INIT_END = ABSOLUTE(. - 1);
    _OS_DATA_SHARED_ZERO_INIT_LIMIT = ABSOLUTE(.);
    . += 16;
  } > RegionBlock_DSPR0
  _OS_DATA_SHARED_VAR_ALL_START = _OS_DATA_SHARED_NOINIT_START;
  _OS_DATA_SHARED_VAR_ALL_END = _OS_DATA_SHARED_ZERO_INIT_END;
  _OS_DATA_SHARED_VAR_ALL_LIMIT = _OS_DATA_SHARED_ZERO_INIT_LIMIT;
  .OS_EXCVEC_CORE0_CODE : ALIGN(256)
  {
    _OS_EXCVEC_CORE0_CODE_START = ABSOLUTE(.);
    . = ALIGN(32);
    KEEP(*(*.OS_EXCVEC_CORE0_CODE))
    . = ALIGN(32);
    KEEP(*(*.OS_EXCVEC_CORE0_CODE_FAST))
    . = ALIGN(32);
    KEEP(*(*.OS_EXCVEC_CORE0_CODE_FAST_NOCACHE))
    . = ALIGN(32);
    KEEP(*(*.OS_EXCVEC_CORE0_CODE_NOCACHE))
    . = ALIGN(256);
    _OS_EXCVEC_CORE0_CODE_END = ABSOLUTE(. - 1);
    _OS_EXCVEC_CORE0_CODE_LIMIT = ABSOLUTE(.);
  } > RegionBlock_PFL0_C
  .OS_EXCVEC_CORE1_CODE : ALIGN(256)
  {
    _OS_EXCVEC_CORE1_CODE_START = ABSOLUTE(.);
    . = ALIGN(32);
    KEEP(*(*.OS_EXCVEC_CORE1_CODE))
    . = ALIGN(32);
    KEEP(*(*.OS_EXCVEC_CORE1_CODE_FAST))
    . = ALIGN(32);
    KEEP(*(*.OS_EXCVEC_CORE1_CODE_FAST_NOCACHE))
    . = ALIGN(32);
    KEEP(*(*.OS_EXCVEC_CORE1_CODE_NOCACHE))
    . = ALIGN(256);
    _OS_EXCVEC_CORE1_CODE_END = ABSOLUTE(. - 1);
    _OS_EXCVEC_CORE1_CODE_LIMIT = ABSOLUTE(.);
  } > RegionBlock_PFL0_C
  .OS_EXCVEC_CORE2_CODE : ALIGN(256)
  {
    _OS_EXCVEC_CORE2_CODE_START = ABSOLUTE(.);
    . = ALIGN(32);
    KEEP(*(*.OS_EXCVEC_CORE2_CODE))
    . = ALIGN(32);
    KEEP(*(*.OS_EXCVEC_CORE2_CODE_FAST))
    . = ALIGN(32);
    KEEP(*(*.OS_EXCVEC_CORE2_CODE_FAST_NOCACHE))
    . = ALIGN(32);
    KEEP(*(*.OS_EXCVEC_CORE2_CODE_NOCACHE))
    . = ALIGN(256);
    _OS_EXCVEC_CORE2_CODE_END = ABSOLUTE(. - 1);
    _OS_EXCVEC_CORE2_CODE_LIMIT = ABSOLUTE(.);
  } > RegionBlock_PFL0_C
  .OS_EXCVEC_CORE3_CODE : ALIGN(256)
  {
    _OS_EXCVEC_CORE3_CODE_START = ABSOLUTE(.);
    . = ALIGN(32);
    KEEP(*(*.OS_EXCVEC_CORE3_CODE))
    . = ALIGN(32);
    KEEP(*(*.OS_EXCVEC_CORE3_CODE_FAST))
    . = ALIGN(32);
    KEEP(*(*.OS_EXCVEC_CORE3_CODE_FAST_NOCACHE))
    . = ALIGN(32);
    KEEP(*(*.OS_EXCVEC_CORE3_CODE_NOCACHE))
    . = ALIGN(256);
    _OS_EXCVEC_CORE3_CODE_END = ABSOLUTE(. - 1);
    _OS_EXCVEC_CORE3_CODE_LIMIT = ABSOLUTE(.);
  } > RegionBlock_PFL0_C
  .OS_EXCVEC_CORE4_CODE : ALIGN(256)
  {
    _OS_EXCVEC_CORE4_CODE_START = ABSOLUTE(.);
    . = ALIGN(32);
    KEEP(*(*.OS_EXCVEC_CORE4_CODE))
    . = ALIGN(32);
    KEEP(*(*.OS_EXCVEC_CORE4_CODE_FAST))
    . = ALIGN(32);
    KEEP(*(*.OS_EXCVEC_CORE4_CODE_FAST_NOCACHE))
    . = ALIGN(32);
    KEEP(*(*.OS_EXCVEC_CORE4_CODE_NOCACHE))
    . = ALIGN(256);
    _OS_EXCVEC_CORE4_CODE_END = ABSOLUTE(. - 1);
    _OS_EXCVEC_CORE4_CODE_LIMIT = ABSOLUTE(.);
  } > RegionBlock_PFL0_C
  .OS_EXCVEC_CORE5_CODE : ALIGN(256)
  {
    _OS_EXCVEC_CORE5_CODE_START = ABSOLUTE(.);
    . = ALIGN(32);
    KEEP(*(*.OS_EXCVEC_CORE5_CODE))
    . = ALIGN(32);
    KEEP(*(*.OS_EXCVEC_CORE5_CODE_FAST))
    . = ALIGN(32);
    KEEP(*(*.OS_EXCVEC_CORE5_CODE_FAST_NOCACHE))
    . = ALIGN(32);
    KEEP(*(*.OS_EXCVEC_CORE5_CODE_NOCACHE))
    . = ALIGN(256);
    _OS_EXCVEC_CORE5_CODE_END = ABSOLUTE(. - 1);
    _OS_EXCVEC_CORE5_CODE_LIMIT = ABSOLUTE(.);
  } > RegionBlock_PFL0_C
  .OS_STACKS_CORE0_NOINIT : ALIGN(8)
  {
    _OS_STACKS_CORE0_NOINIT_START = ABSOLUTE(.);
    . = ALIGN(8);
    *(*.OS_STACK_BSW_QMCORE0_TASK_VAR_NOINIT)
    . = ALIGN(8);
    *(*.OS_STACK_CDD_QMCORE0_TASK_VAR_NOINIT)
    . = ALIGN(8);
    *(*.OS_STACK_OSCORE0_ERROR_VAR_NOINIT)
    . = ALIGN(8);
    *(*.OS_STACK_OSCORE0_INIT_VAR_NOINIT)
    . = ALIGN(8);
    *(*.OS_STACK_OSCORE0_ISR_CORE_VAR_NOINIT)
    . = ALIGN(8);
    *(*.OS_STACK_OSCORE0_KERNEL_VAR_NOINIT)
    . = ALIGN(8);
    *(*.OS_STACK_OSCORE0_PROTECTION_VAR_NOINIT)
    . = ALIGN(8);
    *(*.OS_STACK_OSCORE0_SHUTDOWN_VAR_NOINIT)
    . = ALIGN(8);
    *(*.OS_STACK_OSCORE0_STARTUP_VAR_NOINIT)
    . = ALIGN(8);
    *(*.OS_STACK_OSCORE0_TASK_PRIO21_VAR_NOINIT)
    . = ALIGN(8);
    *(*.OS_STACK_OSCORE0_TASK_PRIO22_VAR_NOINIT)
    . = ALIGN(8);
    *(*.OS_STACK_OSCORE0_TASK_PRIO23_VAR_NOINIT)
    . = ALIGN(8);
    *(*.OS_STACK_OSCORE0_TASK_PRIO24_VAR_NOINIT)
    . = ALIGN(8);
    *(*.OS_STACK_OSCORE0_TASK_PRIO25_VAR_NOINIT)
    . = ALIGN(8);
    *(*.OS_STACK_OSCORE0_TASK_PRIO40_VAR_NOINIT)
    . = ALIGN(8);
    *(*.OS_STACK_OSCORE0_TASK_PRIO4294967295_VAR_NOINIT)
    . = ALIGN(8);
    *(*.OS_STACK_OSCORE0_TASK_PRIO45_VAR_NOINIT)
    . = ALIGN(8);
    *(*.OS_STACK_OSCORE0_TASK_PRIO47_VAR_NOINIT)
    . = ALIGN(8);
    *(*.OS_STACK_OSCORE0_TASK_PRIO49_VAR_NOINIT)
    . = ALIGN(8);
    *(*.OS_STACK_OSCORE0_TASK_PRIO50_VAR_NOINIT)
    . = ALIGN(8);
    *(*.OS_STACK_RTE_MODE_SWITCH_QMCORE0_TASK_VAR_NOINIT)
    . = ALIGN(8);
    _OS_STACKS_CORE0_NOINIT_END = ABSOLUTE(. - 1);
    _OS_STACKS_CORE0_NOINIT_LIMIT = ABSOLUTE(.);
    . += 16;
  } > RegionBlock_DSPR0
  _OS_STACKS_CORE0_VAR_ALL_START = _OS_STACKS_CORE0_NOINIT_START;
  _OS_STACKS_CORE0_VAR_ALL_END = _OS_STACKS_CORE0_NOINIT_END;
  _OS_STACKS_CORE0_VAR_ALL_LIMIT = _OS_STACKS_CORE0_NOINIT_LIMIT;
  .OS_STACKS_CORE1_NOINIT : ALIGN(8)
  {
    _OS_STACKS_CORE1_NOINIT_START = ABSOLUTE(.);
    . = ALIGN(8);
    *(*.OS_STACK_OSCORE1_ERROR_VAR_NOINIT)
    . = ALIGN(8);
    *(*.OS_STACK_OSCORE1_INIT_VAR_NOINIT)
    . = ALIGN(8);
    *(*.OS_STACK_OSCORE1_ISR_CORE_VAR_NOINIT)
    . = ALIGN(8);
    *(*.OS_STACK_OSCORE1_KERNEL_VAR_NOINIT)
    . = ALIGN(8);
    *(*.OS_STACK_OSCORE1_PROTECTION_VAR_NOINIT)
    . = ALIGN(8);
    *(*.OS_STACK_OSCORE1_SHUTDOWN_VAR_NOINIT)
    . = ALIGN(8);
    *(*.OS_STACK_OSCORE1_STARTUP_VAR_NOINIT)
    . = ALIGN(8);
    *(*.OS_STACK_OSCORE1_TASK_PRIO4294967295_VAR_NOINIT)
    . = ALIGN(8);
    *(*.OS_STACK_OSCORE1_TASK_PRIO49_VAR_NOINIT)
    . = ALIGN(8);
    *(*.OS_STACK_OSCORE1_TASK_PRIO50_VAR_NOINIT)
    . = ALIGN(8);
    _OS_STACKS_CORE1_NOINIT_END = ABSOLUTE(. - 1);
    _OS_STACKS_CORE1_NOINIT_LIMIT = ABSOLUTE(.);
    . += 16;
  } > RegionBlock_DSPR1
  _OS_STACKS_CORE1_VAR_ALL_START = _OS_STACKS_CORE1_NOINIT_START;
  _OS_STACKS_CORE1_VAR_ALL_END = _OS_STACKS_CORE1_NOINIT_END;
  _OS_STACKS_CORE1_VAR_ALL_LIMIT = _OS_STACKS_CORE1_NOINIT_LIMIT;
  .OS_STACKS_CORE2_NOINIT : ALIGN(8)
  {
    _OS_STACKS_CORE2_NOINIT_START = ABSOLUTE(.);
    . = ALIGN(8);
    *(*.OS_STACK_OSCORE2_ERROR_VAR_NOINIT)
    . = ALIGN(8);
    *(*.OS_STACK_OSCORE2_INIT_VAR_NOINIT)
    . = ALIGN(8);
    *(*.OS_STACK_OSCORE2_ISR_CORE_VAR_NOINIT)
    . = ALIGN(8);
    *(*.OS_STACK_OSCORE2_KERNEL_VAR_NOINIT)
    . = ALIGN(8);
    *(*.OS_STACK_OSCORE2_PROTECTION_VAR_NOINIT)
    . = ALIGN(8);
    *(*.OS_STACK_OSCORE2_SHUTDOWN_VAR_NOINIT)
    . = ALIGN(8);
    *(*.OS_STACK_OSCORE2_STARTUP_VAR_NOINIT)
    . = ALIGN(8);
    *(*.OS_STACK_OSCORE2_TASK_PRIO4294967295_VAR_NOINIT)
    . = ALIGN(8);
    *(*.OS_STACK_OSCORE2_TASK_PRIO49_VAR_NOINIT)
    . = ALIGN(8);
    *(*.OS_STACK_OSCORE2_TASK_PRIO50_VAR_NOINIT)
    . = ALIGN(8);
    _OS_STACKS_CORE2_NOINIT_END = ABSOLUTE(. - 1);
    _OS_STACKS_CORE2_NOINIT_LIMIT = ABSOLUTE(.);
    . += 16;
  } > RegionBlock_DSPR2
  _OS_STACKS_CORE2_VAR_ALL_START = _OS_STACKS_CORE2_NOINIT_START;
  _OS_STACKS_CORE2_VAR_ALL_END = _OS_STACKS_CORE2_NOINIT_END;
  _OS_STACKS_CORE2_VAR_ALL_LIMIT = _OS_STACKS_CORE2_NOINIT_LIMIT;
  .OS_STACKS_CORE3_NOINIT : ALIGN(8)
  {
    _OS_STACKS_CORE3_NOINIT_START = ABSOLUTE(.);
    . = ALIGN(8);
    *(*.OS_STACK_OSCORE3_ERROR_VAR_NOINIT)
    . = ALIGN(8);
    *(*.OS_STACK_OSCORE3_INIT_VAR_NOINIT)
    . = ALIGN(8);
    *(*.OS_STACK_OSCORE3_ISR_CORE_VAR_NOINIT)
    . = ALIGN(8);
    *(*.OS_STACK_OSCORE3_KERNEL_VAR_NOINIT)
    . = ALIGN(8);
    *(*.OS_STACK_OSCORE3_PROTECTION_VAR_NOINIT)
    . = ALIGN(8);
    *(*.OS_STACK_OSCORE3_SHUTDOWN_VAR_NOINIT)
    . = ALIGN(8);
    *(*.OS_STACK_OSCORE3_STARTUP_VAR_NOINIT)
    . = ALIGN(8);
    *(*.OS_STACK_OSCORE3_TASK_PRIO4294967295_VAR_NOINIT)
    . = ALIGN(8);
    *(*.OS_STACK_OSCORE3_TASK_PRIO49_VAR_NOINIT)
    . = ALIGN(8);
    *(*.OS_STACK_OSCORE3_TASK_PRIO50_VAR_NOINIT)
    . = ALIGN(8);
    _OS_STACKS_CORE3_NOINIT_END = ABSOLUTE(. - 1);
    _OS_STACKS_CORE3_NOINIT_LIMIT = ABSOLUTE(.);
    . += 16;
  } > RegionBlock_DSPR3
  _OS_STACKS_CORE3_VAR_ALL_START = _OS_STACKS_CORE3_NOINIT_START;
  _OS_STACKS_CORE3_VAR_ALL_END = _OS_STACKS_CORE3_NOINIT_END;
  _OS_STACKS_CORE3_VAR_ALL_LIMIT = _OS_STACKS_CORE3_NOINIT_LIMIT;
  .OS_STACKS_CORE4_NOINIT : ALIGN(8)
  {
    _OS_STACKS_CORE4_NOINIT_START = ABSOLUTE(.);
    . = ALIGN(8);
    *(*.OS_STACK_OSCORE4_ERROR_VAR_NOINIT)
    . = ALIGN(8);
    *(*.OS_STACK_OSCORE4_INIT_VAR_NOINIT)
    . = ALIGN(8);
    *(*.OS_STACK_OSCORE4_ISR_CORE_VAR_NOINIT)
    . = ALIGN(8);
    *(*.OS_STACK_OSCORE4_KERNEL_VAR_NOINIT)
    . = ALIGN(8);
    *(*.OS_STACK_OSCORE4_PROTECTION_VAR_NOINIT)
    . = ALIGN(8);
    *(*.OS_STACK_OSCORE4_SHUTDOWN_VAR_NOINIT)
    . = ALIGN(8);
    *(*.OS_STACK_OSCORE4_STARTUP_VAR_NOINIT)
    . = ALIGN(8);
    *(*.OS_STACK_OSCORE4_TASK_PRIO22_VAR_NOINIT)
    . = ALIGN(8);
    *(*.OS_STACK_OSCORE4_TASK_PRIO23_VAR_NOINIT)
    . = ALIGN(8);
    *(*.OS_STACK_OSCORE4_TASK_PRIO24_VAR_NOINIT)
    . = ALIGN(8);
    *(*.OS_STACK_OSCORE4_TASK_PRIO4294967295_VAR_NOINIT)
    . = ALIGN(8);
    *(*.OS_STACK_OSCORE4_TASK_PRIO45_VAR_NOINIT)
    . = ALIGN(8);
    *(*.OS_STACK_OSCORE4_TASK_PRIO47_VAR_NOINIT)
    . = ALIGN(8);
    *(*.OS_STACK_OSCORE4_TASK_PRIO49_VAR_NOINIT)
    . = ALIGN(8);
    *(*.OS_STACK_OSCORE4_TASK_PRIO50_VAR_NOINIT)
    . = ALIGN(8);
    *(*.OS_STACK_RTE_MODE_SWITCH_QMCORE4_TASK_VAR_NOINIT)
    . = ALIGN(8);
    _OS_STACKS_CORE4_NOINIT_END = ABSOLUTE(. - 1);
    _OS_STACKS_CORE4_NOINIT_LIMIT = ABSOLUTE(.);
    . += 16;
  } > RegionBlock_DSPR4
  _OS_STACKS_CORE4_VAR_ALL_START = _OS_STACKS_CORE4_NOINIT_START;
  _OS_STACKS_CORE4_VAR_ALL_END = _OS_STACKS_CORE4_NOINIT_END;
  _OS_STACKS_CORE4_VAR_ALL_LIMIT = _OS_STACKS_CORE4_NOINIT_LIMIT;
  .OS_STACKS_CORE5_NOINIT : ALIGN(8)
  {
    _OS_STACKS_CORE5_NOINIT_START = ABSOLUTE(.);
    . = ALIGN(8);
    *(*.OS_STACK_CDD_CYBCORE0_TASK_VAR_NOINIT)
    . = ALIGN(8);
    *(*.OS_STACK_OSCORE5_ERROR_VAR_NOINIT)
    . = ALIGN(8);
    *(*.OS_STACK_OSCORE5_INIT_VAR_NOINIT)
    . = ALIGN(8);
    *(*.OS_STACK_OSCORE5_ISR_CORE_VAR_NOINIT)
    . = ALIGN(8);
    *(*.OS_STACK_OSCORE5_KERNEL_VAR_NOINIT)
    . = ALIGN(8);
    *(*.OS_STACK_OSCORE5_PROTECTION_VAR_NOINIT)
    . = ALIGN(8);
    *(*.OS_STACK_OSCORE5_SHUTDOWN_VAR_NOINIT)
    . = ALIGN(8);
    *(*.OS_STACK_OSCORE5_STARTUP_VAR_NOINIT)
    . = ALIGN(8);
    *(*.OS_STACK_OSCORE5_TASK_PRIO4294967295_VAR_NOINIT)
    . = ALIGN(8);
    *(*.OS_STACK_OSCORE5_TASK_PRIO49_VAR_NOINIT)
    . = ALIGN(8);
    *(*.OS_STACK_OSCORE5_TASK_PRIO50_VAR_NOINIT)
    . = ALIGN(8);
    _OS_STACKS_CORE5_NOINIT_END = ABSOLUTE(. - 1);
    _OS_STACKS_CORE5_NOINIT_LIMIT = ABSOLUTE(.);
    . += 16;
  } > RegionBlock_DSPR5
  _OS_STACKS_CORE5_VAR_ALL_START = _OS_STACKS_CORE5_NOINIT_START;
  _OS_STACKS_CORE5_VAR_ALL_END = _OS_STACKS_CORE5_NOINIT_END;
  _OS_STACKS_CORE5_VAR_ALL_LIMIT = _OS_STACKS_CORE5_NOINIT_LIMIT;
  .Startup_Code : ALIGN(4)
  {
    _Startup_Code_START = ABSOLUTE(.);
    KEEP(*(*APPLVECT))
. = . + 0x18;
KEEP(*(*.swecuid_check))
. = ALIGN(8);
   KEEP(*(*.brsResetLabel))
_RESET = brsStartupEntry;
   _start = brsStartupEntry;
   _start_tc0 = brsStartupEntry;
   _start_tc1 = brsStartupEntry;
   _start_tc2 = brsStartupEntry;
   _start_tc3 = brsStartupEntry;
   _start_tc4 = brsStartupEntry;
   _start_tc5 = brsStartupEntry;
   _brsStartupEntry = brsStartupEntry;
    . = ALIGN(4);
    _Startup_Code_END = ABSOLUTE(. - 1);
    _Startup_Code_LIMIT = ABSOLUTE(.);
  } > RegionBlock_STARTUP
  .Startup_Stack0 : ALIGN(4)
  {
    _Startup_Stack0_START = ABSOLUTE(.);
    __section_stack_c0_start = ABSOLUTE(.);
. = . + 0x400;
__STARTUPSTACK_CORE0 = .;
__section_stack_c0_end = ABSOLUTE(.);
    . = ALIGN(4);
    _Startup_Stack0_END = ABSOLUTE(. - 1);
    _Startup_Stack0_LIMIT = ABSOLUTE(.);
  } > RegionBlock_DSPR0
  _Startup_Stack0_VAR_ALL_START = _Startup_Stack0_START;
  _Startup_Stack0_VAR_ALL_END = _Startup_Stack0_END;
  _Startup_Stack0_VAR_ALL_LIMIT = _Startup_Stack0_LIMIT;
  .Startup_Stack1 : ALIGN(4)
  {
    _Startup_Stack1_START = ABSOLUTE(.);
    __section_stack_c1_start = ABSOLUTE(.);
. = . + 0x400;
__STARTUPSTACK_CORE1 = .;
__section_stack_c1_end = ABSOLUTE(.);
    . = ALIGN(4);
    _Startup_Stack1_END = ABSOLUTE(. - 1);
    _Startup_Stack1_LIMIT = ABSOLUTE(.);
  } > RegionBlock_DSPR1
  _Startup_Stack1_VAR_ALL_START = _Startup_Stack1_START;
  _Startup_Stack1_VAR_ALL_END = _Startup_Stack1_END;
  _Startup_Stack1_VAR_ALL_LIMIT = _Startup_Stack1_LIMIT;
  .Startup_Stack2 : ALIGN(4)
  {
    _Startup_Stack2_START = ABSOLUTE(.);
    __section_stack_c2_start = ABSOLUTE(.);
. = . + 0x400;
__STARTUPSTACK_CORE2 = .;
__section_stack_c2_end = ABSOLUTE(.);
    . = ALIGN(4);
    _Startup_Stack2_END = ABSOLUTE(. - 1);
    _Startup_Stack2_LIMIT = ABSOLUTE(.);
  } > RegionBlock_DSPR2
  _Startup_Stack2_VAR_ALL_START = _Startup_Stack2_START;
  _Startup_Stack2_VAR_ALL_END = _Startup_Stack2_END;
  _Startup_Stack2_VAR_ALL_LIMIT = _Startup_Stack2_LIMIT;
  .Startup_Stack3 : ALIGN(4)
  {
    _Startup_Stack3_START = ABSOLUTE(.);
    __section_stack_c3_start = ABSOLUTE(.);
. = . + 0x400;
__STARTUPSTACK_CORE3 = .;
__section_stack_c3_end = ABSOLUTE(.);
    . = ALIGN(4);
    _Startup_Stack3_END = ABSOLUTE(. - 1);
    _Startup_Stack3_LIMIT = ABSOLUTE(.);
  } > RegionBlock_DSPR3
  _Startup_Stack3_VAR_ALL_START = _Startup_Stack3_START;
  _Startup_Stack3_VAR_ALL_END = _Startup_Stack3_END;
  _Startup_Stack3_VAR_ALL_LIMIT = _Startup_Stack3_LIMIT;
  .Startup_Stack4 : ALIGN(4)
  {
    _Startup_Stack4_START = ABSOLUTE(.);
    __section_stack_c4_start = ABSOLUTE(.);
. = . + 0x400;
__STARTUPSTACK_CORE4 = .;
__section_stack_c4_end = ABSOLUTE(.);
    . = ALIGN(4);
    _Startup_Stack4_END = ABSOLUTE(. - 1);
    _Startup_Stack4_LIMIT = ABSOLUTE(.);
  } > RegionBlock_DSPR4
  _Startup_Stack4_VAR_ALL_START = _Startup_Stack4_START;
  _Startup_Stack4_VAR_ALL_END = _Startup_Stack4_END;
  _Startup_Stack4_VAR_ALL_LIMIT = _Startup_Stack4_LIMIT;
  .Startup_Stack5 : ALIGN(4)
  {
    _Startup_Stack5_START = ABSOLUTE(.);
    __section_stack_c5_start = ABSOLUTE(.);
. = . + 0x400;
__STARTUPSTACK_CORE5 = .;
__section_stack_c5_end = ABSOLUTE(.);
    . = ALIGN(4);
    _Startup_Stack5_END = ABSOLUTE(. - 1);
    _Startup_Stack5_LIMIT = ABSOLUTE(.);
  } > RegionBlock_DSPR5
  _Startup_Stack5_VAR_ALL_START = _Startup_Stack5_START;
  _Startup_Stack5_VAR_ALL_END = _Startup_Stack5_END;
  _Startup_Stack5_VAR_ALL_LIMIT = _Startup_Stack5_LIMIT;
  .etk_ram_pattern :
  {
    _etk_ram_pattern_START = ABSOLUTE(.);
          *(.code_checkMemClassRam)
      *(.end_etk_tab_ram)
      *(.start_etk_tab_ram)
    _etk_ram_pattern_END = ABSOLUTE(. - 1);
    _etk_ram_pattern_LIMIT = ABSOLUTE(.);
  } > RegionBlock_ETKMG
  _etk_ram_pattern_VAR_ALL_START = _etk_ram_pattern_START;
  _etk_ram_pattern_VAR_ALL_END = _etk_ram_pattern_END;
  _etk_ram_pattern_VAR_ALL_LIMIT = _etk_ram_pattern_LIMIT;
  .standby :
  {
    _standby_START = ABSOLUTE(.);
        *(standby)
    *(.shared_Var_noinit)
    *(.preservedstartinfo)
    _standby_END = ABSOLUTE(. - 1);
    _standby_LIMIT = ABSOLUTE(.);
  } > RegionBlock_LMU2_SB
  _standby_VAR_ALL_START = _standby_START;
  _standby_VAR_ALL_END = _standby_END;
  _standby_VAR_ALL_LIMIT = _standby_LIMIT;
  .EE_mirror :
  {
    _EE_mirror_START = ABSOLUTE(.);
    *(.EEMIRROR)
    _EE_mirror_END = ABSOLUTE(. - 1);
    _EE_mirror_LIMIT = ABSOLUTE(.);
  } > RegionBlock_LMU2
  _EE_mirror_VAR_ALL_START = _EE_mirror_START;
  _EE_mirror_VAR_ALL_END = _EE_mirror_END;
  _EE_mirror_VAR_ALL_LIMIT = _EE_mirror_LIMIT;
  .OS_INTVEC_CODE : ALIGN(8192)
  {
    _OS_INTVEC_CODE_START = ABSOLUTE(.);
    . = ALIGN(32);
    *(*.OS_INTVEC_CODE)
    . = ALIGN(8192);
    _OS_INTVEC_CODE_END = ABSOLUTE(. - 1);
    _OS_INTVEC_CODE_LIMIT = ABSOLUTE(.);
  } > RegionBlock_PFL0_C
  .OS_INTVEC_CORE0_CODE : ALIGN(8192)
  {
    _OS_INTVEC_CORE0_CODE_START = ABSOLUTE(.);
    . = ALIGN(32);
    KEEP(*(*.OS_INTVEC_CORE0_CODE))
    . = ALIGN(32);
    KEEP(*(*.OS_INTVEC_CORE0_CODE_FAST))
    . = ALIGN(32);
    KEEP(*(*.OS_INTVEC_CORE0_CODE_FAST_NOCACHE))
    . = ALIGN(32);
    KEEP(*(*.OS_INTVEC_CORE0_CODE_NOCACHE))
    . = ALIGN(8192);
    _OS_INTVEC_CORE0_CODE_END = ABSOLUTE(. - 1);
    _OS_INTVEC_CORE0_CODE_LIMIT = ABSOLUTE(.);
  } > RegionBlock_PFL0_C
  .OS_INTVEC_CORE1_CODE : ALIGN(8192)
  {
    _OS_INTVEC_CORE1_CODE_START = ABSOLUTE(.);
    . = ALIGN(32);
    KEEP(*(*.OS_INTVEC_CORE1_CODE))
    . = ALIGN(32);
    KEEP(*(*.OS_INTVEC_CORE1_CODE_FAST))
    . = ALIGN(32);
    KEEP(*(*.OS_INTVEC_CORE1_CODE_FAST_NOCACHE))
    . = ALIGN(32);
    KEEP(*(*.OS_INTVEC_CORE1_CODE_NOCACHE))
    . = ALIGN(8192);
    _OS_INTVEC_CORE1_CODE_END = ABSOLUTE(. - 1);
    _OS_INTVEC_CORE1_CODE_LIMIT = ABSOLUTE(.);
  } > RegionBlock_PFL0_C
  .OS_INTVEC_CORE2_CODE : ALIGN(8192)
  {
    _OS_INTVEC_CORE2_CODE_START = ABSOLUTE(.);
    . = ALIGN(32);
    KEEP(*(*.OS_INTVEC_CORE2_CODE))
    . = ALIGN(32);
    KEEP(*(*.OS_INTVEC_CORE2_CODE_FAST))
    . = ALIGN(32);
    KEEP(*(*.OS_INTVEC_CORE2_CODE_FAST_NOCACHE))
    . = ALIGN(32);
    KEEP(*(*.OS_INTVEC_CORE2_CODE_NOCACHE))
    . = ALIGN(8192);
    _OS_INTVEC_CORE2_CODE_END = ABSOLUTE(. - 1);
    _OS_INTVEC_CORE2_CODE_LIMIT = ABSOLUTE(.);
  } > RegionBlock_PFL0_C
  .OS_INTVEC_CORE3_CODE : ALIGN(8192)
  {
    _OS_INTVEC_CORE3_CODE_START = ABSOLUTE(.);
    . = ALIGN(32);
    KEEP(*(*.OS_INTVEC_CORE3_CODE))
    . = ALIGN(32);
    KEEP(*(*.OS_INTVEC_CORE3_CODE_FAST))
    . = ALIGN(32);
    KEEP(*(*.OS_INTVEC_CORE3_CODE_FAST_NOCACHE))
    . = ALIGN(32);
    KEEP(*(*.OS_INTVEC_CORE3_CODE_NOCACHE))
    . = ALIGN(8192);
    _OS_INTVEC_CORE3_CODE_END = ABSOLUTE(. - 1);
    _OS_INTVEC_CORE3_CODE_LIMIT = ABSOLUTE(.);
  } > RegionBlock_PFL0_C
  .OS_INTVEC_CORE4_CODE : ALIGN(8192)
  {
    _OS_INTVEC_CORE4_CODE_START = ABSOLUTE(.);
    . = ALIGN(32);
    KEEP(*(*.OS_INTVEC_CORE4_CODE))
    . = ALIGN(32);
    KEEP(*(*.OS_INTVEC_CORE4_CODE_FAST))
    . = ALIGN(32);
    KEEP(*(*.OS_INTVEC_CORE4_CODE_FAST_NOCACHE))
    . = ALIGN(32);
    KEEP(*(*.OS_INTVEC_CORE4_CODE_NOCACHE))
    . = ALIGN(8192);
    _OS_INTVEC_CORE4_CODE_END = ABSOLUTE(. - 1);
    _OS_INTVEC_CORE4_CODE_LIMIT = ABSOLUTE(.);
  } > RegionBlock_PFL0_C
  .OS_INTVEC_CORE5_CODE : ALIGN(8192)
  {
    _OS_INTVEC_CORE5_CODE_START = ABSOLUTE(.);
    . = ALIGN(32);
    KEEP(*(*.OS_INTVEC_CORE5_CODE))
    . = ALIGN(32);
    KEEP(*(*.OS_INTVEC_CORE5_CODE_FAST))
    . = ALIGN(32);
    KEEP(*(*.OS_INTVEC_CORE5_CODE_FAST_NOCACHE))
    . = ALIGN(32);
    KEEP(*(*.OS_INTVEC_CORE5_CODE_NOCACHE))
    . = ALIGN(8192);
    _OS_INTVEC_CORE5_CODE_END = ABSOLUTE(. - 1);
    _OS_INTVEC_CORE5_CODE_LIMIT = ABSOLUTE(.);
  } > RegionBlock_PFL0_C
  .OS_EXCVEC_CORE0_CONST :
  {
    _OS_EXCVEC_CORE0_CONST_START = ABSOLUTE(.);
    . = ALIGN(32);
    KEEP(*(*.OS_EXCVEC_CORE0_CONST))
    . = ALIGN(32);
    KEEP(*(*.OS_EXCVEC_CORE0_CONST_FAST))
    . = ALIGN(32);
    KEEP(*(*.OS_EXCVEC_CORE0_CONST_FAST_NOCACHE))
    . = ALIGN(32);
    KEEP(*(*.OS_EXCVEC_CORE0_CONST_NOCACHE))
    _OS_EXCVEC_CORE0_CONST_END = ABSOLUTE(. - 1);
    _OS_EXCVEC_CORE0_CONST_LIMIT = ABSOLUTE(.);
  } > RegionBlock_PFL0_C
  .OS_EXCVEC_CORE1_CONST :
  {
    _OS_EXCVEC_CORE1_CONST_START = ABSOLUTE(.);
    . = ALIGN(32);
    KEEP(*(*.OS_EXCVEC_CORE1_CONST))
    . = ALIGN(32);
    KEEP(*(*.OS_EXCVEC_CORE1_CONST_FAST))
    . = ALIGN(32);
    KEEP(*(*.OS_EXCVEC_CORE1_CONST_FAST_NOCACHE))
    . = ALIGN(32);
    KEEP(*(*.OS_EXCVEC_CORE1_CONST_NOCACHE))
    _OS_EXCVEC_CORE1_CONST_END = ABSOLUTE(. - 1);
    _OS_EXCVEC_CORE1_CONST_LIMIT = ABSOLUTE(.);
  } > RegionBlock_PFL0_C
  .OS_EXCVEC_CORE2_CONST :
  {
    _OS_EXCVEC_CORE2_CONST_START = ABSOLUTE(.);
    . = ALIGN(32);
    KEEP(*(*.OS_EXCVEC_CORE2_CONST))
    . = ALIGN(32);
    KEEP(*(*.OS_EXCVEC_CORE2_CONST_FAST))
    . = ALIGN(32);
    KEEP(*(*.OS_EXCVEC_CORE2_CONST_FAST_NOCACHE))
    . = ALIGN(32);
    KEEP(*(*.OS_EXCVEC_CORE2_CONST_NOCACHE))
    _OS_EXCVEC_CORE2_CONST_END = ABSOLUTE(. - 1);
    _OS_EXCVEC_CORE2_CONST_LIMIT = ABSOLUTE(.);
  } > RegionBlock_PFL0_C
  .OS_EXCVEC_CORE3_CONST :
  {
    _OS_EXCVEC_CORE3_CONST_START = ABSOLUTE(.);
    . = ALIGN(32);
    KEEP(*(*.OS_EXCVEC_CORE3_CONST))
    . = ALIGN(32);
    KEEP(*(*.OS_EXCVEC_CORE3_CONST_FAST))
    . = ALIGN(32);
    KEEP(*(*.OS_EXCVEC_CORE3_CONST_FAST_NOCACHE))
    . = ALIGN(32);
    KEEP(*(*.OS_EXCVEC_CORE3_CONST_NOCACHE))
    _OS_EXCVEC_CORE3_CONST_END = ABSOLUTE(. - 1);
    _OS_EXCVEC_CORE3_CONST_LIMIT = ABSOLUTE(.);
  } > RegionBlock_PFL0_C
  .OS_EXCVEC_CORE4_CONST :
  {
    _OS_EXCVEC_CORE4_CONST_START = ABSOLUTE(.);
    . = ALIGN(32);
    KEEP(*(*.OS_EXCVEC_CORE4_CONST))
    . = ALIGN(32);
    KEEP(*(*.OS_EXCVEC_CORE4_CONST_FAST))
    . = ALIGN(32);
    KEEP(*(*.OS_EXCVEC_CORE4_CONST_FAST_NOCACHE))
    . = ALIGN(32);
    KEEP(*(*.OS_EXCVEC_CORE4_CONST_NOCACHE))
    _OS_EXCVEC_CORE4_CONST_END = ABSOLUTE(. - 1);
    _OS_EXCVEC_CORE4_CONST_LIMIT = ABSOLUTE(.);
  } > RegionBlock_PFL0_C
  .OS_EXCVEC_CORE5_CONST :
  {
    _OS_EXCVEC_CORE5_CONST_START = ABSOLUTE(.);
    . = ALIGN(32);
    KEEP(*(*.OS_EXCVEC_CORE5_CONST))
    . = ALIGN(32);
    KEEP(*(*.OS_EXCVEC_CORE5_CONST_FAST))
    . = ALIGN(32);
    KEEP(*(*.OS_EXCVEC_CORE5_CONST_FAST_NOCACHE))
    . = ALIGN(32);
    KEEP(*(*.OS_EXCVEC_CORE5_CONST_NOCACHE))
    _OS_EXCVEC_CORE5_CONST_END = ABSOLUTE(. - 1);
    _OS_EXCVEC_CORE5_CONST_LIMIT = ABSOLUTE(.);
  } > RegionBlock_PFL0_C
  .OS_INTVEC_CONST :
  {
    _OS_INTVEC_CONST_START = ABSOLUTE(.);
    KEEP(*(*.OS_INTVEC_CONST))
    KEEP(*(*.OS_INTVEC_CONST_FAST))
    KEEP(*(*.OS_INTVEC_CONST_FAST_NOCACHE))
    KEEP(*(*.OS_INTVEC_CONST_NOCACHE))
    _OS_INTVEC_CONST_END = ABSOLUTE(. - 1);
    _OS_INTVEC_CONST_LIMIT = ABSOLUTE(.);
  } > RegionBlock_PFL0_C
  .OS_INTVEC_CORE0_CONST :
  {
    _OS_INTVEC_CORE0_CONST_START = ABSOLUTE(.);
    . = ALIGN(32);
    KEEP(*(*.OS_INTVEC_CORE0_CONST))
    . = ALIGN(32);
    KEEP(*(*.OS_INTVEC_CORE0_CONST_FAST))
    . = ALIGN(32);
    KEEP(*(*.OS_INTVEC_CORE0_CONST_FAST_NOCACHE))
    . = ALIGN(32);
    KEEP(*(*.OS_INTVEC_CORE0_CONST_NOCACHE))
    _OS_INTVEC_CORE0_CONST_END = ABSOLUTE(. - 1);
    _OS_INTVEC_CORE0_CONST_LIMIT = ABSOLUTE(.);
  } > RegionBlock_PFL0_C
  .OS_INTVEC_CORE1_CONST :
  {
    _OS_INTVEC_CORE1_CONST_START = ABSOLUTE(.);
    . = ALIGN(32);
    KEEP(*(*.OS_INTVEC_CORE1_CONST))
    . = ALIGN(32);
    KEEP(*(*.OS_INTVEC_CORE1_CONST_FAST))
    . = ALIGN(32);
    KEEP(*(*.OS_INTVEC_CORE1_CONST_FAST_NOCACHE))
    . = ALIGN(32);
    KEEP(*(*.OS_INTVEC_CORE1_CONST_NOCACHE))
    _OS_INTVEC_CORE1_CONST_END = ABSOLUTE(. - 1);
    _OS_INTVEC_CORE1_CONST_LIMIT = ABSOLUTE(.);
  } > RegionBlock_PFL0_C
  .OS_INTVEC_CORE2_CONST :
  {
    _OS_INTVEC_CORE2_CONST_START = ABSOLUTE(.);
    . = ALIGN(32);
    KEEP(*(*.OS_INTVEC_CORE2_CONST))
    . = ALIGN(32);
    KEEP(*(*.OS_INTVEC_CORE2_CONST_FAST))
    . = ALIGN(32);
    KEEP(*(*.OS_INTVEC_CORE2_CONST_FAST_NOCACHE))
    . = ALIGN(32);
    KEEP(*(*.OS_INTVEC_CORE2_CONST_NOCACHE))
    _OS_INTVEC_CORE2_CONST_END = ABSOLUTE(. - 1);
    _OS_INTVEC_CORE2_CONST_LIMIT = ABSOLUTE(.);
  } > RegionBlock_PFL0_C
  .OS_INTVEC_CORE3_CONST :
  {
    _OS_INTVEC_CORE3_CONST_START = ABSOLUTE(.);
    . = ALIGN(32);
    KEEP(*(*.OS_INTVEC_CORE3_CONST))
    . = ALIGN(32);
    KEEP(*(*.OS_INTVEC_CORE3_CONST_FAST))
    . = ALIGN(32);
    KEEP(*(*.OS_INTVEC_CORE3_CONST_FAST_NOCACHE))
    . = ALIGN(32);
    KEEP(*(*.OS_INTVEC_CORE3_CONST_NOCACHE))
    _OS_INTVEC_CORE3_CONST_END = ABSOLUTE(. - 1);
    _OS_INTVEC_CORE3_CONST_LIMIT = ABSOLUTE(.);
  } > RegionBlock_PFL0_C
  .OS_INTVEC_CORE4_CONST :
  {
    _OS_INTVEC_CORE4_CONST_START = ABSOLUTE(.);
    . = ALIGN(32);
    KEEP(*(*.OS_INTVEC_CORE4_CONST))
    . = ALIGN(32);
    KEEP(*(*.OS_INTVEC_CORE4_CONST_FAST))
    . = ALIGN(32);
    KEEP(*(*.OS_INTVEC_CORE4_CONST_FAST_NOCACHE))
    . = ALIGN(32);
    KEEP(*(*.OS_INTVEC_CORE4_CONST_NOCACHE))
    _OS_INTVEC_CORE4_CONST_END = ABSOLUTE(. - 1);
    _OS_INTVEC_CORE4_CONST_LIMIT = ABSOLUTE(.);
  } > RegionBlock_PFL0_C
  .OS_INTVEC_CORE5_CONST :
  {
    _OS_INTVEC_CORE5_CONST_START = ABSOLUTE(.);
    . = ALIGN(32);
    KEEP(*(*.OS_INTVEC_CORE5_CONST))
    . = ALIGN(32);
    KEEP(*(*.OS_INTVEC_CORE5_CONST_FAST))
    . = ALIGN(32);
    KEEP(*(*.OS_INTVEC_CORE5_CONST_FAST_NOCACHE))
    . = ALIGN(32);
    KEEP(*(*.OS_INTVEC_CORE5_CONST_NOCACHE))
    _OS_INTVEC_CORE5_CONST_END = ABSOLUTE(. - 1);
    _OS_INTVEC_CORE5_CONST_LIMIT = ABSOLUTE(.);
  } > RegionBlock_PFL0_C
  .OS_CODE : ALIGN(8)
  {
    _OS_CODE_START = ABSOLUTE(.);
    *(*.OS_CODE)
    *(*.OS_OS_COREINITHOOK_CODE)
    . = ALIGN(8);
    _OS_CODE_END = ABSOLUTE(. - 1);
    _OS_CODE_LIMIT = ABSOLUTE(.);
  } > RegionBlock_PFL0_C
  .OS_CONST : ALIGN(8)
  {
    _OS_CONST_START = ABSOLUTE(.);
    *(*.OS_ASILApplication_OsCore0_CONST)
    *(*.OS_ASILApplication_OsCore0_CONST_FAST)
    *(*.OS_CONST)
    *(*.OS_CONST_FAST)
    *(*.OS_CORE0_CONST)
    *(*.OS_CORE0_CONST_FAST)
    *(*.OS_CORE1_CONST)
    *(*.OS_CORE1_CONST_FAST)
    *(*.OS_CORE2_CONST)
    *(*.OS_CORE2_CONST_FAST)
    *(*.OS_CORE3_CONST)
    *(*.OS_CORE3_CONST_FAST)
    *(*.OS_CORE4_CONST)
    *(*.OS_CORE4_CONST_FAST)
    *(*.OS_CORE5_CONST)
    *(*.OS_CORE5_CONST_FAST)
    *(*.OS_CybApplication_OsCore5_CONST)
    *(*.OS_CybApplication_OsCore5_CONST_FAST)
    *(*.OS_GLOBALSHARED_CONST)
    *(*.OS_GLOBALSHARED_CONST_FAST)
    *(*.OS_QMApplication_OsCore0_CONST)
    *(*.OS_QMApplication_OsCore0_CONST_FAST)
    *(*.OS_QMApplication_OsCore4_CONST)
    *(*.OS_QMApplication_OsCore4_CONST_FAST)
    *(*.OS_SystemApplication_OsCore0_CONST)
    *(*.OS_SystemApplication_OsCore0_CONST_FAST)
    *(*.OS_SystemApplication_OsCore1_CONST)
    *(*.OS_SystemApplication_OsCore1_CONST_FAST)
    *(*.OS_SystemApplication_OsCore2_CONST)
    *(*.OS_SystemApplication_OsCore2_CONST_FAST)
    *(*.OS_SystemApplication_OsCore3_CONST)
    *(*.OS_SystemApplication_OsCore3_CONST_FAST)
    *(*.OS_SystemApplication_OsCore4_CONST)
    *(*.OS_SystemApplication_OsCore4_CONST_FAST)
    *(*.OS_SystemApplication_OsCore5_CONST)
    *(*.OS_SystemApplication_OsCore5_CONST_FAST)
    . = ALIGN(8);
    _OS_CONST_END = ABSOLUTE(. - 1);
    _OS_CONST_LIMIT = ABSOLUTE(.);
    . += 16;
  } > RegionBlock_PFL0_C
  .Code_PFL0 : ALIGN(1)
  {
    _Code_PFL0_START = ABSOLUTE(.);
    */BrsHwStartup.o(.text*)
*/Os_Hal_Entry_Lcfg.o(.text*)
*/bsw.a:*(.text*)
*/mcal.a:*(.text*)
*/wrp.a:*(.text*)
*/gendata.a:*(.text*)
*/dd.a:*(.text*)
*/develop.a:*(.text*)
*/cddtest.a:*(.text*)
*/hal.a:*(.text*)
*/kernel.a:*(.text*)
*/fi.a:*(.text*)
    . = ALIGN(1);
    _Code_PFL0_END = ABSOLUTE(. - 1);
    _Code_PFL0_LIMIT = ABSOLUTE(.);
  } > RegionBlock_PFL0_C
  .Const_PFL0 :
  {
    _Const_PFL0_START = ABSOLUTE(.);
    */BrsHwStartup.o(.rodata*)
*/Os_Hal_Entry_Lcfg.o(.rodata*)
*/bsw.a:*(.rodata*)
*/mcal.a:*(.rodata*)
*/wrp.a:*(.rodata*)
*/gendata.a:*(.rodata*)
*/dd.a:*(.rodata*)
*/develop.a:*(.rodata*)
*/cddtest.a:*(.rodata*)
*/hal.a:*(.rodata*)
*/kernel.a:*(.rodata*)
*/fi.a:*(.rodata*)
    _Const_PFL0_END = ABSOLUTE(. - 1);
    _Const_PFL0_LIMIT = ABSOLUTE(.);
  } > RegionBlock_PFL0_C
  .Bss_Default_Core1 :
  {
    _Bss_Default_Core1_START = ABSOLUTE(.);
         */f4_arm.a:*(.bss*)
     */f5_arm.a:*(.bss*)
     */f7_arm.a:*(.bss*)
     */f8_arm.a:*(.bss*)
    _Bss_Default_Core1_END = ABSOLUTE(. - 1);
    _Bss_Default_Core1_LIMIT = ABSOLUTE(.);
  } > RegionBlock_DSPR1
  _Bss_Default_Core1_VAR_ALL_START = _Bss_Default_Core1_START;
  _Bss_Default_Core1_VAR_ALL_END = _Bss_Default_Core1_END;
  _Bss_Default_Core1_VAR_ALL_LIMIT = _Bss_Default_Core1_LIMIT;
  .Bss_Default_Core4 :
  {
    _Bss_Default_Core4_START = ABSOLUTE(.);
    */AirSpringML.a:*(.bss*)
    _Bss_Default_Core4_END = ABSOLUTE(. - 1);
    _Bss_Default_Core4_LIMIT = ABSOLUTE(.);
  } > RegionBlock_DSPR4
  _Bss_Default_Core4_VAR_ALL_START = _Bss_Default_Core4_START;
  _Bss_Default_Core4_VAR_ALL_END = _Bss_Default_Core4_END;
  _Bss_Default_Core4_VAR_ALL_LIMIT = _Bss_Default_Core4_LIMIT;
  .Bss_Default_Core5 :
  {
    _Bss_Default_Core5_START = ABSOLUTE(.);
     */f14.a:*(.bss*)
    _Bss_Default_Core5_END = ABSOLUTE(. - 1);
    _Bss_Default_Core5_LIMIT = ABSOLUTE(.);
  } > RegionBlock_DSPR5
  _Bss_Default_Core5_VAR_ALL_START = _Bss_Default_Core5_START;
  _Bss_Default_Core5_VAR_ALL_END = _Bss_Default_Core5_END;
  _Bss_Default_Core5_VAR_ALL_LIMIT = _Bss_Default_Core5_LIMIT;
  .Data_Default_Core4 :
  {
    _Data_Default_Core4_START = ABSOLUTE(.);
    _Data_Default_Core4_END = ABSOLUTE(. - 1);
    _Data_Default_Core4_LIMIT = ABSOLUTE(.);
  } > RegionBlock_DSPR4 AT> RegionBlock_PFL1_C
  _Data_Default_Core4_ROM_START = LOADADDR(.Data_Default_Core4);
  _Data_Default_Core4_ROM_LIMIT = LOADADDR(.Data_Default_Core4) + SIZEOF(.Data_Default_Core4);
  _Data_Default_Core4_VAR_ALL_START = _Data_Default_Core4_START;
  _Data_Default_Core4_VAR_ALL_END = _Data_Default_Core4_END;
  _Data_Default_Core4_VAR_ALL_LIMIT = _Data_Default_Core4_LIMIT;
  .Data_Default_Core5 :
  {
    _Data_Default_Core5_START = ABSOLUTE(.);
*/f14.a:*(.data*)
    _Data_Default_Core5_END = ABSOLUTE(. - 1);
    _Data_Default_Core5_LIMIT = ABSOLUTE(.);
  } > RegionBlock_DSPR5 AT> RegionBlock_PFL1_C
  _Data_Default_Core5_ROM_START = LOADADDR(.Data_Default_Core5);
  _Data_Default_Core5_ROM_LIMIT = LOADADDR(.Data_Default_Core5) + SIZEOF(.Data_Default_Core5);
  _Data_Default_Core5_VAR_ALL_START = _Data_Default_Core5_START;
  _Data_Default_Core5_VAR_ALL_END = _Data_Default_Core5_END;
  _Data_Default_Core5_VAR_ALL_LIMIT = _Data_Default_Core5_LIMIT;
  .Bss_Default :
  {
    _Bss_Default_START = ABSOLUTE(.);
    *(.XcpVarAlign32)
    *(.bss)
    *(.bss.*)
    *(COMMON)
   . = ALIGN(5);
    *(.sbss)
    *(.sbss.*)
   . = ALIGN(6);
    *(.zbss)
    *(.zbss.*)
    _Bss_Default_END = ABSOLUTE(. - 1);
    _Bss_Default_LIMIT = ABSOLUTE(.);
  } > RegionBlock_DSPR0
  _Bss_Default_VAR_ALL_START = _Bss_Default_START;
  _Bss_Default_VAR_ALL_END = _Bss_Default_END;
  _Bss_Default_VAR_ALL_LIMIT = _Bss_Default_LIMIT;
  .Data_Default :
  {
    _Data_Default_START = ABSOLUTE(.);
    *(.data)
    *(.data.*)
    *(.sdata)
    *(.sdata.*)
    *(.zdata)
    *(.zdata.*)
    _Data_Default_END = ABSOLUTE(. - 1);
    _Data_Default_LIMIT = ABSOLUTE(.);
  } > RegionBlock_DSPR0 AT> RegionBlock_PFL1_C
  _Data_Default_ROM_START = LOADADDR(.Data_Default);
  _Data_Default_ROM_LIMIT = LOADADDR(.Data_Default) + SIZEOF(.Data_Default);
  _Data_Default_VAR_ALL_START = _Data_Default_START;
  _Data_Default_VAR_ALL_END = _Data_Default_END;
  _Data_Default_VAR_ALL_LIMIT = _Data_Default_LIMIT;
  .Code_Default : ALIGN(1)
  {
    _Code_Default_START = ABSOLUTE(.);
       *(.text)
   *(.text.*)
*(.gnu.linkonce.t.*)
*(.cramtext)
*(.cramtext.*)
    *(*.OS_ERRORHOOK_CODE)
    . = ALIGN(1);
    _Code_Default_END = ABSOLUTE(. - 1);
    _Code_Default_LIMIT = ABSOLUTE(.);
  } > RegionBlock_PFL1_C
  .Const_Default :
  {
    _Const_Default_START = ABSOLUTE(.);
        *(.rodata)
    *(.rodata.*)
    *(.srodata)
    *(.srodata.*)
    *(.zrodata)
    *(.zrodata.*)
    _Const_Default_END = ABSOLUTE(. - 1);
    _Const_Default_LIMIT = ABSOLUTE(.);
  } > RegionBlock_PFL1_C
MM_ECU_CAL_PAGE_SIZE = 0x100000;
MM_EMEM_CAL_STRUCT_START = ORIGIN(RegionBlock_EmemCal);
ETK_WRK_PAGE_BASE_ADDRESS = 0xB9200000;
HE_LO_CAL = 0x80C00000;
HE_END_CAL = 0x80CA8000;
__REF_PAGE_BASE_ADDRESS =0x80C00000;
}

AUTOSAR XML (schema 00049)
package /ActiveEcuC
  module config vSet: implementation-config-variant=VARIANT-PRE-COMPILE, module-description=vSet_Impl
    vSetCalibration
    vSetGeneral: vSetDummyStatementKind=None
    vSetPlatform:
      vSetByteOrder = LITTLE_ENDIAN
      vSetSizeOfRAMPointer = Size32Bit
      vSetSizeOfEnum = Size32Bit
      vSetSizeOfROMPointer = Size32Bit
      vSetCPUType = CPU32Bit
      vSetBitOrder = LSB_to_MSB
      vSetSizeOfInt = Size32Bit

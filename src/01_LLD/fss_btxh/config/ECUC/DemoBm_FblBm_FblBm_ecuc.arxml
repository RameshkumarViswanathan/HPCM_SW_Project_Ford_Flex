AUTOSAR XML (schema 00049)
package /ActiveEcuC
  module config FblBm: implementation-config-variant=VARIANT-PRE-COMPILE, module-description=FblBm_Impl
    FblBmGeneral:
      FblBmExecutionInstance = BootManager
      FblBmStandaloneMode = true
      FblBmIncludeOemConfiguration = true
      FblBmIncludeHardwareConfiguration = false
      FblBmHeaderAddress = 2147876832
      FblBmSecureBoot = false
      FblBmFailsafeUpdater = true
      FblBmInitializeKeys = false
      FblBmInitializeMacOfBootloader = false
    FblBmBootOrder
      FblBmBootTarget_Appl (FblBmBootTarget): FblBmBootOrderId=1, FblBmBootTargetRef=Appl
      FblBmBootTarget_Upd (FblBmBootTarget): FblBmBootOrderId=0, FblBmBootTargetRef=FblUpdater

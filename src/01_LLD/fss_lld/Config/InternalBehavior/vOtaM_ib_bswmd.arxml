AUTOSAR XML (schema 4-0-3)
package /MICROSAR/vOtaM_Fbl_ib_bswmd/BswModuleDescriptions
  bsw module description vOtaM
    bsw internal behavior vOtaMBehavior

AUTOSAR XML (schema 00049)
package /ActiveEcuC
  module config Smh: implementation-config-variant=VARIANT-LINK-TIME, module-description=Smh_Impl
    SmhGeneral:
      SmhWatchdogCycleCount = 32
      SmhProvidevSecPrimRandomFunction = true
      SmhOperationMode = PRODUCTION
      SmhCryptographicKeysLocatedInRAM = false
      SmhSaveRestoreContext = false
    SmhSeedKey: SmhKeyTimeout=100, SmhCallCycle=10
      SmhKeyConfig:
        SmhKeyConstant = 4294967295
        SmhKeyLength = 256
        SmhKeyType = BYTE_ARRAY
        SmhExternalComparison = false
        SmhSecretKeyLength = 0
        SmhExtendedApi = false
        SmhAsymmetric = false
      SmhSeedConfig: SmhSeedLength=256, SmhSeedType=BYTE_ARRAY
        SmhSeedGeneration
          SmhLcg: SmhMultiplier=2147001325, SmhIncrement=715136305
    SmhCryptographicKeys: SmhElementIdRSAPublicExponent=161, SmhElementIdRSAModulus=160, SmhElementIdRSAPrivateExponent=162
      3 x SmhKey:
        AesKey: SmhDescription=Decryption key for security class AAA, SmhKeyValueRef=AesKeyValue, SmhKeyValueRef=AesIvValue
        ClassCCC_Rsa2048Key: SmhDescription=Public key for RSA (2048 Bits), SmhKeyValueRef=RsaKey2048ExpValue, SmhKeyValueRef=RsaKey2048ModValue
        ClassCCC_Rsa3072Key: SmhDescription=Public key for RSA (3072 Bits), SmhKeyValueRef=RsaKey3072ExpValue, SmhKeyValueRef=RsaKey3072ModValue
      6 x SmhKeyValue, all with SmhDescription=:
        AesKeyValue: SmhValue=00112233445566778899aabbccddeeff, SmhSuffix=AesKey, SmhCryptoKeyElementRef=Crypto_30_LibCv_Fbl_Aes128_Key
        RsaKey2048ExpValue: SmhSuffix=Exp, SmhValue=00010001, SmhCryptoKeyElementRef=Crypto_30_LibCv_Fbl_Signature_Rsa2048_Exp
        RsaKey2048ModValue: SmhSuffix=Mod, SmhValue=B1C5BE469A4F56098B1B4EC0B51502B0E89C147A8F769708078D3AA395EC97CD76848C9D9A6E00C3F2C1CBE35AA5FFD9C06CAAFDE16A61BF06E415BDA6D52B5737188B01B609292F08AF9760ED62316E006655631A7EF9B23DBDD4A5F4F6F6C87B6575DC40D05E75451DD394583D89C92380AFB598C77564D135281CA69B725CD272DAB478FE330DF9D3136D57597F7F40E965EDF327C72986D80286063CC9AA165BBDCE00DC0E67445A62554D66C75775174F575CA9E2F648EBA97F0B261BA6DF918C535C0430AF045BAD7F41BE01EE8F891825D541434D8F429FA74FAC7AF4A00D95F07D1C7F5DFAE94A468CD5351E1B0C15E9F52FA8F101B17CF784632D75, SmhCryptoKeyElementRef=Crypto_30_LibCv_Fbl_Signature_Rsa2048_Mod
        RsaKey3072ExpValue: SmhSuffix=Exp, SmhValue=00010001, SmhCryptoKeyElementRef=Crypto_30_LibCv_Fbl_Signature_Rsa3072_Exp
        RsaKey3072ModValue: SmhSuffix=Mod, SmhValue=D27DA65AF1BE1B2938258AC85EA5ABBCBE39296923562764F65EB017998D17105DF62D9D8070F44622BB7488D19F65A6EF829FD59CF02A702C3216C097BED86665FE9252797982B9FE2F168A23EA16AA7DEF98E1DC0A75DB23ED625F506478D1879887A40B8C762E6E7693E70B4642F863594842DE66539ABA12B80EBDA19D99D94F9EC6A18E9EDC2EAF381D6A695DF49E3006EB2F739467BA5D34070E95DC618BA712D816C47A0D2470B7189ACC403FC6E2572CAD7E1E40DE7158586EF34A806D2528BD481B30E79D430052103BE5A44C31C3E4EBF23708FA4F0428C9FD14429014CB6486008B44A2A8A1CC146296AA99CC2E7B4D3CF78E7103379890545FF105CE50E82AC5FEF0A5DF43CB34625427BA57E7F174BC1E3ADA54D5F02B8A7EBDDB13C88A91C1F8FAFDDB0C67F17005194A7849AFD9149115A529F882D16429AC07F216B5648EBCEB07ADEE0FE53237BBE9224A9D21B353C15A2F03F454F902CE18D89F3B4C64186FC41D9FB2D2DB1F425A8CDB7D9093800A0BBD3639975BD1FF, SmhCryptoKeyElementRef=Crypto_30_LibCv_Fbl_Signature_Rsa3072_Mod
        AesIvValue: SmhSuffix=AesIV, SmhValue=00000000000000000000000000000000, SmhCryptoKeyElementRef=Crypto_30_LibCv_Fbl_Aes128_IV
      SecAccess_AesKey (SmhKey): SmhDescription=Decryption key for security access, SmhKeyValueRef=Sec_Access_AesKeyValue, SmhKeyValueRef=SecAccess_AesIvValue
      Sec_Access_AesKeyValue (SmhKeyValue): SmhValue=000102030405060708090A0B0C0D0E0F, SmhSuffix=, SmhDescription=, SmhCryptoKeyElementRef=Crypto_30_LibCv_Fbl_Aes128_Key
      SecAccess_AesIvValue (SmhKeyValue): SmhSuffix=IV, SmhValue=00000000000000000000000000000000, SmhDescription=, SmhCryptoKeyElementRef=Crypto_30_LibCv_Fbl_Aes128_IV
      SecAccess_DiagSecH_Rsa2048Key (SmhKey):
        SmhDescription = Public key for RSA (2048 Bits) used in DiagSecH
        SmhKeyValueRef = RsaKey2048ExpValue_DiagSecH
        SmhKeyValueRef = RsaKey2048ModValue_DiagSecH
      RsaKey2048ExpValue_DiagSecH (SmhKeyValue): SmhSuffix=Exp, SmhValue=00010001, SmhDescription=, SmhCryptoKeyElementRef=Crypto_30_LibCv_Fbl_Signature_Rsa2048_Exp
      RsaKey2048ModValue_DiagSecH (SmhKeyValue):
        SmhSuffix = Mod
        SmhValue = CBEF678443AFEF6C4BCD656318FAB06D230F63B7FEC924DA47C43D37DDE2FBE6BF1BD0EA28E7B2EC4D445CE5B44A95F9FC306D6FB20D52AAB49DB366322087E460AF44BA2605B19DECA55ECC4EE1BA33E375C38424E5340E4FE71601259B9E732180DB44490DE3BFA09ADF8E1E70834FE54E43D661F934A7FE2EACFF83262F4BC2B150C98B8E627897F2A9A72274A1B823BA06E86D9F04582168682C1E8BF45AA508ED6A5B66A830EDEBE52AF3159C1B40A4E20D60450A1F8D06A821D7D76D5D4B90F2A7213DF2B5D82C184FB1305739344BE6CA7B98983699F01D104A6ADE122BA608ACB1E31AEDCB1CFC5144D653450DEFB1B7F3F41F163103564A640D0C5F
        SmhDescription = 
        SmhCryptoKeyElementRef = Crypto_30_LibCv_Fbl_Signature_Rsa2048_Mod
      SmhKeyOperations: SmhAccessKeyElementApis=false, SmhCopyKeyElementApi=false, SmhCopyKeyApi=false
    SmhJob_AesDecryption (SmhJob)
      SmhJob_AesDecryption (SmhDecryption): SmhCryptographicKeyRef=AesKey, SmhCsmJobRef=CsmJob_DecryptionAes128NoneCbc
    SmhJob_Verify_ClassCCC (SmhJob)
      SmhJob_Verify_ClassCCC (SmhSignatureVerify): SmhCryptographicKeyRef=ClassCCC_Rsa2048Key, SmhCsmJobRef=CsmJob_SigAsymVer_RsaV15Sha256
    SmhEncryption: SmhDecryptionDefaultConfig=SmhDecryptionConfig_Aes128, SmhEncryptionDefaultConfig=SmhEncryptionConfig_SecAccess
      SmhDecryptionConfig_Aes128 (SmhDecryptionConfig): SmhFunctionName=DecryptAes128, SmhJobRef=SmhJob_AesDecryption/SmhJob_AesDecryption
      SmhDecryptionConfig_SecAccess (SmhDecryptionConfig): SmhFunctionName=SecM_DecryptAes128PkcsCbc, SmhJobRef=SmhJob_SecAccess_AesDecryption/SmhJob_SecAccess_AesDecryption
      SmhEncryptionConfig_SecAccess (SmhEncryptionConfig): SmhFunctionName=SecM_EncryptAes128PkcsCbc, SmhJobRef=SmhJob_SecAccess_AesEncryption/SmhJob_SecAccess_AesEncryption
      SmhEncryptionConfig: SmhFunctionName=SecM_EncryptRsaSha256Oaep, SmhJobRef=SmhJob_RsaSha256OaepEncryption/SmhJob_RsaSha256OaepEncryption
    3 x SmhJob:
      SmhJob_SecAccess_AesDecryption
        SmhJob_SecAccess_AesDecryption (SmhDecryption): SmhCryptographicKeyRef=SecAccess_AesKey, SmhCsmJobRef=CsmJob_DecryptionAes128NoneCbc
      SmhJob_SecAccess_AesEncryption
        SmhJob_SecAccess_AesEncryption (SmhEncryption): SmhCryptographicKeyRef=SecAccess_AesKey, SmhCsmJobRef=CsmJob_EncryptionAes128NoneCbc
      SmhJob_Sha1
        SmhJob_Sha1 (SmhHash): SmhCsmJobRef=CsmJob_Sha1
    SmhCrc: SmhCRCType=CRC_32
      SmhCrc32: SmhOptimization=SPEED, SmhInitialValue=4294967295, SmhPolynomial=3988292384, SmhMode=REFLECTED, SmhComplementValue=4294967295
    SmhJob_Verify_ClassCCC_DiagSecH (SmhJob)
      SmhJob_Verify_ClassCCC_DiagSecH (SmhSignatureVerify): SmhCryptographicKeyRef=SecAccess_DiagSecH_Rsa2048Key, SmhCsmJobRef=CsmJob_SigAsymVer_RsaPssSha256
    SmhJob_RsaSha256OaepEncryption (SmhJob)
      SmhJob_RsaSha256OaepEncryption (SmhEncryption): SmhCryptographicKeyRef=SecAccess_DiagSecH_Rsa2048Key, SmhCsmJobRef=CsmJob_EncryptionRsaSha256Oaep
    SmhVerification
      SmhMonolithicVerification:
        SmhCRCWritten = false
        SmhMemoryAccessMode = ADDRESS
        SmhExportVerificationWrapper = false
        SmhOperationCountOfWrapper = 4
        SmhCheckAddressRangeOverflow = false
        SmhAssertReadCount = false
        SmhCRCTotal = false
        SmhReadBufferSize = 64
        SmhCRCWrittenGet = false
        SmhDefaultMonolithicVerificationConfig = SmhSecurityClassDDD/SmhSecurityClassDDDConfig
        SmhSecurityClassDDD: SmhDefaultSecurityClassDDDConfig=SmhSecurityClassDDD/SmhSecurityClassDDDConfig
          SmhSecurityClassDDDConfig:
            SmhFunctionName = SecM_VerificationClassDDD
            SmhIncludeAddressAndLengthInSignature = false
            SmhSignatureOffset = 0
            SmhCRCOffset = 0
            SmhStreamVerificationConfig = SmhSecurityClassDDD/SmhSecurityClassDDDConfig
        SmhSecurityClassCCC: SmhDefaultSecurityClassCCCConfig=SmhSecurityClassCCC/SmhSecurityClassCCCConfig
          SmhSecurityClassCCCConfig:
            SmhFunctionName = SecM_Verification_ClassCCC
            SmhIncludeAddressAndLengthInSignature = false
            SmhSignatureOffset = 0
            SmhCRCOffset = 0
            SmhStreamVerificationConfig = SmhSecurityClassCCC/SmhSecurityClassCCCConfig
      SmhStreamVerification: SmhDefaultStreamVerificationConfig=SmhSecurityClassCCC/SmhSecurityClassCCCConfig
        SmhSecurityClassDDD: SmhDefaultSecurityClassDDDConfig=SmhSecurityClassDDD/SmhSecurityClassDDDConfig
          SmhSecurityClassDDDConfig: SmhFunctionName=SecM_VerifyClass_DDD, SmhUpdateLengthOfHashedData=false, SmhComputationOnly=false
            SmhSecurityClassDDDType
              SmhHash: SmhJobRef=SmhJob_Sha1/SmhJob_Sha1
        SmhSecurityClassCCC: SmhDefaultSecurityClassCCCConfig=SmhSecurityClassCCC/SmhSecurityClassCCCConfig
          SmhSecurityClassCCCConfig: SmhFunctionName=SecM_VerifyClass_CCC, SmhUpdateLengthOfHashedData=false, SmhJobRef=SmhJob_Verify_ClassCCC/SmhJob_Verify_ClassCCC
          SmhSecurityClassCCCConfig_DiagSecH (SmhSecurityClassCCCConfig):
            SmhFunctionName = SecM_VerifySigRsaPssSha256
            SmhUpdateLengthOfHashedData = false
            SmhJobRef = SmhJob_Verify_ClassCCC_DiagSecH/SmhJob_Verify_ClassCCC_DiagSecH

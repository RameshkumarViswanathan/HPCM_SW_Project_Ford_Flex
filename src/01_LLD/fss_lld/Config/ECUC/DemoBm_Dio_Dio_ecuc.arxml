AUTOSAR XML (schema 00049)
package /Dio
  module config Dio: implementation-config-variant=VARIANT-LINK-TIME, module-description=Dio_Impl
    CommonPublishedInformation:
      ArMajorVersion = 4
      ArMinorVersion = 2
      ArPatchVersion = 2
      ModuleId = 120
      Release = _TRICORE_TC387
      SwMajorVersion = 20
      SwMinorVersion = 0
      SwPatchVersion = 1
      VendorId = 17
    DioConfig
      3 x DioPort:
        DioPort_32: DioPortId=32
          DioChannel_2_CAN03_RXDB (DioChannel): DioChannelId=2
        DioPort_22: DioPortId=22
          DioChannel_5_CAN13_RXDA (DioChannel): DioChannelId=5
        DioPort_14: DioPortId=14
          3 x DioChannel:
            DioChannel_0_CanEtsEn: DioChannelId=0
            DioChannel_1_CanEtsNstb: DioChannelId=1
            DioChannel_6_CanEtsErr: DioChannelId=6
    DioGeneral: DioDevErrorDetect=true, DioFlipChannelApi=false, DioMaskedWritePortApi=true, DioSafetyEnable=false, DioVersionInfoApi=false

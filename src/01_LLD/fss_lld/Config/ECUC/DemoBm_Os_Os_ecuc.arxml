AUTOSAR XML (schema 00049)
package /ActiveEcuC
  module config Os: implementation-config-variant=VARIANT-PRE-COMPILE
    OsAppMode
    OsOS: OsStackMonitoring=false, OsStatus=STANDARD, OsUseGetServiceId=false, OsUseParameterAccess=false, OsUseResScheduler=true
      OsHooks: OsErrorHook=false, OsPostTaskHook=false, OsPreTaskHook=false, OsShutdownHook=false, OsStartupHook=false, OsProtectionHook=false
    OsCounter: OsCounterMaxAllowedValue=18446744073709551615, OsCounterMinCycle=1, OsCounterTicksPerBase=100000, OsCounterType=SOFTWARE, OsSecondsPerTick=0.001
    OsResource: OsResourceProperty=STANDARD

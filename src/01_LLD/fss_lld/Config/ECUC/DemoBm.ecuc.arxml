AUTOSAR XML (schema 00049)
package /ActiveEcuC
  ecuc value collection ActiveEcuC
    ecuc-values:
      EcuM
      EcuC
      vSet
      Det
      Os
      FblBm
      FblHal
      FblBmHdr
      Csm
      vSecPrim
      Crypto
      CryIf
      vBaseEnv
      Irq
      McalLib
      vBRS
      ResourceM
      Dem
      Smh
      Mcu
      Irq
      Fbl
      Fls
      MemMap
      vLinkGen
      Dio
      Fee
      NvM
      WrapNv
      vMemAccM
      vMem
      vOtaM

AUTOSAR XML (schema 00049)
package /ActiveEcuC
  module config NvM: implementation-config-variant=VARIANT-PRE-COMPILE
    NvMBlockDescriptor_XcpRxTesterSourceAddr (NvMBlockDescriptor):
      NvMBlockJobPriority = 0
      NvMBlockManagementType = NVM_BLOCK_NATIVE
      NvMBlockUseCrc = false
      NvMBlockUseSyncMechanism = false
      NvMBlockWriteProt = false
      NvMBswMBlockStatusInformation = false
      NvMMaxNumOfReadRetries = 0
      NvMMaxNumOfWriteRetries = 0
      NvMNvBlockBaseNumber = 540
      NvMNvBlockLength = 1
      NvMNvBlockNum = 1
      NvMNvramBlockIdentifier = 2
      NvMNvramDeviceId = 0
      NvMResistantToChangedSw = false
      NvMRomBlockNum = 0
      NvMStaticBlockIDCheck = false
      NvMWriteBlockOnce = false
      NvMWriteVerification = false
      NvMWriteVerificationDataSize = 1
      NvMInitBlockCallback = NULL_PTR
      NvMTargetBlockReference
        NvMFeeRef: NvMNameOfFeeBlock=FeeBlockDescriptor_XcpRxTesterSourceAddr
    NvMCommon:
      NvMApiConfigClass = NVM_API_CONFIG_CLASS_3
      NvMBswMMultiBlockJobStatusInformation = true
      NvMCompiledConfigId = 0
      NvMCrcNumOfBytes = 1
      NvMDatasetSelectionBits = 3
      NvMDevErrorDetect = true
      NvMDrvModeSwitch = false
      NvMDynamicConfiguration = false
      NvMJobPrioritization = false
      NvMPollingMode = false
      NvMRepeatMirrorOperations = 0
      NvMSetRamBlockStatusApi = false
      NvMSizeStandardJobQueue = 1
      NvMVersionInfoApi = false
    15 x NvMBlockDescriptor, all with NvMBlockJobPriority=0, NvMBlockUseCrc=false, NvMBlockUseSyncMechanism=false, NvMBlockWriteProt=false, NvMBswMBlockStatusInformation=false, NvMMaxNumOfReadRetries=0, NvMMaxNumOfWriteRetries=0, NvMNvramBlockIdentifier=2, NvMNvramDeviceId=0, NvMResistantToChangedSw=false, NvMRomBlockNum=0, NvMStaticBlockIDCheck=false, NvMWriteBlockOnce=false, NvMWriteVerification=false, NvMWriteVerificationDataSize=1:
      NvMBlockDescriptor_DcmDslRxTesterSourceAddr: NvMBlockManagementType=NVM_BLOCK_NATIVE, NvMNvBlockBaseNumber=524, NvMNvBlockLength=2, NvMNvBlockNum=1, NvMInitBlockCallback=NULL_PTR
        NvMTargetBlockReference
          NvMFeeRef: NvMNameOfFeeBlock=FeeBlockDescriptor_DcmDslRxTesterSourceAddr
      NvMBlockDescriptor_ProgReqFlag: NvMBlockManagementType=NVM_BLOCK_NATIVE, NvMNvBlockBaseNumber=512, NvMNvBlockLength=1, NvMNvBlockNum=1, NvMInitBlockCallback=NULL_PTR
        NvMTargetBlockReference
          NvMFeeRef: NvMNameOfFeeBlock=FeeBlockDescriptor_ProgReqFlag
      NvMBlockDescriptor_InitFlag: NvMBlockManagementType=NVM_BLOCK_NATIVE, NvMNvBlockBaseNumber=528, NvMNvBlockLength=1, NvMNvBlockNum=1, NvMInitBlockCallback=NULL_PTR
        NvMTargetBlockReference
          NvMFeeRef: NvMNameOfFeeBlock=FeeBlockDescriptor_InitFlag
      NvMBlockDescriptor_DtcList: NvMBlockManagementType=NVM_BLOCK_NATIVE, NvMNvBlockBaseNumber=530, NvMNvBlockLength=10, NvMNvBlockNum=1, NvMInitBlockCallback=NULL_PTR
        NvMTargetBlockReference
          NvMFeeRef: NvMNameOfFeeBlock=FeeBlockDescriptor_DtcList
      NvMBlockDescriptor_DiDs: NvMBlockManagementType=NVM_BLOCK_NATIVE, NvMNvBlockBaseNumber=538, NvMNvBlockLength=208, NvMNvBlockNum=1, NvMInitBlockCallback=NULL_PTR
        NvMTargetBlockReference
          NvMFeeRef: NvMNameOfFeeBlock=FeeBlockDescriptor_DiDs
      NvMBlockDescriptor_MetaDataModule: NvMBlockManagementType=NVM_BLOCK_DATASET, NvMNvBlockBaseNumber=532, NvMNvBlockLength=28, NvMNvBlockNum=6, NvMInitBlockCallback=NULL_PTR
        NvMTargetBlockReference
          NvMFeeRef: NvMNameOfFeeBlock=FeeBlockDescriptor_MetaDataModule
      NvMBlockDescriptor_MetaDataPartition: NvMBlockManagementType=NVM_BLOCK_DATASET, NvMNvBlockBaseNumber=534, NvMNvBlockLength=6, NvMNvBlockNum=3, NvMInitBlockCallback=NULL_PTR
        NvMTargetBlockReference
          NvMFeeRef: NvMNameOfFeeBlock=FeeBlockDescriptor_MetaDataPartition
      NvMBlockDescriptor_DiagSecH: NvMBlockManagementType=NVM_BLOCK_NATIVE, NvMNvBlockBaseNumber=218, NvMNvBlockLength=154, NvMNvBlockNum=1, NvMInitBlockCallback=NULL_PTR
        NvMTargetBlockReference
          NvMFeeRef: NvMNameOfFeeBlock=FeeBlockDescriptor_DiagSecH
      NvMBlockDescriptor_fblApplValidityNvBlock: NvMBlockManagementType=NVM_BLOCK_NATIVE, NvMNvBlockBaseNumber=516, NvMNvBlockLength=1, NvMNvBlockNum=1, NvMInitBlockCallback=FblSharedNvData_fblApplValidityNvBlock, NvMCalcRamBlockCrc=false
        NvMTargetBlockReference
          NvMFeeRef: NvMNameOfFeeBlock=FeeBlockDescriptor_fblApplValidityNvBlock
      NvMBlockDescriptor_ResetResponseFlagNvBlock: NvMBlockManagementType=NVM_BLOCK_NATIVE, NvMNvBlockBaseNumber=514, NvMNvBlockLength=1, NvMNvBlockNum=1, NvMInitBlockCallback=NULL_PTR, NvMCalcRamBlockCrc=false, NvMSelectBlockForReadAll=false
        NvMTargetBlockReference
          NvMFeeRef: NvMNameOfFeeBlock=FeeBlockDescriptor_ResetResponseFlagNvBlock
      NvMBlockDescriptor_SecAccessDelayFlagNvBlock: NvMBlockManagementType=NVM_BLOCK_NATIVE, NvMNvBlockBaseNumber=520, NvMNvBlockLength=1, NvMNvBlockNum=1, NvMInitBlockCallback=NULL_PTR, NvMSelectBlockForReadAll=false
        NvMTargetBlockReference
          NvMFeeRef: NvMNameOfFeeBlock=FeeBlockDescriptor_SecAccessDelayFlagNvBlock
      NvMBlockDescriptor_SecAccessInvalidCountNvBlock: NvMBlockManagementType=NVM_BLOCK_NATIVE, NvMNvBlockBaseNumber=522, NvMNvBlockLength=1, NvMNvBlockNum=1, NvMInitBlockCallback=NULL_PTR
        NvMTargetBlockReference
          NvMFeeRef: NvMNameOfFeeBlock=FeeBlockDescriptor_SecAccessInvalidCountNvBlock
      NvMBlockDescriptor_ValidityFlagsNvBlock: NvMBlockManagementType=NVM_BLOCK_NATIVE, NvMNvBlockBaseNumber=518, NvMNvBlockLength=1, NvMNvBlockNum=1, NvMInitBlockCallback=NULL_PTR
        NvMTargetBlockReference
          NvMFeeRef: NvMNameOfFeeBlock=FeeBlockDescriptor_ValidityFlagsNvBlock
      NvMBlockDescriptor_MileageForNormalMode: NvMBlockManagementType=NVM_BLOCK_NATIVE, NvMNvBlockBaseNumber=128, NvMNvBlockLength=1, NvMNvBlockNum=1, NvMInitBlockCallback=NULL_PTR
        NvMTargetBlockReference
          NvMFeeRef: NvMNameOfFeeBlock=FeeBlockDescriptor_MileageForNormalMode
      NvMBlockDescriptor_VIN: NvMBlockManagementType=NVM_BLOCK_NATIVE, NvMNvBlockBaseNumber=130, NvMNvBlockLength=17, NvMNvBlockNum=1, NvMInitBlockCallback=NULL_PTR
        NvMTargetBlockReference
          NvMFeeRef: NvMNameOfFeeBlock=FeeBlockDescriptor_VIN

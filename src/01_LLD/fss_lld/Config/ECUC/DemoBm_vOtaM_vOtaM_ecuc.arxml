AUTOSAR XML (schema 00049)
package /ActiveEcuC
  module config vOtaM: implementation-config-variant=VARIANT-PRE-COMPILE, module-description=vOtaM_Impl
    vOtaMGeneral:
      vOtaMReadProcessing = false
      vOtaMUseCase = BASIC
      vOtaMCopyBufferSize = 1024
      vOtaMSwapAttempts = 1
      vOtaMEnableSetActiveVariantApi = false
      vOtaMFlashDriverInit = true
      vOtaMProgAttempts = false
      vOtaMProgAttemptsThresholdSwap = 1
      vOtaMProgAttemptsThresholdRollback = 1
      vOtaMSyncPartition = false
      vOtaMInvalidatePartition = vOtaM_InvalidatePartition
      vOtaMValidatePartition = vOtaM_ValidatePartition
      vOtaMInvalidateModule = vOtaM_InvalidateModule
      vOtaMValidateModule = vOtaM_ValidateModule
    vOtaMLayout
      vOtaMPartition_B (vOtaMPartition): vOtaMPartitionId=1, vOtaMAddressAreaRef=AddressArea_B
      Module_Bootloader (vOtaMModule): vOtaMModuleId=1, vOtaMSyncModule=false, vOtaMLogicalBlockRef=FblLogicalBlock_FBL, vOtaMPartitionGroupRef=PartitionGroup_Swap
      PartitionGroup_Swap (vOtaMPartitionGroup): vOtaMPartitionRef=vOtaMPartition_A, vOtaMPartitionRef=vOtaMPartition_B
      Module_Application (vOtaMModule): vOtaMModuleId=0, vOtaMSyncModule=false, vOtaMLogicalBlockRef=FblLogicalBlock_ASW, vOtaMPartitionGroupRef=PartitionGroup_Swap
      Module_Calibration (vOtaMModule): vOtaMModuleId=2, vOtaMSyncModule=false, vOtaMLogicalBlockRef=FblLogicalBlock_CALIB, vOtaMPartitionGroupRef=PartitionGroup_Swap
      vOtaMPartition_A (vOtaMPartition): vOtaMPartitionId=0, vOtaMAddressAreaRef=AddressArea_A

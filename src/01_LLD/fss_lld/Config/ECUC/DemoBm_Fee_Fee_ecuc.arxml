AUTOSAR XML (schema 00049)
package /ActiveEcuC
  module config Fee: implementation-config-variant=VARIANT-POST-BUILD, module-description=Fee_Impl
    FeeBlockDescriptor_XcpRxTesterSourceAddr (FeeBlockConfiguration):
      FeeBlockNumber = 4320
      FeeQsBlockInstances = 0
      FeeQsBlockAddress = 0
      FeeQuasiStaticManager = false
      FeeBlockSize = 1
      FeeImmediateData = true
      FeeNumberOfWriteCycles = 0
      FeeDeviceIndex = FlsGeneral
    FeeGeneral:
      FeeDevErrorDetect = true
      FeeSafetyEnable = false
      FeeInitCheckApi = false
      FeeMainFunctionPeriod = 0.01
      FeePollingMode = false
      FeeSetModeSupported = true
      FeeVersionInfoApi = false
      FeeVirtualPageSize = 8
      FeeBlockTypeConfigured = FEE_DOUBLE_SECTOR_DATA_ONLY
    FeePublishedInformation: FeeBlockOverhead=17, FeePageOverhead=1
    FeeIfxSpecificConfig:
      FeeThresholdValue = 200
      FeeMaxBlockCount = 128
      FeeRunTimeErrorDetect = true
      FeeBlocksScannedPerCycle = 0
      FeeUseEraseSuspend = false
      FeeStateVarStructure = Fee_StateVar
      FeeUnConfigBlock = FEE_UNCONFIG_BLOCK_IGNORE
      FeeUnConfigBlkOverflowHandle = FEE_CONTINUE
      FeeGcRestart = FEE_GC_RESTART_INIT
      FeeGetCycleCountApi = false
      FeeEccErrorInfoApi = false
      FeeEraseAllEnable = true
      FeeGetPrevDataApi = false
      FeeCancelAllApi = false
      FeeMaxBytesPerCycle = FEE_MAX_BYTES_512
      FeeNvmIllegalStateNotification = NULL_PTR
      FeeQsIllegalStateNotification = NULL_PTR
      FeeQsHardenErrorNotification = NULL_PTR
      FeeVirginFlashIllegalState = false
    CommonPublishedInformation:
      ArMajorVersion = 4
      ArMinorVersion = 2
      ArPatchVersion = 2
      SwMajorVersion = 20
      SwMinorVersion = 10
      SwPatchVersion = 0
      ModuleId = 21
      VendorId = 17
      Release = _TRICORE_TC387
    FeeDemEventParameterRefs:
      FEE_E_GC_ERASE = FEE_E_FAILURE
      FEE_E_GC_INIT = FEE_E_FAILURE
      FEE_E_GC_READ = FEE_E_FAILURE
      FEE_E_GC_TRIG = FEE_E_FAILURE
      FEE_E_GC_WRITE = FEE_E_FAILURE
      FEE_E_INVALIDATE = FEE_E_FAILURE
      FEE_E_READ = FEE_E_FAILURE
      FEE_E_UNCONFIG_BLK_EXCEEDED = FEE_E_FAILURE
      FEE_E_WRITE = FEE_E_FAILURE
      FEE_E_WRITE_CYCLES_EXHAUSTED = FEE_E_FAILURE
    22 x FeeBlockConfiguration, all with FeeQsBlockInstances=0, FeeQsBlockAddress=0, FeeQuasiStaticManager=false, FeeImmediateData=true, FeeNumberOfWriteCycles=0, FeeDeviceIndex=FlsGeneral:
      FeeBlockDescriptor_DcmDslRxTesterSourceAddr: FeeBlockNumber=4192, FeeBlockSize=2
      FeeBlockDescriptor_ProgReqFlag: FeeBlockNumber=4096, FeeBlockSize=1
      FeeBlockDescriptor_InitFlag: FeeBlockNumber=4224, FeeBlockSize=1
      FeeBlockDescriptor_DtcList: FeeBlockNumber=4240, FeeBlockSize=10
      FeeBlockDescriptor_DiDs: FeeBlockNumber=4304, FeeBlockSize=208
      FeeBlockDescriptor_MetaDataModule: FeeBlockNumber=4256, FeeBlockSize=28
      FeeBlockDescriptor_MetaDataPartition: FeeBlockNumber=4272, FeeBlockSize=6
      FeeBlockDescriptor_DiagSecH: FeeBlockNumber=4288, FeeBlockSize=154
      FeeBlockDescriptor_fblApplValidityNvBlock: FeeBlockNumber=4128, FeeBlockSize=1
      FeeBlockDescriptor_ResetResponseFlagNvBlock: FeeBlockNumber=4112, FeeBlockSize=1
      FeeBlockDescriptor_SecAccessDelayFlagNvBlock: FeeBlockNumber=4160, FeeBlockSize=1
      FeeBlockDescriptor_SecAccessInvalidCountNvBlock: FeeBlockNumber=4176, FeeBlockSize=1
      FeeBlockDescriptor_ValidityFlagsNvBlock: FeeBlockNumber=4144, FeeBlockSize=1
      FeeBlockDescriptor_MileageForNormalMode: FeeBlockNumber=1024, FeeBlockSize=1
      FeeBlockDescriptor_VIN: FeeBlockNumber=1040, FeeBlockSize=17
      FeeBlockDescriptor_MetaDataModule_cons0: FeeBlockNumber=4257, FeeBlockSize=28
      FeeBlockDescriptor_MetaDataModule_cons1: FeeBlockNumber=4258, FeeBlockSize=28
      FeeBlockDescriptor_MetaDataModule_cons2: FeeBlockNumber=4259, FeeBlockSize=28
      FeeBlockDescriptor_MetaDataModule_cons3: FeeBlockNumber=4260, FeeBlockSize=28
      FeeBlockDescriptor_MetaDataModule_cons4: FeeBlockNumber=4261, FeeBlockSize=28
      FeeBlockDescriptor_MetaDataPartition_cons0: FeeBlockNumber=4273, FeeBlockSize=6
      FeeBlockDescriptor_MetaDataPartition_cons1: FeeBlockNumber=4274, FeeBlockSize=6

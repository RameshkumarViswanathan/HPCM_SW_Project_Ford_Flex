AUTOSAR XML (schema 00049)
package /ActiveEcuC
  module config vMemAccM: implementation-config-variant=VARIANT-PRE-COMPILE, module-description=vMemAccM_Impl
    vMemAccMGeneral:
      vMemAccMVersionInfoApi = false
      vMemAccMMainFunctionPeriod = 0.005
      vMemAccMMainFunctionTriggering = FixedCycleTime
      vMemAccMSafeBswChecks = false
      vMemAccMDevErrorDetect = true
      vMemAccMCompareApi = false
    AddressArea_A (vMemAccMAddressAreaConfiguration): vMemAccMAddressAreaId=0, vMemAccMAddressAreaPriority=0, vMemAccMReadRequestLength=64
      3 x vMemAccMSubAddressAreaConfiguration, all with vMemAccMvMemFuncPtrTableSymbol=vMem_30_Fbl_FunctionPointerTable, vMemAccMUseEraseBurst=false, vMemAccMUseWriteBurst=false:
        SubAddressArea_Bootloader: vMemAccMNumberOfSectors=1, vMemAccMVirtualStartAddress=2147876864, vMemAccMPhysicalStartAddress=2147876864, vMemAccMSectorRef=vMemSector_S0
        SubAddressArea_Application: vMemAccMNumberOfSectors=23, vMemAccMVirtualStartAddress=2148270080, vMemAccMPhysicalStartAddress=2148270080, vMemAccMSectorRef=vMemSector_S1_S23
        SubAddressArea_Calibration: vMemAccMNumberOfSectors=1, vMemAccMVirtualStartAddress=2151284736, vMemAccMPhysicalStartAddress=2151284736, vMemAccMSectorRef=vMemSector_S24
    AddressArea_B (vMemAccMAddressAreaConfiguration): vMemAccMAddressAreaId=1, vMemAccMAddressAreaPriority=1, vMemAccMReadRequestLength=64
      3 x vMemAccMSubAddressAreaConfiguration, all with vMemAccMvMemFuncPtrTableSymbol=vMem_30_Fbl_FunctionPointerTable, vMemAccMUseEraseBurst=false, vMemAccMUseWriteBurst=false:
        SubAddressArea_Application: vMemAccMNumberOfSectors=23, vMemAccMVirtualStartAddress=2148270080, vMemAccMPhysicalStartAddress=2154561536, vMemAccMSectorRef=vMemSector_S26_S48
        SubAddressArea_Bootloader: vMemAccMNumberOfSectors=1, vMemAccMVirtualStartAddress=2147876864, vMemAccMPhysicalStartAddress=2154168320, vMemAccMSectorRef=vMemSector_S25
        SubAddressArea_Calibration: vMemAccMNumberOfSectors=1, vMemAccMVirtualStartAddress=2151284736, vMemAccMPhysicalStartAddress=2157576192, vMemAccMSectorRef=vMemSector_S49

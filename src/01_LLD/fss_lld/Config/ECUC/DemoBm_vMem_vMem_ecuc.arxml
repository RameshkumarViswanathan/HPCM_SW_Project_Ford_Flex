AUTOSAR XML (schema 00049)
package /ActiveEcuC
  module config vMem: implementation-config-variant=VARIANT-PRE-COMPILE, module-description=vMem_Impl
    vMemInstance: vMemInstanceId=0
      vMemSectorList
        6 x vMemSector, all with vMemPageSize=32:
          vMemSector_S0: vMemNumberOfSectors=1, vMemSectorSize=393216, vMemStartAddress=2147876864
          vMemSector_S1_S23: vMemNumberOfSectors=23, vMemSectorSize=131072, vMemStartAddress=2148270080
          vMemSector_S24: vMemNumberOfSectors=1, vMemSectorSize=376832, vMemStartAddress=2151284736
          vMemSector_S25: vMemNumberOfSectors=1, vMemSectorSize=393216, vMemStartAddress=2154168320
          vMemSector_S26_S48: vMemNumberOfSectors=23, vMemSectorSize=131072, vMemStartAddress=2154561536
          vMemSector_S49: vMemNumberOfSectors=1, vMemSectorSize=376832, vMemStartAddress=2157576192
    vMemInstanceMapping: vMemvMemInstanceRef=vMemInstance, vMemFblMemoryDeviceRef=Flash
    vMemGeneral: vMemInitialize=false, vMemUseIsBlank=false, vMemUserMainFunction=false, vMemUserInitFunction=false, vMemCompareAfterWrite=false

AUTOSAR XML (schema 00049)
package /InitialEcuC
  ecuc value collection InitialEcuC

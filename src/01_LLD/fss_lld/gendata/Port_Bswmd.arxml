AUTOSAR XML (schema 4-2-2)
# Copyright (C) Infineon Technologies (2021)
# All rights reserved.
package /AUTOSAR_Port/BswModuleDescriptions
  bsw module description Port: category=BSW_MODULE, module-id=124, provided-entrys=[Port_Init, Port_RefreshPortDirection]  # PORT Driver
    bsw module dependency DetDependency: target-module-id=15, required-entrys=Det_ReportError
    bsw module dependency McalLibDependency: target-module-id=255, required-entrys=[Mcal_WritePeripEndInitProtReg, Mcal_WriteSafetyEndInitProtRegMask, Mcal_SetBitAtomic]
    bsw module dependency McalSafetyErrorDependency: target-module-id=255, required-entrys=Mcal_ReportSafetyError
    bsw internal behavior PortBehavior
      bsw called entity Port_Init: reentrancy-level=NON-REENTRANT, implemented-entry=Port_Init
      bsw called entity Port_RefreshPortDirection: reentrancy-level=NON-REENTRANT, implemented-entry=Port_RefreshPortDirection
package /AUTOSAR_Port/BswModuleEntrys
  bsw module entry Port_Init: service-id=0, is-reentrant=false, is-synchronous=true, call-type=REGULAR, execution-context=TASK, sw-service-impl-policy=STANDARD
    sw service arg ConfigPtr: category=DATA_REFERENCE, sw-pointer-target-props={target-category=TYPE_REFERENCE, implementation-data-type=Port_ConfigType}
  bsw module entry Port_RefreshPortDirection: service-id=2, is-reentrant=false, is-synchronous=true, call-type=REGULAR, execution-context=TASK, sw-service-impl-policy=STANDARD
package /AUTOSAR_Port/Implementations
  bsw implementation Port: programming-language=C, sw-version=20.10.0, vendor-id=17, ar-release-version=4.2.2, behavior=PortBehavior, vendor-specific-module-def=Port
    code-descriptors:
      code Files: artifact-descriptors=[{short-label=ssc::src::Port.c, category=SWSRC}, {short-label=ssc::inc::Port.h, category=SWHDR}]
    generated-artifacts:
      5 x dependency on artifact:
        Port_PBCfg_c: artifact-descriptor={short-label=generate::template::src::Port_PBCfg.c, category=SWTEMPLATE}, usages=EXECUTE
        Port_PBCfg_h: artifact-descriptor={short-label=generate::template::inc::Port_PBcfg.h, category=SWTEMPLATE}, usages=EXECUTE
        Port_xdm: artifact-descriptor={short-label=config::Port.xdm, category=SWTOOL}, usages=CODEGENERATION
        Port_Cfg_h: artifact-descriptor={short-label=generate::template::inc::Port_Cfg.h, category=SWTEMPLATE}, usages=COMPILE
        Port_bmd: artifact-descriptor={short-label=autosar::TC38x::TC387x::Port.bmd, category=SWTOOL}, usages=CODEGENERATION
    resource consumption ResourceConsumption
      5 x memory section:
        VAR_CLEARED_ASIL_B_GLOBAL_8: alignment=8, sw-addrmethod=VAR_CLEARED
        VAR_CLEARED_ASIL_B_GLOBAL_32: alignment=32, sw-addrmethod=VAR_CLEARED
        CONST_ASIL_B_GLOBAL_16: alignment=16, sw-addrmethod=CONST
        CONFIG_DATA_ASIL_B_GLOBAL_UNSPECIFIED: alignment=UNSPECIFIED, sw-addrmethod=CONFIG_DATA
        CODE_ASIL_B_GLOBAL: alignment=UNSPECIFIED, sw-addrmethod=CODE
      section name prefix PORT
package /AUTOSAR_Port/ImplementationDataTypes
  6 x impl type, all with category=STRUCTURE, type-emitter=BSW:
    Port_ConfigType
      5 x element, all with category=DATA_REFERENCE:
        PortConfigSetPtr: sw-pointer-target-props={target-category=TYPE_REFERENCE, implementation-data-type=Port_n_ConfigType}
        PDiscSet: sw-pointer-target-props={target-category=TYPE_REFERENCE, implementation-data-type=uint32}
        PortPinHwSupportedModes: sw-pointer-target-props={target-category=TYPE_REFERENCE, implementation-data-type=Port_n_ModeType}
        Port_LVDSConfigTypePtr: sw-pointer-target-props={target-category=TYPE_REFERENCE, implementation-data-type=Port_n_LVDSConfigType}
        Port_PCSRConfigTypePtr: sw-pointer-target-props={target-category=TYPE_REFERENCE, implementation-data-type=uint32}
    Port_n_ConfigType
      8 x element, all with category=TYPE_REFERENCE:
        PinControl: implementation-data-type=Port_n_ControlType
        PinLevel: implementation-data-type=Port_n_PinType
        DriverStrength0: implementation-data-type=uint32
        DriverStrength1: implementation-data-type=uint32
        ModeChangeControl: implementation-data-type=Port_n_PinType
        DirChangeControl: implementation-data-type=Port_n_PinType
        PinControl2: implementation-data-type=Port_n_ControlType
        EmergencyStopConf: implementation-data-type=Port_n_PinType
    Port_n_ControlType
      element PCx: implementation-data-type=uint8
    Port_n_LVDSConfigType
      element LPCRx: implementation-data-type=uint32
    Port_n_ModeType
      element U: array-size=16, array-size-semantics=FIXED-SIZE, implementation-data-type=uint8
    Port_n_PinType
      element Px: implementation-data-type=uint32
